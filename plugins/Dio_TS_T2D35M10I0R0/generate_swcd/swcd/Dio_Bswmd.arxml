AUTOSAR XML (schema 4-0-3)
package /AUTOSAR_Dio/BswModuleDescriptions
  bsw module description Dio: module-id=120
    provided-entrys:
      Dio_FlipChannel
      Dio_GetVersionInfo
      Dio_MaskedWritePort
      Dio_ReadChannel
      Dio_ReadChannelGroup
      Dio_ReadPort
      Dio_ValidateChannelForRead
      Dio_ValidateChannelForWrite
      Dio_ValidateChannelGroupForRead
      Dio_ValidateChannelGroupForWrite
      Dio_ValidateChannelLevel
      Dio_ValidatePortForRead
      Dio_ValidatePortForWrite
      Dio_WriteChannel
      Dio_WriteChannelGroup
      Dio_WritePort
      Dio_Init
    bsw internal behavior InternalBehavior_0
      exclusive area DIO_EXCLUSIVE_AREA_00
      exclusive area DIO_EXCLUSIVE_AREA_01
      17 x bsw called entity:
        Dio_FlipChannel: implemented-entry=Dio_FlipChannel
        Dio_GetVersionInfo: implemented-entry=Dio_GetVersionInfo
        Dio_MaskedWritePort: implemented-entry=Dio_MaskedWritePort
        Dio_ReadChannel: implemented-entry=Dio_ReadChannel
        Dio_ReadChannelGroup: implemented-entry=Dio_ReadChannelGroup
        Dio_ReadPort: implemented-entry=Dio_ReadPort
        Dio_ValidateChannelForRead: implemented-entry=Dio_ValidateChannelForRead
        Dio_ValidateChannelForWrite: implemented-entry=Dio_ValidateChannelForWrite
        Dio_ValidateChannelGroupForRead: implemented-entry=Dio_ValidateChannelGroupForRead
        Dio_ValidateChannelGroupForWrite: implemented-entry=Dio_ValidateChannelGroupForWrite
        Dio_ValidateChannelLevel: implemented-entry=Dio_ValidateChannelLevel
        Dio_ValidatePortForRead: implemented-entry=Dio_ValidatePortForRead
        Dio_ValidatePortForWrite: implemented-entry=Dio_ValidatePortForWrite
        Dio_WriteChannel: implemented-entry=Dio_WriteChannel
        Dio_WriteChannelGroup: implemented-entry=Dio_WriteChannelGroup
        Dio_WritePort: implemented-entry=Dio_WritePort
        Dio_Init: can-enter-exclusive-area=[DIO_EXCLUSIVE_AREA_00, DIO_EXCLUSIVE_AREA_01], implemented-entry=Dio_Init
package /AUTOSAR_Dio/BswModuleEntrys
  17 x bsw module entry, all with is-synchronous=true, call-type=REGULAR, execution-context=UNSPECIFIED, sw-service-impl-policy=STANDARD:
    Dio_FlipChannel: service-id=0x11, is-reentrant=true
    Dio_GetVersionInfo: service-id=0x12, is-reentrant=true
    Dio_MaskedWritePort: service-id=0, is-reentrant=false
    Dio_ReadChannel: service-id=0x00, is-reentrant=true
    Dio_ReadChannelGroup: service-id=0x04, is-reentrant=true
    Dio_ReadPort: service-id=0x02, is-reentrant=true
    Dio_ValidateChannelForRead: service-id=0, is-reentrant=false
    Dio_ValidateChannelForWrite: service-id=0, is-reentrant=false
    Dio_ValidateChannelGroupForRead: service-id=0, is-reentrant=false
    Dio_ValidateChannelGroupForWrite: service-id=0, is-reentrant=false
    Dio_ValidateChannelLevel: service-id=0, is-reentrant=false
    Dio_ValidatePortForRead: service-id=0, is-reentrant=false
    Dio_ValidatePortForWrite: service-id=0, is-reentrant=false
    Dio_WriteChannel: service-id=0x01, is-reentrant=true
    Dio_WriteChannelGroup: service-id=0x05, is-reentrant=true
    Dio_WritePort: service-id=0x03, is-reentrant=true
    Dio_Init: service-id=0x10, is-reentrant=false
package /Dio_T2D35M10I0R0/Implementations
  bsw implementation BswImplementation_0: programming-language=C, sw-version=1.0.0, vendor-id=43, ar-release-version=4.2.2, behavior=InternalBehavior_0, vendor-specific-module-def=Dio
    code-descriptors:
      code Files
        artifact-descriptors:
          short-label=config::Dio.xdm, category=SWCFG
          short-label=doc::AUTOSAR_MCAL_DIO_IM.pdf, category=SWDOC
          short-label=doc::AUTOSAR_MCAL_DIO_UM.pdf, category=SWDOC
          short-label=include::Dio.h, category=SWHDR
          short-label=include::Dio_EnvCfg.h, category=SWHDR
          short-label=include::Dio_Ipw.h, category=SWHDR
          short-label=include::Dio_Reg_eSys_Siul2.h, category=SWHDR
          short-label=include::Dio_Siul2.h, category=SWHDR
          short-label=include::Siul2_IpVersion.h, category=SWHDR
          short-label=src::Dio.c, category=SWSRC
          short-label=src::Dio_Siul2.c, category=SWSRC
    compiler DIAB_Compiler:
      name=Windriver Diab
      options=-tPPCE200Z4204N3VEN:simple -tPPCE200Z210N3VEN:simple -Xdialect-ansi -XO -g3 -Xsize-opt -Xsmall-data=0 -Xsmall-const=0 -Xaddr-sconst=0x11 -Xaddr-sdata=0x11 -Xno-common -Xnested-interrupts -Xdebug-dwarf2 -Xdebug-local-all -Xdebug-local-cie -Xdebug-struct-all -Xforce-declarations -ee1481 -Xmacro-undefined-warn -Xlink-time-lint -W:as:,-l -Wa,-Xisa-vle -DAUTOSAR_OS_NOT_USED -DUSE_SW_VECTOR_MODE -DDIAB -DDISABLE_MCAL_INTERMODULE_ASR_CHECK -c
      vendor=Windriver
      version=Windriver DIAB DIAB_5_9_6_2
    compiler GHS_Compiler:
      name=Green Hills
      options=-cpu=ppc5748gz4204 -cpu=ppc5748gz210 -ansi -noSPE -Ospace -sda=0 -vle -dual_debug -G --no_exceptions -Wundef -Wimplicit-int -Wshadow -Wtrigraphs --prototype_errors --incorrect_pragma_warnings -noslashcomment -preprocess_assembly_files -nostartfile --short_enum --diag_error 223 -DAUTOSAR_OS_NOT_USED -DUSE_SW_VECTOR_MODE -DDISABLE_MCAL_INTERMODULE_ASR_CHECK -DGHS -c
      vendor=Green Hills
      version=Green Hills Multi 7.1.4 / Compiler 2015.1.6
    generated-artifacts:
      dependency on artifact Dio_Cfg_h: artifact-descriptor={short-label=generate_PC::include::Dio_Cfg.h, category=SWHDR}, usages=COMPILE
      dependency on artifact Dio_Cfg_c: artifact-descriptor={short-label=generate_PC::src::Dio_Cfg.c, category=SWSRC}, usages=COMPILE
    linker DIAB_Linker: name=Windriver Diab, options=-tPPCE200Z4204N3VEN:simple -tPPCE200Z210N3VEN:simple -Xelf -m6 -Xlink-time-lint, vendor=Windriver, version=Windriver DIAB DIAB_5_9_6_2
    linker GHS_Linker: name=Green Hills, options=-cpu=ppc5748gz4204 -cpu=ppc5748gz210 -nostartfiles -vle --nocpp -Mn -delete -ignore_debug_references -keepmap, vendor=Green Hills, version=Green Hills Multi 7.1.4 / Compiler 2015.1.6
    resource consumption ResourceConsumption
      memory section DIO_CODE: alignment=UNSPECIFIED, sw-addrmethod=CODE, symbol=CODE
      memory section DIO_CONFIG_DATA_UNSPECIFIED: alignment=UNSPECIFIED, sw-addrmethod=CONFIG_DATA_UNSPECIFIED, symbol=CONFIG_DATA_UNSPECIFIED
