AUTOSAR XML (schema 4-0-3)
package /AUTOSAR_Pwm/BswModuleDescriptions
  bsw module description Pwm: module-id=121
    provided-entrys:
      Pwm_DeInit
      Pwm_DisableNotification
      Pwm_EnableNotification
      Pwm_ForceOutputToZero
      Pwm_GetChannelState
      Pwm_GetOutputState
      Pwm_GetVersionInfo
      Pwm_Init
      Pwm_SetDutyCycle
      Pwm_SetOutputToIdle
      Pwm_SetPeriodAndDuty
    bsw internal behavior InternalBehavior_0
      10 x exclusive area:
        PWM_EXCLUSIVE_AREA_{00..09}
      11 x bsw called entity:
        Pwm_DeInit: implemented-entry=Pwm_DeInit
        Pwm_DisableNotification: implemented-entry=Pwm_DisableNotification
        Pwm_EnableNotification: implemented-entry=Pwm_EnableNotification
        Pwm_ForceOutputToZero: implemented-entry=Pwm_ForceOutputToZero
        Pwm_GetChannelState: implemented-entry=Pwm_GetChannelState
        Pwm_GetOutputState: implemented-entry=Pwm_GetOutputState
        Pwm_GetVersionInfo: implemented-entry=Pwm_GetVersionInfo
        Pwm_Init: can-enter-exclusive-area=[PWM_EXCLUSIVE_AREA_00, PWM_EXCLUSIVE_AREA_01, PWM_EXCLUSIVE_AREA_02, PWM_EXCLUSIVE_AREA_03, PWM_EXCLUSIVE_AREA_04, PWM_EXCLUSIVE_AREA_05, PWM_EXCLUSIVE_AREA_06, PWM_EXCLUSIVE_AREA_07, PWM_EXCLUSIVE_AREA_08, PWM_EXCLUSIVE_AREA_09], implemented-entry=Pwm_Init
        Pwm_SetDutyCycle: implemented-entry=Pwm_SetDutyCycle
        Pwm_SetOutputToIdle: implemented-entry=Pwm_SetOutputToIdle
        Pwm_SetPeriodAndDuty: implemented-entry=Pwm_SetPeriodAndDuty
package /AUTOSAR_Pwm/BswModuleEntrys
  11 x bsw module entry, all with is-synchronous=true, call-type=REGULAR, execution-context=UNSPECIFIED, sw-service-impl-policy=STANDARD:
    Pwm_DeInit: service-id=0x01, is-reentrant=false
    Pwm_DisableNotification: service-id=0x06, is-reentrant=true
    Pwm_EnableNotification: service-id=0x07, is-reentrant=true
    Pwm_ForceOutputToZero: service-id=0, is-reentrant=false
    Pwm_GetChannelState: service-id=0, is-reentrant=false
    Pwm_GetOutputState: service-id=0x05, is-reentrant=true
    Pwm_GetVersionInfo: service-id=0x08, is-reentrant=true
    Pwm_Init: service-id=0x00, is-reentrant=false
    Pwm_SetDutyCycle: service-id=0x02, is-reentrant=true
    Pwm_SetOutputToIdle: service-id=0x04, is-reentrant=true
    Pwm_SetPeriodAndDuty: service-id=0x03, is-reentrant=true
package /Pwm_T2D35M10I0R0/Implementations
  bsw implementation BswImplementation_0: programming-language=C, sw-version=1.0.0, vendor-id=43, ar-release-version=4.2.2, behavior=InternalBehavior_0, vendor-specific-module-def=Pwm
    code-descriptors:
      code Files
        artifact-descriptors:
          short-label=config::Pwm.xdm, category=SWCFG
          short-label=doc::AUTOSAR_MCAL_PWM_IM.pdf, category=SWDOC
          short-label=doc::AUTOSAR_MCAL_PWM_UM.pdf, category=SWDOC
          short-label=include::Pwm.h, category=SWHDR
          short-label=include::Pwm_eMios.h, category=SWHDR
          short-label=include::Pwm_eMios_Types.h, category=SWHDR
          short-label=include::Pwm_EnvCfg.h, category=SWHDR
          short-label=include::Pwm_Ipw.h, category=SWHDR
          short-label=include::Pwm_Ipw_Notif.h, category=SWHDR
          short-label=include::Pwm_Ipw_Types.h, category=SWHDR
          short-label=include::Pwm_Notif.h, category=SWHDR
          short-label=include::Pwm_Types.h, category=SWHDR
          short-label=src::Pwm.c, category=SWSRC
          short-label=src::Pwm_eMios.c, category=SWSRC
          short-label=src::Pwm_Ipw.c, category=SWSRC
    compiler DIAB_Compiler:
      name=Windriver Diab
      options=-tPPCE200Z4204N3VEN:simple -tPPCE200Z210N3VEN:simple -Xdialect-ansi -XO -g3 -Xsize-opt -Xsmall-data=0 -Xsmall-const=0 -Xaddr-sconst=0x11 -Xaddr-sdata=0x11 -Xno-common -Xnested-interrupts -Xdebug-dwarf2 -Xdebug-local-all -Xdebug-local-cie -Xdebug-struct-all -Xforce-declarations -ee1481 -Xmacro-undefined-warn -Xlink-time-lint -W:as:,-l -Wa,-Xisa-vle -DAUTOSAR_OS_NOT_USED -DUSE_SW_VECTOR_MODE -DDIAB -DDISABLE_MCAL_INTERMODULE_ASR_CHECK -c
      vendor=Windriver
      version=Windriver DIAB DIAB_5_9_6_2
    compiler GHS_Compiler:
      name=Green Hills
      options=-cpu=ppc5748gz4204 -cpu=ppc5748gz210 -ansi -noSPE -Ospace -sda=0 -vle -dual_debug -G --no_exceptions -Wundef -Wimplicit-int -Wshadow -Wtrigraphs --prototype_errors --incorrect_pragma_warnings -noslashcomment -preprocess_assembly_files -nostartfile --short_enum --diag_error 223 -DAUTOSAR_OS_NOT_USED -DUSE_SW_VECTOR_MODE -DDISABLE_MCAL_INTERMODULE_ASR_CHECK -DGHS -c
      vendor=Green Hills
      version=Green Hills Multi 7.1.4 / Compiler 2015.1.6
    generated-artifacts:
      dependency on artifact Pwm_PBcfg_c: artifact-descriptor={short-label=generate_PB::src::Pwm_PBcfg.c, category=SWSRC}, usages=COMPILE
      dependency on artifact Pwm_Cfg_h: artifact-descriptor={short-label=generate_PC::include::Pwm_Cfg.h, category=SWHDR}, usages=COMPILE
    linker DIAB_Linker: name=Windriver Diab, options=-tPPCE200Z4204N3VEN:simple -tPPCE200Z210N3VEN:simple -Xelf -m6 -Xlink-time-lint, vendor=Windriver, version=Windriver DIAB DIAB_5_9_6_2
    linker GHS_Linker: name=Green Hills, options=-cpu=ppc5748gz4204 -cpu=ppc5748gz210 -nostartfiles -vle --nocpp -Mn -delete -ignore_debug_references -keepmap, vendor=Green Hills, version=Green Hills Multi 7.1.4 / Compiler 2015.1.6
    resource consumption ResourceConsumption
      7 x memory section:
        PWM_CODE: alignment=UNSPECIFIED, sw-addrmethod=CODE, symbol=CODE
        PWM_CONFIG_DATA_UNSPECIFIED: alignment=UNSPECIFIED, sw-addrmethod=CONFIG_DATA_UNSPECIFIED, symbol=CONFIG_DATA_UNSPECIFIED
        PWM_VAR_INIT_UNSPECIFIED: alignment=UNSPECIFIED, sw-addrmethod=VAR_INIT_UNSPECIFIED, symbol=VAR_INIT_UNSPECIFIED
        PWM_VAR_NO_INIT_16: alignment=16, sw-addrmethod=VAR_NO_INIT_16, symbol=VAR_NO_INIT_16
        PWM_VAR_NO_INIT_32: alignment=32, sw-addrmethod=VAR_NO_INIT_32, symbol=VAR_NO_INIT_32
        PWM_VAR_NO_INIT_8: alignment=8, sw-addrmethod=VAR_NO_INIT_8, symbol=VAR_NO_INIT_8
        PWM_VAR_NO_INIT_UNSPECIFIED: alignment=UNSPECIFIED, sw-addrmethod=VAR_NO_INIT_UNSPECIFIED, symbol=VAR_NO_INIT_UNSPECIFIED
