AUTOSAR XML (schema 4-0-3)
package /AUTOSAR_Spi/BswModuleDescriptions
  bsw module description Spi: module-id=83
    provided-entrys:
      Spi_AsyncTransmit
      Spi_Cancel
      Spi_DeInit
      Spi_GetHWUnitStatus
      Spi_GetJobResult
      Spi_GetSequenceResult
      Spi_GetStatus
      Spi_GetVersionInfo
      Spi_Init
      Spi_ReadIB
      Spi_SetAsyncMode
      Spi_SetupEB
      Spi_SyncTransmit
      Spi_WriteIB
    bsw internal behavior InternalBehavior_0
      6 x exclusive area:
        SPI_EXCLUSIVE_AREA_{01..06}
      14 x bsw called entity:
        Spi_AsyncTransmit: implemented-entry=Spi_AsyncTransmit
        Spi_Cancel: implemented-entry=Spi_Cancel
        Spi_DeInit: implemented-entry=Spi_DeInit
        Spi_GetHWUnitStatus: implemented-entry=Spi_GetHWUnitStatus
        Spi_GetJobResult: implemented-entry=Spi_GetJobResult
        Spi_GetSequenceResult: implemented-entry=Spi_GetSequenceResult
        Spi_GetStatus: implemented-entry=Spi_GetStatus
        Spi_GetVersionInfo: implemented-entry=Spi_GetVersionInfo
        Spi_Init: can-enter-exclusive-area=[SPI_EXCLUSIVE_AREA_01, SPI_EXCLUSIVE_AREA_02, SPI_EXCLUSIVE_AREA_03, SPI_EXCLUSIVE_AREA_04, SPI_EXCLUSIVE_AREA_05, SPI_EXCLUSIVE_AREA_06], implemented-entry=Spi_Init
        Spi_ReadIB: implemented-entry=Spi_ReadIB
        Spi_SetAsyncMode: implemented-entry=Spi_SetAsyncMode
        Spi_SetupEB: implemented-entry=Spi_SetupEB
        Spi_SyncTransmit: implemented-entry=Spi_SyncTransmit
        Spi_WriteIB: implemented-entry=Spi_WriteIB
package /AUTOSAR_Spi/BswModuleEntrys
  14 x bsw module entry, all with call-type=REGULAR, execution-context=UNSPECIFIED, sw-service-impl-policy=STANDARD:
    Spi_AsyncTransmit: service-id=0x03, is-reentrant=true, is-synchronous=false
    Spi_Cancel: service-id=0x0c, is-reentrant=true, is-synchronous=false
    Spi_DeInit: service-id=0x01, is-reentrant=false, is-synchronous=true
    Spi_GetHWUnitStatus: service-id=0x0b, is-reentrant=true, is-synchronous=true
    Spi_GetJobResult: service-id=0x07, is-reentrant=true, is-synchronous=true
    Spi_GetSequenceResult: service-id=0x08, is-reentrant=true, is-synchronous=true
    Spi_GetStatus: service-id=0x06, is-reentrant=true, is-synchronous=true
    Spi_GetVersionInfo: service-id=0x09, is-reentrant=true, is-synchronous=true
    Spi_Init: service-id=0x00, is-reentrant=false, is-synchronous=true
    Spi_ReadIB: service-id=0x04, is-reentrant=true, is-synchronous=true
    Spi_SetAsyncMode: service-id=0x0d, is-reentrant=false, is-synchronous=true
    Spi_SetupEB: service-id=0x05, is-reentrant=true, is-synchronous=true
    Spi_SyncTransmit: service-id=0x0a, is-reentrant=true, is-synchronous=false
    Spi_WriteIB: service-id=0x02, is-reentrant=true, is-synchronous=true
package /Spi_T2D35M10I0R0/Implementations
  bsw implementation BswImplementation_0: programming-language=C, sw-version=1.0.0, vendor-id=43, ar-release-version=4.2.2, behavior=InternalBehavior_0, vendor-specific-module-def=Spi
    code-descriptors:
      code Files
        artifact-descriptors:
          short-label=config::Spi.xdm, category=SWCFG
          short-label=doc::AUTOSAR_MCAL_SPI_IM.pdf, category=SWDOC
          short-label=doc::AUTOSAR_MCAL_SPI_UM.pdf, category=SWDOC
          short-label=include::Reg_eSys_DSPI.h, category=SWHDR
          short-label=include::Spi.h, category=SWHDR
          short-label=include::Spi_DSPI.h, category=SWHDR
          short-label=include::Spi_IPW.h, category=SWHDR
          short-label=include::Spi_IPW_Types.h, category=SWHDR
          short-label=src::Spi.c, category=SWSRC
          short-label=src::Spi_DSPI.c, category=SWSRC
          short-label=src::Spi_Dspi_Irq.c, category=SWSRC
    compiler DIAB_Compiler:
      name=Windriver Diab
      options=-tPPCE200Z4204N3VEN:simple -tPPCE200Z210N3VEN:simple -Xdialect-ansi -XO -g3 -Xsize-opt -Xsmall-data=0 -Xsmall-const=0 -Xaddr-sconst=0x11 -Xaddr-sdata=0x11 -Xno-common -Xnested-interrupts -Xdebug-dwarf2 -Xdebug-local-all -Xdebug-local-cie -Xdebug-struct-all -Xforce-declarations -ee1481 -Xmacro-undefined-warn -Xlink-time-lint -W:as:,-l -Wa,-Xisa-vle -DAUTOSAR_OS_NOT_USED -DUSE_SW_VECTOR_MODE -DDIAB -DDISABLE_MCAL_INTERMODULE_ASR_CHECK -c
      vendor=Windriver
      version=Windriver DIAB DIAB_5_9_6_2
    compiler GHS_Compiler:
      name=Green Hills
      options=-cpu=ppc5748gz4204 -cpu=ppc5748gz210 -ansi -noSPE -Ospace -sda=0 -vle -dual_debug -G --no_exceptions -Wundef -Wimplicit-int -Wshadow -Wtrigraphs --prototype_errors --incorrect_pragma_warnings -noslashcomment -preprocess_assembly_files -nostartfile --short_enum --diag_error 223 -DAUTOSAR_OS_NOT_USED -DUSE_SW_VECTOR_MODE -DDISABLE_MCAL_INTERMODULE_ASR_CHECK -DGHS -c
      vendor=Green Hills
      version=Green Hills Multi 7.1.4 / Compiler 2015.1.6
    generated-artifacts:
      dependency on artifact Spi_PBcfg_c: artifact-descriptor={short-label=generate_PB::src::Spi_PBcfg.c, category=SWSRC}, usages=COMPILE
      dependency on artifact Spi_Cfg_h: artifact-descriptor={short-label=generate_PC::include::Spi_Cfg.h, category=SWHDR}, usages=COMPILE
      dependency on artifact Spi_Cfg_c: artifact-descriptor={short-label=generate_PC::src::Spi_Cfg.c, category=SWSRC}, usages=COMPILE
    linker DIAB_Linker: name=Windriver Diab, options=-tPPCE200Z4204N3VEN:simple -tPPCE200Z210N3VEN:simple -Xelf -m6 -Xlink-time-lint, vendor=Windriver, version=Windriver DIAB DIAB_5_9_6_2
    linker GHS_Linker: name=Green Hills, options=-cpu=ppc5748gz4204 -cpu=ppc5748gz210 -nostartfiles -vle --nocpp -Mn -delete -ignore_debug_references -keepmap, vendor=Green Hills, version=Green Hills Multi 7.1.4 / Compiler 2015.1.6
    resource consumption ResourceConsumption
      6 x memory section:
        SPI_CODE: alignment=UNSPECIFIED, sw-addrmethod=CODE, symbol=CODE
        SPI_CONFIG_DATA_UNSPECIFIED: alignment=UNSPECIFIED, sw-addrmethod=CONFIG_DATA_UNSPECIFIED, symbol=CONFIG_DATA_UNSPECIFIED
        SPI_CONST_32: alignment=32, sw-addrmethod=CONST_32, symbol=CONST_32
        SPI_VAR_INIT_UNSPECIFIED: alignment=UNSPECIFIED, sw-addrmethod=VAR_INIT_UNSPECIFIED, symbol=VAR_INIT_UNSPECIFIED
        SPI_VAR_NO_INIT_32: alignment=32, sw-addrmethod=VAR_NO_INIT_32, symbol=VAR_NO_INIT_32
        SPI_VAR_NO_INIT_UNSPECIFIED: alignment=UNSPECIFIED, sw-addrmethod=VAR_NO_INIT_UNSPECIFIED, symbol=VAR_NO_INIT_UNSPECIFIED
