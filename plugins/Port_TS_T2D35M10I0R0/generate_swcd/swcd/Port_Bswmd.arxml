AUTOSAR XML (schema 4-0-3)
package /AUTOSAR_Port/BswModuleDescriptions
  bsw module description Port: module-id=124
    provided-entrys:
      Port_GetVersionInfo
      Port_Init
      Port_Ipw_GetIndexForInoutEntry
      Port_Ipw_SetPinMode
      Port_RefreshPortDirection
      Port_SetPinDirection
      Port_SetPinMode
    bsw internal behavior InternalBehavior_0
      4 x exclusive area:
        PORT_EXCLUSIVE_AREA_{00..03}
      7 x bsw called entity:
        Port_GetVersionInfo: implemented-entry=Port_GetVersionInfo
        Port_Init: can-enter-exclusive-area=[PORT_EXCLUSIVE_AREA_00, PORT_EXCLUSIVE_AREA_01, PORT_EXCLUSIVE_AREA_02, PORT_EXCLUSIVE_AREA_03], implemented-entry=Port_Init
        Port_Ipw_GetIndexForInoutEntry: implemented-entry=Port_Ipw_GetIndexForInoutEntry
        Port_Ipw_SetPinMode: implemented-entry=Port_Ipw_SetPinMode
        Port_RefreshPortDirection: implemented-entry=Port_RefreshPortDirection
        Port_SetPinDirection: implemented-entry=Port_SetPinDirection
        Port_SetPinMode: implemented-entry=Port_SetPinMode
package /AUTOSAR_Port/BswModuleEntrys
  7 x bsw module entry, all with is-synchronous=true, call-type=REGULAR, execution-context=UNSPECIFIED, sw-service-impl-policy=STANDARD:
    Port_GetVersionInfo: service-id=0x03, is-reentrant=false
    Port_Init: service-id=0x00, is-reentrant=false
    Port_Ipw_GetIndexForInoutEntry: service-id=0, is-reentrant=false
    Port_Ipw_SetPinMode: service-id=0, is-reentrant=false
    Port_RefreshPortDirection: service-id=0x02, is-reentrant=false
    Port_SetPinDirection: service-id=0x01, is-reentrant=true
    Port_SetPinMode: service-id=0x04, is-reentrant=true
package /Port_T2D35M10I0R0/Implementations
  bsw implementation BswImplementation_0: programming-language=C, sw-version=1.0.0, vendor-id=43, ar-release-version=4.2.2, behavior=InternalBehavior_0, vendor-specific-module-def=Port
    code-descriptors:
      code Files
        artifact-descriptors:
          short-label=config::Port.xdm, category=SWCFG
          short-label=doc::AUTOSAR_MCAL_PORT_IM.pdf, category=SWDOC
          short-label=doc::AUTOSAR_MCAL_PORT_UM.pdf, category=SWDOC
          short-label=include::Port.h, category=SWHDR
          short-label=include::Port_EnvCfg.h, category=SWHDR
          short-label=include::Port_Ipw.h, category=SWHDR
          short-label=include::Port_Siul2.h, category=SWHDR
          short-label=include::Port_Siul2_Types.h, category=SWHDR
          short-label=include::Reg_eSys_Siul2.h, category=SWHDR
          short-label=include::Siul2_IpVersion.h, category=SWHDR
          short-label=src::Port.c, category=SWSRC
          short-label=src::Port_Ipw.c, category=SWSRC
          short-label=src::Port_Siul2.c, category=SWSRC
    compiler DIAB_Compiler:
      name=Windriver Diab
      options=-tPPCE200Z4204N3VEN:simple -tPPCE200Z210N3VEN:simple -Xdialect-ansi -XO -g3 -Xsize-opt -Xsmall-data=0 -Xsmall-const=0 -Xaddr-sconst=0x11 -Xaddr-sdata=0x11 -Xno-common -Xnested-interrupts -Xdebug-dwarf2 -Xdebug-local-all -Xdebug-local-cie -Xdebug-struct-all -Xforce-declarations -ee1481 -Xmacro-undefined-warn -Xlink-time-lint -W:as:,-l -Wa,-Xisa-vle -DAUTOSAR_OS_NOT_USED -DUSE_SW_VECTOR_MODE -DDIAB -DDISABLE_MCAL_INTERMODULE_ASR_CHECK -c
      vendor=Windriver
      version=Windriver DIAB DIAB_5_9_6_2
    compiler GHS_Compiler:
      name=Green Hills
      options=-cpu=ppc5748gz4204 -cpu=ppc5748gz210 -ansi -noSPE -Ospace -sda=0 -vle -dual_debug -G --no_exceptions -Wundef -Wimplicit-int -Wshadow -Wtrigraphs --prototype_errors --incorrect_pragma_warnings -noslashcomment -preprocess_assembly_files -nostartfile --short_enum --diag_error 223 -DAUTOSAR_OS_NOT_USED -DUSE_SW_VECTOR_MODE -DDISABLE_MCAL_INTERMODULE_ASR_CHECK -DGHS -c
      vendor=Green Hills
      version=Green Hills Multi 7.1.4 / Compiler 2015.1.6
    generated-artifacts:
      dependency on artifact Port_PBcfg_c: artifact-descriptor={short-label=generate_PB::src::Port_PBcfg.c, category=SWSRC}, usages=COMPILE
      dependency on artifact Port_Cfg_h: artifact-descriptor={short-label=generate_PC::include::Port_Cfg.h, category=SWHDR}, usages=COMPILE
      dependency on artifact Port_Cfg_c: artifact-descriptor={short-label=generate_PC::src::Port_Cfg.c, category=SWSRC}, usages=COMPILE
    linker DIAB_Linker: name=Windriver Diab, options=-tPPCE200Z4204N3VEN:simple -tPPCE200Z210N3VEN:simple -Xelf -m6 -Xlink-time-lint, vendor=Windriver, version=Windriver DIAB DIAB_5_9_6_2
    linker GHS_Linker: name=Green Hills, options=-cpu=ppc5748gz4204 -cpu=ppc5748gz210 -nostartfiles -vle --nocpp -Mn -delete -ignore_debug_references -keepmap, vendor=Green Hills, version=Green Hills Multi 7.1.4 / Compiler 2015.1.6
    resource consumption ResourceConsumption
      7 x memory section:
        PORT_CODE: alignment=UNSPECIFIED, sw-addrmethod=CODE, symbol=CODE
        PORT_CONFIG_DATA_16: alignment=16, sw-addrmethod=CONFIG_DATA_16, symbol=CONFIG_DATA_16
        PORT_CONFIG_DATA_UNSPECIFIED: alignment=UNSPECIFIED, sw-addrmethod=CONFIG_DATA_UNSPECIFIED, symbol=CONFIG_DATA_UNSPECIFIED
        PORT_CONST_16: alignment=16, sw-addrmethod=CONST_16, symbol=CONST_16
        PORT_CONST_UNSPECIFIED: alignment=UNSPECIFIED, sw-addrmethod=CONST_UNSPECIFIED, symbol=CONST_UNSPECIFIED
        PORT_VAR_INIT_UNSPECIFIED: alignment=UNSPECIFIED, sw-addrmethod=VAR_INIT_UNSPECIFIED, symbol=VAR_INIT_UNSPECIFIED
        PORT_VAR_NO_INIT_16: alignment=16, sw-addrmethod=VAR_NO_INIT_16, symbol=VAR_NO_INIT_16
