AUTOSAR XML (schema 4-0-3)
package /AUTOSAR_Wdg/BswModuleDescriptions
  bsw module description Wdg: module-id=102
    provided-entrys:
      Wdg_43_Instance0_GetVersionInfo
      Wdg_43_Instance0_Init
      Wdg_43_Instance0_SetMode
      Wdg_43_Instance0_SetTriggerCondition
      Wdg_43_Instance1_GetVersionInfo
      Wdg_43_Instance1_Init
      Wdg_43_Instance1_SetMode
      Wdg_43_Instance1_SetTriggerCondition
      Wdg_43_Instance2_GetVersionInfo
      Wdg_43_Instance2_Init
      Wdg_43_Instance2_SetMode
      Wdg_43_Instance2_SetTriggerCondition
      Wdg_Cbk_GptNotification
      Wdg_GetVersionInfo
      Wdg_Init
      Wdg_SetMode
      Wdg_SetTriggerCondition
      Wdg_Swt{0..4}_Isr
    bsw internal behavior InternalBehavior_0
      6 x exclusive area:
        WDG_EXCLUSIVE_AREA_{00..05}
      17 x bsw called entity:
        Wdg_43_Instance0_GetVersionInfo: implemented-entry=Wdg_43_Instance0_GetVersionInfo
        Wdg_43_Instance0_Init: implemented-entry=Wdg_43_Instance0_Init
        Wdg_43_Instance0_SetMode: implemented-entry=Wdg_43_Instance0_SetMode
        Wdg_43_Instance0_SetTriggerCondition: implemented-entry=Wdg_43_Instance0_SetTriggerCondition
        Wdg_43_Instance1_GetVersionInfo: implemented-entry=Wdg_43_Instance1_GetVersionInfo
        Wdg_43_Instance1_Init: implemented-entry=Wdg_43_Instance1_Init
        Wdg_43_Instance1_SetMode: implemented-entry=Wdg_43_Instance1_SetMode
        Wdg_43_Instance1_SetTriggerCondition: implemented-entry=Wdg_43_Instance1_SetTriggerCondition
        Wdg_43_Instance2_GetVersionInfo: implemented-entry=Wdg_43_Instance2_GetVersionInfo
        Wdg_43_Instance2_Init: implemented-entry=Wdg_43_Instance2_Init
        Wdg_43_Instance2_SetMode: implemented-entry=Wdg_43_Instance2_SetMode
        Wdg_43_Instance2_SetTriggerCondition: implemented-entry=Wdg_43_Instance2_SetTriggerCondition
        Wdg_Cbk_GptNotification: implemented-entry=Wdg_Cbk_GptNotification
        Wdg_GetVersionInfo: implemented-entry=Wdg_GetVersionInfo
        Wdg_Init: can-enter-exclusive-area=[WDG_EXCLUSIVE_AREA_00, WDG_EXCLUSIVE_AREA_01, WDG_EXCLUSIVE_AREA_02, WDG_EXCLUSIVE_AREA_03, WDG_EXCLUSIVE_AREA_04, WDG_EXCLUSIVE_AREA_05], implemented-entry=Wdg_Init
        Wdg_SetMode: implemented-entry=Wdg_SetMode
        Wdg_SetTriggerCondition: implemented-entry=Wdg_SetTriggerCondition
      5 x bsw interrupt entity, all with interrupt-category=CAT-2, interrupt-source=Hardware:
        Wdg_Swt{0..4}_Isr: implemented-entry=Wdg_Swt{0..4}_Isr
package /AUTOSAR_Wdg/BswModuleEntrys
  22 x bsw module entry, all with is-synchronous=true, sw-service-impl-policy=STANDARD:
    Wdg_43_Instance0_GetVersionInfo: service-id=0, is-reentrant=false, call-type=REGULAR, execution-context=UNSPECIFIED
    Wdg_43_Instance0_Init: service-id=0, is-reentrant=false, call-type=REGULAR, execution-context=UNSPECIFIED
    Wdg_43_Instance0_SetMode: service-id=0, is-reentrant=false, call-type=REGULAR, execution-context=UNSPECIFIED
    Wdg_43_Instance0_SetTriggerCondition: service-id=0, is-reentrant=false, call-type=REGULAR, execution-context=UNSPECIFIED
    Wdg_43_Instance1_GetVersionInfo: service-id=0, is-reentrant=false, call-type=REGULAR, execution-context=UNSPECIFIED
    Wdg_43_Instance1_Init: service-id=0, is-reentrant=false, call-type=REGULAR, execution-context=UNSPECIFIED
    Wdg_43_Instance1_SetMode: service-id=0, is-reentrant=false, call-type=REGULAR, execution-context=UNSPECIFIED
    Wdg_43_Instance1_SetTriggerCondition: service-id=0, is-reentrant=false, call-type=REGULAR, execution-context=UNSPECIFIED
    Wdg_43_Instance2_GetVersionInfo: service-id=0, is-reentrant=false, call-type=REGULAR, execution-context=UNSPECIFIED
    Wdg_43_Instance2_Init: service-id=0, is-reentrant=false, call-type=REGULAR, execution-context=UNSPECIFIED
    Wdg_43_Instance2_SetMode: service-id=0, is-reentrant=false, call-type=REGULAR, execution-context=UNSPECIFIED
    Wdg_43_Instance2_SetTriggerCondition: service-id=0, is-reentrant=false, call-type=REGULAR, execution-context=UNSPECIFIED
    Wdg_Cbk_GptNotification: service-id=0x05, is-reentrant=false, call-type=REGULAR, execution-context=UNSPECIFIED
    Wdg_GetVersionInfo: service-id=0x04, is-reentrant=true, call-type=REGULAR, execution-context=UNSPECIFIED
    Wdg_Init: service-id=0x00, is-reentrant=false, call-type=REGULAR, execution-context=UNSPECIFIED
    Wdg_SetMode: service-id=0x01, is-reentrant=false, call-type=REGULAR, execution-context=UNSPECIFIED
    Wdg_SetTriggerCondition: service-id=0x03, is-reentrant=false, call-type=REGULAR, execution-context=UNSPECIFIED
    Wdg_Swt{0..4}_Isr: service-id=0, is-reentrant=false, call-type=INTERRUPT, execution-context=INTERRUPT-CAT-2
package /Wdg_T2D35M10I0R0/Implementations
  bsw implementation BswImplementation_0: programming-language=C, sw-version=1.0.0, vendor-id=43, ar-release-version=4.2.2, behavior=InternalBehavior_0, vendor-specific-module-def=Wdg
    code-descriptors:
      code Files
        artifact-descriptors:
          short-label=config::Wdg.xdm, category=SWCFG
          short-label=doc::AUTOSAR_MCAL_WDG_IM.pdf, category=SWDOC
          short-label=doc::AUTOSAR_MCAL_WDG_UM.pdf, category=SWDOC
          short-label=include::Reg_eSys_Swt.h, category=SWHDR
          short-label=include::Reg_eSys_Swt_defines.h, category=SWHDR
          short-label=include::Wdg_43_Instance{0..2}.h, category=SWHDR
          short-label=include::Wdg_Channel.h, category=SWHDR
          short-label=include::Wdg_EnvCfg.h, category=SWHDR
          short-label=include::Wdg_IPW.h, category=SWHDR
          short-label=include::Wdg_IPW_Types.h, category=SWHDR
          short-label=include::Wdg_Irq.h, category=SWHDR
          short-label=include::Wdg_Swt.h, category=SWHDR
          short-label=include::Wdg_Swt_Types.h, category=SWHDR
          short-label=src::Wdg_43_Instance{0..2}.c, category=SWSRC
          short-label=src::Wdg_Channel.c, category=SWSRC
          short-label=src::Wdg_Swt.c, category=SWSRC
          short-label=src::Wdg_Swt_Isr.c, category=SWSRC
    compiler DIAB_Compiler:
      name=Windriver Diab
      options=-tPPCE200Z4204N3VEN:simple -tPPCE200Z210N3VEN:simple -Xdialect-ansi -XO -g3 -Xsize-opt -Xsmall-data=0 -Xsmall-const=0 -Xaddr-sconst=0x11 -Xaddr-sdata=0x11 -Xno-common -Xnested-interrupts -Xdebug-dwarf2 -Xdebug-local-all -Xdebug-local-cie -Xdebug-struct-all -Xforce-declarations -ee1481 -Xmacro-undefined-warn -Xlink-time-lint -W:as:,-l -Wa,-Xisa-vle -DAUTOSAR_OS_NOT_USED -DUSE_SW_VECTOR_MODE -DDIAB -DDISABLE_MCAL_INTERMODULE_ASR_CHECK -c
      vendor=Windriver
      version=Windriver DIAB DIAB_5_9_6_2
    compiler GHS_Compiler:
      name=Green Hills
      options=-cpu=ppc5748gz4204 -cpu=ppc5748gz210 -ansi -noSPE -Ospace -sda=0 -vle -dual_debug -G --no_exceptions -Wundef -Wimplicit-int -Wshadow -Wtrigraphs --prototype_errors --incorrect_pragma_warnings -noslashcomment -preprocess_assembly_files -nostartfile --short_enum --diag_error 223 -DAUTOSAR_OS_NOT_USED -DUSE_SW_VECTOR_MODE -DDISABLE_MCAL_INTERMODULE_ASR_CHECK -DGHS -c
      vendor=Green Hills
      version=Green Hills Multi 7.1.4 / Compiler 2015.1.6
    generated-artifacts:
      11 x dependency on artifact, all with usages=COMPILE:
        Wdg_Cfg_h: artifact-descriptor={short-label=generate::include::Wdg_Cfg.h, category=SWHDR}
        Wdg_CfgExt_c: artifact-descriptor={short-label=generate::src::Wdg_CfgExt.c, category=SWSRC}
        Wdg_43_Instance{0..2}_Lcfg_c: artifact-descriptor={short-label=generate_LT::src::Wdg_43_Instance{0..2}_Lcfg.c, category=SWSRC}
        Wdg_43_Instance{0..2}_PBcfg_c: artifact-descriptor={short-label=generate_PB::src::Wdg_43_Instance{0..2}_PBcfg.c, category=SWSRC}
        Wdg_43_Instance{0..2}_Cfg_c: artifact-descriptor={short-label=generate_PC::src::Wdg_43_Instance{0..2}_Cfg.c, category=SWSRC}
    linker DIAB_Linker: name=Windriver Diab, options=-tPPCE200Z4204N3VEN:simple -tPPCE200Z210N3VEN:simple -Xelf -m6 -Xlink-time-lint, vendor=Windriver, version=Windriver DIAB DIAB_5_9_6_2
    linker GHS_Linker: name=Green Hills, options=-cpu=ppc5748gz4204 -cpu=ppc5748gz210 -nostartfiles -vle --nocpp -Mn -delete -ignore_debug_references -keepmap, vendor=Green Hills, version=Green Hills Multi 7.1.4 / Compiler 2015.1.6
    resource consumption ResourceConsumption
      9 x memory section:
        WDG_CODE: alignment=UNSPECIFIED, sw-addrmethod=CODE, symbol=CODE
        WDG_CONFIG_DATA_UNSPECIFIED: alignment=UNSPECIFIED, sw-addrmethod=CONFIG_DATA_UNSPECIFIED, symbol=CONFIG_DATA_UNSPECIFIED
        WDG_CONST_32: alignment=32, sw-addrmethod=CONST_32, symbol=CONST_32
        WDG_CONST_8: alignment=8, sw-addrmethod=CONST_8, symbol=CONST_8
        WDG_CONST_UNSPECIFIED: alignment=UNSPECIFIED, sw-addrmethod=CONST_UNSPECIFIED, symbol=CONST_UNSPECIFIED
        WDG_RAMCODE: alignment=UNSPECIFIED, sw-addrmethod=RAMCODE, symbol=RAMCODE
        WDG_VAR_INIT_16: alignment=16, sw-addrmethod=VAR_INIT_16, symbol=VAR_INIT_16
        WDG_VAR_INIT_UNSPECIFIED: alignment=UNSPECIFIED, sw-addrmethod=VAR_INIT_UNSPECIFIED, symbol=VAR_INIT_UNSPECIFIED
        WDG_VAR_NO_INIT_UNSPECIFIED: alignment=UNSPECIFIED, sw-addrmethod=VAR_NO_INIT_UNSPECIFIED, symbol=VAR_NO_INIT_UNSPECIFIED
