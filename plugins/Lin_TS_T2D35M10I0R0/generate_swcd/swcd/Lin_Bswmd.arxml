AUTOSAR XML (schema 4-0-3)
package /AUTOSAR_Lin/BswModuleDescriptions
  bsw module description Lin: module-id=82
    provided-entrys:
      Lin_CheckWakeup
      Lin_GetStatus
      Lin_GetVersionInfo
      Lin_GoToSleep
      Lin_GoToSleepInternal
      Lin_Init
      Lin_SendFrame
      Lin_SetClockMode
      Lin_Wakeup
      Lin_WakeupInternal
      Lin_Linflex_Isr_LINFlex_0
      Lin_Linflex_Isr_LINFlex_1
      Lin_Linflex_Isr_LINFlex_{10..17}
      Lin_Linflex_Isr_LINFlex_{2..9}
      Lin_Linflex_IsrError_LINFlex_0
      Lin_Linflex_IsrError_LINFlex_1
      Lin_Linflex_IsrError_LINFlex_{10..17}
      Lin_Linflex_IsrError_LINFlex_{2..9}
      Lin_Linflex_IsrRx_LINFlex_0
      Lin_Linflex_IsrRx_LINFlex_1
      Lin_Linflex_IsrRx_LINFlex_{10..17}
      Lin_Linflex_IsrRx_LINFlex_{2..9}
      Lin_Linflex_IsrTx_LINFlex_0
      Lin_Linflex_IsrTx_LINFlex_1
      Lin_Linflex_IsrTx_LINFlex_{10..17}
      Lin_Linflex_IsrTx_LINFlex_{2..9}
    bsw internal behavior InternalBehavior_0
      22 x exclusive area:
        LIN_EXCLUSIVE_AREA_{00..21}
      10 x bsw called entity:
        Lin_CheckWakeup: implemented-entry=Lin_CheckWakeup
        Lin_GetStatus: implemented-entry=Lin_GetStatus
        Lin_GetVersionInfo: implemented-entry=Lin_GetVersionInfo
        Lin_GoToSleep: implemented-entry=Lin_GoToSleep
        Lin_GoToSleepInternal: implemented-entry=Lin_GoToSleepInternal
        Lin_Init: can-enter-exclusive-area=[LIN_EXCLUSIVE_AREA_00, LIN_EXCLUSIVE_AREA_01, LIN_EXCLUSIVE_AREA_02, LIN_EXCLUSIVE_AREA_03, LIN_EXCLUSIVE_AREA_04, LIN_EXCLUSIVE_AREA_05, LIN_EXCLUSIVE_AREA_06, LIN_EXCLUSIVE_AREA_07, LIN_EXCLUSIVE_AREA_08, LIN_EXCLUSIVE_AREA_09, LIN_EXCLUSIVE_AREA_10, LIN_EXCLUSIVE_AREA_11, LIN_EXCLUSIVE_AREA_12, LIN_EXCLUSIVE_AREA_13, LIN_EXCLUSIVE_AREA_14, LIN_EXCLUSIVE_AREA_15, LIN_EXCLUSIVE_AREA_16, LIN_EXCLUSIVE_AREA_17, LIN_EXCLUSIVE_AREA_18, LIN_EXCLUSIVE_AREA_19, LIN_EXCLUSIVE_AREA_20, LIN_EXCLUSIVE_AREA_21], implemented-entry=Lin_Init
        Lin_SendFrame: implemented-entry=Lin_SendFrame
        Lin_SetClockMode: implemented-entry=Lin_SetClockMode
        Lin_Wakeup: implemented-entry=Lin_Wakeup
        Lin_WakeupInternal: implemented-entry=Lin_WakeupInternal
      72 x bsw interrupt entity, all with interrupt-category=CAT-2, interrupt-source=Hardware:
        Lin_Linflex_Isr_LINFlex_0: implemented-entry=Lin_Linflex_Isr_LINFlex_0
        Lin_Linflex_Isr_LINFlex_1: implemented-entry=Lin_Linflex_Isr_LINFlex_1
        Lin_Linflex_Isr_LINFlex_{10..17}: implemented-entry=Lin_Linflex_Isr_LINFlex_{10..17}
        Lin_Linflex_Isr_LINFlex_{2..9}: implemented-entry=Lin_Linflex_Isr_LINFlex_{2..9}
        Lin_Linflex_IsrError_LINFlex_0: implemented-entry=Lin_Linflex_IsrError_LINFlex_0
        Lin_Linflex_IsrError_LINFlex_1: implemented-entry=Lin_Linflex_IsrError_LINFlex_1
        Lin_Linflex_IsrError_LINFlex_{10..17}: implemented-entry=Lin_Linflex_IsrError_LINFlex_{10..17}
        Lin_Linflex_IsrError_LINFlex_{2..9}: implemented-entry=Lin_Linflex_IsrError_LINFlex_{2..9}
        Lin_Linflex_IsrRx_LINFlex_0: implemented-entry=Lin_Linflex_IsrRx_LINFlex_0
        Lin_Linflex_IsrRx_LINFlex_1: implemented-entry=Lin_Linflex_IsrRx_LINFlex_1
        Lin_Linflex_IsrRx_LINFlex_{10..17}: implemented-entry=Lin_Linflex_IsrRx_LINFlex_{10..17}
        Lin_Linflex_IsrRx_LINFlex_{2..9}: implemented-entry=Lin_Linflex_IsrRx_LINFlex_{2..9}
        Lin_Linflex_IsrTx_LINFlex_0: implemented-entry=Lin_Linflex_IsrTx_LINFlex_0
        Lin_Linflex_IsrTx_LINFlex_1: implemented-entry=Lin_Linflex_IsrTx_LINFlex_1
        Lin_Linflex_IsrTx_LINFlex_{10..17}: implemented-entry=Lin_Linflex_IsrTx_LINFlex_{10..17}
        Lin_Linflex_IsrTx_LINFlex_{2..9}: implemented-entry=Lin_Linflex_IsrTx_LINFlex_{2..9}
package /AUTOSAR_Lin/BswModuleEntrys
  82 x bsw module entry, all with is-reentrant=false, sw-service-impl-policy=STANDARD:
    Lin_CheckWakeup: service-id=0x0a, is-synchronous=true, call-type=REGULAR, execution-context=UNSPECIFIED
    Lin_GetStatus: service-id=0x08, is-synchronous=true, call-type=REGULAR, execution-context=UNSPECIFIED
    Lin_GetVersionInfo: service-id=0x01, is-synchronous=true, call-type=REGULAR, execution-context=UNSPECIFIED
    Lin_GoToSleep: service-id=0, is-synchronous=true, call-type=REGULAR, execution-context=UNSPECIFIED
    Lin_GoToSleepInternal: service-id=0, is-synchronous=true, call-type=REGULAR, execution-context=UNSPECIFIED
    Lin_Init: service-id=0x00, is-synchronous=true, call-type=REGULAR, execution-context=UNSPECIFIED
    Lin_SendFrame: service-id=0x04, is-synchronous=false, call-type=REGULAR, execution-context=UNSPECIFIED
    Lin_SetClockMode: service-id=0, is-synchronous=true, call-type=REGULAR, execution-context=UNSPECIFIED
    Lin_Wakeup: service-id=0x07, is-synchronous=false, call-type=REGULAR, execution-context=UNSPECIFIED
    Lin_WakeupInternal: service-id=0, is-synchronous=true, call-type=REGULAR, execution-context=UNSPECIFIED
    Lin_Linflex_Isr_LINFlex_0: service-id=0, is-synchronous=true, call-type=INTERRUPT, execution-context=INTERRUPT-CAT-2
    Lin_Linflex_Isr_LINFlex_1: service-id=0, is-synchronous=true, call-type=INTERRUPT, execution-context=INTERRUPT-CAT-2
    Lin_Linflex_Isr_LINFlex_{10..17}: service-id=0, is-synchronous=true, call-type=INTERRUPT, execution-context=INTERRUPT-CAT-2
    Lin_Linflex_Isr_LINFlex_{2..9}: service-id=0, is-synchronous=true, call-type=INTERRUPT, execution-context=INTERRUPT-CAT-2
    Lin_Linflex_IsrError_LINFlex_0: service-id=0, is-synchronous=true, call-type=INTERRUPT, execution-context=INTERRUPT-CAT-2
    Lin_Linflex_IsrError_LINFlex_1: service-id=0, is-synchronous=true, call-type=INTERRUPT, execution-context=INTERRUPT-CAT-2
    Lin_Linflex_IsrError_LINFlex_{10..17}: service-id=0, is-synchronous=true, call-type=INTERRUPT, execution-context=INTERRUPT-CAT-2
    Lin_Linflex_IsrError_LINFlex_{2..9}: service-id=0, is-synchronous=true, call-type=INTERRUPT, execution-context=INTERRUPT-CAT-2
    Lin_Linflex_IsrRx_LINFlex_0: service-id=0, is-synchronous=true, call-type=INTERRUPT, execution-context=INTERRUPT-CAT-2
    Lin_Linflex_IsrRx_LINFlex_1: service-id=0, is-synchronous=true, call-type=INTERRUPT, execution-context=INTERRUPT-CAT-2
    Lin_Linflex_IsrRx_LINFlex_{10..17}: service-id=0, is-synchronous=true, call-type=INTERRUPT, execution-context=INTERRUPT-CAT-2
    Lin_Linflex_IsrRx_LINFlex_{2..9}: service-id=0, is-synchronous=true, call-type=INTERRUPT, execution-context=INTERRUPT-CAT-2
    Lin_Linflex_IsrTx_LINFlex_0: service-id=0, is-synchronous=true, call-type=INTERRUPT, execution-context=INTERRUPT-CAT-2
    Lin_Linflex_IsrTx_LINFlex_1: service-id=0, is-synchronous=true, call-type=INTERRUPT, execution-context=INTERRUPT-CAT-2
    Lin_Linflex_IsrTx_LINFlex_{10..17}: service-id=0, is-synchronous=true, call-type=INTERRUPT, execution-context=INTERRUPT-CAT-2
    Lin_Linflex_IsrTx_LINFlex_{2..9}: service-id=0, is-synchronous=true, call-type=INTERRUPT, execution-context=INTERRUPT-CAT-2
package /Lin_T2D35M10I0R0/Implementations
  bsw implementation BswImplementation_0: programming-language=C, sw-version=1.0.0, vendor-id=43, ar-release-version=4.2.2, behavior=InternalBehavior_0, vendor-specific-module-def=Lin
    code-descriptors:
      code Files
        artifact-descriptors:
          short-label=config::Lin.xdm, category=SWCFG
          short-label=doc::AUTOSAR_MCAL_LIN_IM.pdf, category=SWDOC
          short-label=doc::AUTOSAR_MCAL_LIN_UM.pdf, category=SWDOC
          short-label=include::Lin.h, category=SWHDR
          short-label=include::Lin_IPW.h, category=SWHDR
          short-label=include::Lin_LINFlex.h, category=SWHDR
          short-label=include::Lin_NonASR.h, category=SWHDR
          short-label=include::Reg_eSys_LINFlex.h, category=SWHDR
          short-label=src::Lin.c, category=SWSRC
          short-label=src::Lin_IPW.c, category=SWSRC
          short-label=src::Lin_LINFlex.c, category=SWSRC
          short-label=src::Lin_LINFlex_Irq.c, category=SWSRC
          short-label=src::Lin_NonASR.c, category=SWSRC
    compiler DIAB_Compiler:
      name=Windriver Diab
      options=-tPPCE200Z4204N3VEN:simple -tPPCE200Z210N3VEN:simple -Xdialect-ansi -XO -g3 -Xsize-opt -Xsmall-data=0 -Xsmall-const=0 -Xaddr-sconst=0x11 -Xaddr-sdata=0x11 -Xno-common -Xnested-interrupts -Xdebug-dwarf2 -Xdebug-local-all -Xdebug-local-cie -Xdebug-struct-all -Xforce-declarations -ee1481 -Xmacro-undefined-warn -Xlink-time-lint -W:as:,-l -Wa,-Xisa-vle -DAUTOSAR_OS_NOT_USED -DUSE_SW_VECTOR_MODE -DDIAB -DDISABLE_MCAL_INTERMODULE_ASR_CHECK -c
      vendor=Windriver
      version=Windriver DIAB DIAB_5_9_6_2
    compiler GHS_Compiler:
      name=Green Hills
      options=-cpu=ppc5748gz4204 -cpu=ppc5748gz210 -ansi -noSPE -Ospace -sda=0 -vle -dual_debug -G --no_exceptions -Wundef -Wimplicit-int -Wshadow -Wtrigraphs --prototype_errors --incorrect_pragma_warnings -noslashcomment -preprocess_assembly_files -nostartfile --short_enum --diag_error 223 -DAUTOSAR_OS_NOT_USED -DUSE_SW_VECTOR_MODE -DDISABLE_MCAL_INTERMODULE_ASR_CHECK -DGHS -c
      vendor=Green Hills
      version=Green Hills Multi 7.1.4 / Compiler 2015.1.6
    generated-artifacts:
      dependency on artifact Lin_PBcfg_c: artifact-descriptor={short-label=generate_PB::src::Lin_PBcfg.c, category=SWSRC}, usages=COMPILE
      dependency on artifact Lin_Cfg_h: artifact-descriptor={short-label=generate_PC::include::Lin_Cfg.h, category=SWHDR}, usages=COMPILE
      dependency on artifact Lin_Cfg_c: artifact-descriptor={short-label=generate_PC::src::Lin_Cfg.c, category=SWSRC}, usages=COMPILE
    linker DIAB_Linker: name=Windriver Diab, options=-tPPCE200Z4204N3VEN:simple -tPPCE200Z210N3VEN:simple -Xelf -m6 -Xlink-time-lint, vendor=Windriver, version=Windriver DIAB DIAB_5_9_6_2
    linker GHS_Linker: name=Green Hills, options=-cpu=ppc5748gz4204 -cpu=ppc5748gz210 -nostartfiles -vle --nocpp -Mn -delete -ignore_debug_references -keepmap, vendor=Green Hills, version=Green Hills Multi 7.1.4 / Compiler 2015.1.6
    resource consumption ResourceConsumption
      8 x memory section:
        LIN_CODE: alignment=UNSPECIFIED, sw-addrmethod=CODE, symbol=CODE
        LIN_CONFIG_DATA_UNSPECIFIED: alignment=UNSPECIFIED, sw-addrmethod=CONFIG_DATA_UNSPECIFIED, symbol=CONFIG_DATA_UNSPECIFIED
        LIN_CONST_32: alignment=32, sw-addrmethod=CONST_32, symbol=CONST_32
        LIN_CONST_UNSPECIFIED: alignment=UNSPECIFIED, sw-addrmethod=CONST_UNSPECIFIED, symbol=CONST_UNSPECIFIED
        LIN_VAR_INIT_8: alignment=8, sw-addrmethod=VAR_INIT_8, symbol=VAR_INIT_8
        LIN_VAR_INIT_UNSPECIFIED: alignment=UNSPECIFIED, sw-addrmethod=VAR_INIT_UNSPECIFIED, symbol=VAR_INIT_UNSPECIFIED
        LIN_VAR_NO_INIT_8: alignment=8, sw-addrmethod=VAR_NO_INIT_8, symbol=VAR_NO_INIT_8
        LIN_VAR_NO_INIT_UNSPECIFIED: alignment=UNSPECIFIED, sw-addrmethod=VAR_NO_INIT_UNSPECIFIED, symbol=VAR_NO_INIT_UNSPECIFIED
