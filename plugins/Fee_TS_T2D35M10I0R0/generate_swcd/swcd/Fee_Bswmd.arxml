AUTOSAR XML (schema 4-0-3)
package /AUTOSAR_Fee/BswModuleDescriptions
  bsw module description Fee: module-id=21
    provided-entrys:
      Fee_Cancel
      Fee_EraseImmediateBlock
      Fee_ForceSwapOnNextWrite
      Fee_GetJobResult
      Fee_GetRunTimeInfo
      Fee_GetStatus
      Fee_GetVersionInfo
      Fee_Init
      Fee_InvalidateBlock
      Fee_JobEndNotification
      Fee_JobErrorNotification
      Fee_MainFunction
      Fee_Read
      Fee_SetMode
      Fee_Write
    bsw internal behavior InternalBehavior_0
      4 x exclusive area:
        FEE_EXCLUSIVE_AREA_{00..03}
      15 x bsw called entity:
        Fee_Cancel: implemented-entry=Fee_Cancel
        Fee_EraseImmediateBlock: implemented-entry=Fee_EraseImmediateBlock
        Fee_ForceSwapOnNextWrite: implemented-entry=Fee_ForceSwapOnNextWrite
        Fee_GetJobResult: implemented-entry=Fee_GetJobResult
        Fee_GetRunTimeInfo: implemented-entry=Fee_GetRunTimeInfo
        Fee_GetStatus: implemented-entry=Fee_GetStatus
        Fee_GetVersionInfo: implemented-entry=Fee_GetVersionInfo
        Fee_Init: can-enter-exclusive-area=[FEE_EXCLUSIVE_AREA_00, FEE_EXCLUSIVE_AREA_01, FEE_EXCLUSIVE_AREA_02, FEE_EXCLUSIVE_AREA_03], implemented-entry=Fee_Init
        Fee_InvalidateBlock: implemented-entry=Fee_InvalidateBlock
        Fee_JobEndNotification: implemented-entry=Fee_JobEndNotification
        Fee_JobErrorNotification: implemented-entry=Fee_JobErrorNotification
        Fee_MainFunction: implemented-entry=Fee_MainFunction
        Fee_Read: implemented-entry=Fee_Read
        Fee_SetMode: implemented-entry=Fee_SetMode
        Fee_Write: implemented-entry=Fee_Write
      bsw timing event FeeTimingEvent_MainFunction: starts-on-event=Fee_MainFunction, period=FeeMainFunctionPeriod
package /AUTOSAR_Fee/BswModuleEntrys
  15 x bsw module entry, all with service-id=0, is-reentrant=false, is-synchronous=true, sw-service-impl-policy=STANDARD:
    Fee_Cancel: call-type=REGULAR, execution-context=UNSPECIFIED
    Fee_EraseImmediateBlock: call-type=REGULAR, execution-context=UNSPECIFIED
    Fee_ForceSwapOnNextWrite: call-type=REGULAR, execution-context=UNSPECIFIED
    Fee_GetJobResult: call-type=REGULAR, execution-context=UNSPECIFIED
    Fee_GetRunTimeInfo: call-type=REGULAR, execution-context=UNSPECIFIED
    Fee_GetStatus: call-type=REGULAR, execution-context=UNSPECIFIED
    Fee_GetVersionInfo: call-type=REGULAR, execution-context=UNSPECIFIED
    Fee_Init: call-type=REGULAR, execution-context=UNSPECIFIED
    Fee_InvalidateBlock: call-type=REGULAR, execution-context=UNSPECIFIED
    Fee_JobEndNotification: call-type=REGULAR, execution-context=UNSPECIFIED
    Fee_JobErrorNotification: call-type=REGULAR, execution-context=UNSPECIFIED
    Fee_MainFunction: call-type=SCHEDULED, execution-context=TASK
    Fee_Read: call-type=REGULAR, execution-context=UNSPECIFIED
    Fee_SetMode: call-type=REGULAR, execution-context=UNSPECIFIED
    Fee_Write: call-type=REGULAR, execution-context=UNSPECIFIED
package /Fee_T2D35M10I0R0/Implementations
  bsw implementation BswImplementation_0: programming-language=C, sw-version=1.0.0, vendor-id=43, ar-release-version=4.2.2, behavior=InternalBehavior_0, vendor-specific-module-def=Fee
    code-descriptors:
      code Files
        artifact-descriptors:
          short-label=config::Fee.xdm, category=SWCFG
          short-label=doc::AUTOSAR_MCAL_FEE_IM.pdf, category=SWDOC
          short-label=doc::AUTOSAR_MCAL_FEE_UM.pdf, category=SWDOC
          short-label=include::Fee.h, category=SWHDR
          short-label=include::Fee_Cbk.h, category=SWHDR
          short-label=include::Fee_InternalTypes.h, category=SWHDR
          short-label=include::Fee_Types.h, category=SWHDR
          short-label=include::Fee_Version.h, category=SWHDR
          short-label=src::Fee.c, category=SWSRC
    compiler DIAB_Compiler:
      name=Windriver Diab
      options=-tPPCE200Z4204N3VEN:simple -tPPCE200Z210N3VEN:simple -Xdialect-ansi -XO -g3 -Xsize-opt -Xsmall-data=0 -Xsmall-const=0 -Xaddr-sconst=0x11 -Xaddr-sdata=0x11 -Xno-common -Xnested-interrupts -Xdebug-dwarf2 -Xdebug-local-all -Xdebug-local-cie -Xdebug-struct-all -Xforce-declarations -ee1481 -Xmacro-undefined-warn -Xlink-time-lint -W:as:,-l -Wa,-Xisa-vle -DAUTOSAR_OS_NOT_USED -DUSE_SW_VECTOR_MODE -DDIAB -DDISABLE_MCAL_INTERMODULE_ASR_CHECK -c
      vendor=Windriver
      version=Windriver DIAB DIAB_5_9_6_2
    compiler GHS_Compiler:
      name=Green Hills
      options=-cpu=ppc5748gz4204 -cpu=ppc5748gz210 -ansi -noSPE -Ospace -sda=0 -vle -dual_debug -G --no_exceptions -Wundef -Wimplicit-int -Wshadow -Wtrigraphs --prototype_errors --incorrect_pragma_warnings -noslashcomment -preprocess_assembly_files -nostartfile --short_enum --diag_error 223 -DAUTOSAR_OS_NOT_USED -DUSE_SW_VECTOR_MODE -DDISABLE_MCAL_INTERMODULE_ASR_CHECK -DGHS -c
      vendor=Green Hills
      version=Green Hills Multi 7.1.4 / Compiler 2015.1.6
    generated-artifacts:
      dependency on artifact Fee_Cfg_h: artifact-descriptor={short-label=generate_PC::include::Fee_Cfg.h, category=SWHDR}, usages=COMPILE
      dependency on artifact Fee_Cfg_c: artifact-descriptor={short-label=generate_PC::src::Fee_Cfg.c, category=SWSRC}, usages=COMPILE
    linker DIAB_Linker: name=Windriver Diab, options=-tPPCE200Z4204N3VEN:simple -tPPCE200Z210N3VEN:simple -Xelf -m6 -Xlink-time-lint, vendor=Windriver, version=Windriver DIAB DIAB_5_9_6_2
    linker GHS_Linker: name=Green Hills, options=-cpu=ppc5748gz4204 -cpu=ppc5748gz210 -nostartfiles -vle --nocpp -Mn -delete -ignore_debug_references -keepmap, vendor=Green Hills, version=Green Hills Multi 7.1.4 / Compiler 2015.1.6
    resource consumption ResourceConsumption
      7 x memory section:
        FEE_CODE: alignment=UNSPECIFIED, sw-addrmethod=CODE, symbol=CODE
        FEE_CONST_UNSPECIFIED: alignment=UNSPECIFIED, sw-addrmethod=CONST_UNSPECIFIED, symbol=CONST_UNSPECIFIED
        FEE_VAR_INIT_16: alignment=16, sw-addrmethod=VAR_INIT_16, symbol=VAR_INIT_16
        FEE_VAR_INIT_32: alignment=32, sw-addrmethod=VAR_INIT_32, symbol=VAR_INIT_32
        FEE_VAR_INIT_8: alignment=8, sw-addrmethod=VAR_INIT_8, symbol=VAR_INIT_8
        FEE_VAR_INIT_UNSPECIFIED: alignment=UNSPECIFIED, sw-addrmethod=VAR_INIT_UNSPECIFIED, symbol=VAR_INIT_UNSPECIFIED
        FEE_VAR_NO_INIT_UNSPECIFIED: alignment=UNSPECIFIED, sw-addrmethod=VAR_NO_INIT_UNSPECIFIED, symbol=VAR_NO_INIT_UNSPECIFIED
