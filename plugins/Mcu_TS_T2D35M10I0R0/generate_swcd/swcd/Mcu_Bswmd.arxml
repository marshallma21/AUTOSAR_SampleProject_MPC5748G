AUTOSAR XML (schema 4-0-3)
package /AUTOSAR_Mcu/BswModuleDescriptions
  bsw module description Mcu: module-id=101
    provided-entrys:
      Mcu_DisableCmu
      Mcu_DistributePllClock
      Mcu_EmiosConfigureGpren
      Mcu_GetMidrStructure
      Mcu_GetPeripheralState
      Mcu_GetPllStatus
      Mcu_GetPowerDomainState
      Mcu_GetPowerModeState
      Mcu_GetRamState
      Mcu_GetResetRawValue
      Mcu_GetResetReason
      Mcu_GetSystemState
      Mcu_GetVersionInfo
      Mcu_Init
      Mcu_InitClock
      Mcu_InitRamSection
      Mcu_PerformReset
      Mcu_SetMode
      Mcu_SSCM_GetMemConfig
      Mcu_SSCM_GetStatus
      Mcu_SSCM_GetUops
      Mcu_SscmGetMemConfig
      Mcu_SscmGetStatus
      Mcu_SscmGetUops
      Mcu_Cmu_ClockFailIsr
      Mcu_Fxosc_ISR
      Mcu_LPU_InvalidMode_ISR
      Mcu_Mcv4_AlternateResetIsr
      Mcu_Mcv4_InvalidConfigurationIsr
      Mcu_Mcv4_InvalidModeIsr
      Mcu_Mcv4_ModeEnterSafeIsr
      Mcu_Mcv4_ModeTransitionCompleteIsr
      Mcu_Mcv4_TemperatureErrorIsr
      Mcu_Mcv4_VoltageErrorIsr
      Mcu_PllDig_Pll0_LossOfLockIsr
      Mcu_PllDig_Pll0_PowerDownCompleteIsr
      Mcu_PllDig_Pll1_LossOfLockIsr
      Mcu_PllDig_Pll1_PowerDownCompleteIsr
      Mcu_PllDig_Pll2_LossOfLockIsr
      Mcu_PllDig_Pll2_PowerDownCompleteIsr
      Mcu_PllDig_Pll3_LossOfLockIsr
      Mcu_PllDig_Pll3_PowerDownCompleteIsr
      Mcu_PllDig_Pll4_LossOfLockIsr
      Mcu_PllDig_Pll_LossOfLockIsr
      Mcu_Sxosc_ISR
    bsw internal behavior InternalBehavior_0
      exclusive area MCU_EXCLUSIVE_AREA_00
      exclusive area MCU_EXCLUSIVE_AREA_01
      24 x bsw called entity:
        Mcu_DisableCmu: implemented-entry=Mcu_DisableCmu
        Mcu_DistributePllClock: implemented-entry=Mcu_DistributePllClock
        Mcu_EmiosConfigureGpren: implemented-entry=Mcu_EmiosConfigureGpren
        Mcu_GetMidrStructure: implemented-entry=Mcu_GetMidrStructure
        Mcu_GetPeripheralState: implemented-entry=Mcu_GetPeripheralState
        Mcu_GetPllStatus: implemented-entry=Mcu_GetPllStatus
        Mcu_GetPowerDomainState: implemented-entry=Mcu_GetPowerDomainState
        Mcu_GetPowerModeState: implemented-entry=Mcu_GetPowerModeState
        Mcu_GetRamState: implemented-entry=Mcu_GetRamState
        Mcu_GetResetRawValue: implemented-entry=Mcu_GetResetRawValue
        Mcu_GetResetReason: implemented-entry=Mcu_GetResetReason
        Mcu_GetSystemState: implemented-entry=Mcu_GetSystemState
        Mcu_GetVersionInfo: implemented-entry=Mcu_GetVersionInfo
        Mcu_Init: can-enter-exclusive-area=[MCU_EXCLUSIVE_AREA_00, MCU_EXCLUSIVE_AREA_01], implemented-entry=Mcu_Init
        Mcu_InitClock: implemented-entry=Mcu_InitClock
        Mcu_InitRamSection: implemented-entry=Mcu_InitRamSection
        Mcu_PerformReset: implemented-entry=Mcu_PerformReset
        Mcu_SetMode: implemented-entry=Mcu_SetMode
        Mcu_SSCM_GetMemConfig: implemented-entry=Mcu_SSCM_GetMemConfig
        Mcu_SSCM_GetStatus: implemented-entry=Mcu_SSCM_GetStatus
        Mcu_SSCM_GetUops: implemented-entry=Mcu_SSCM_GetUops
        Mcu_SscmGetMemConfig: implemented-entry=Mcu_SscmGetMemConfig
        Mcu_SscmGetStatus: implemented-entry=Mcu_SscmGetStatus
        Mcu_SscmGetUops: implemented-entry=Mcu_SscmGetUops
      21 x bsw interrupt entity, all with interrupt-category=CAT-2, interrupt-source=Hardware:
        Mcu_Cmu_ClockFailIsr: implemented-entry=Mcu_Cmu_ClockFailIsr
        Mcu_Fxosc_ISR: implemented-entry=Mcu_Fxosc_ISR
        Mcu_LPU_InvalidMode_ISR: implemented-entry=Mcu_LPU_InvalidMode_ISR
        Mcu_Mcv4_AlternateResetIsr: implemented-entry=Mcu_Mcv4_AlternateResetIsr
        Mcu_Mcv4_InvalidConfigurationIsr: implemented-entry=Mcu_Mcv4_InvalidConfigurationIsr
        Mcu_Mcv4_InvalidModeIsr: implemented-entry=Mcu_Mcv4_InvalidModeIsr
        Mcu_Mcv4_ModeEnterSafeIsr: implemented-entry=Mcu_Mcv4_ModeEnterSafeIsr
        Mcu_Mcv4_ModeTransitionCompleteIsr: implemented-entry=Mcu_Mcv4_ModeTransitionCompleteIsr
        Mcu_Mcv4_TemperatureErrorIsr: implemented-entry=Mcu_Mcv4_TemperatureErrorIsr
        Mcu_Mcv4_VoltageErrorIsr: implemented-entry=Mcu_Mcv4_VoltageErrorIsr
        Mcu_PllDig_Pll0_LossOfLockIsr: implemented-entry=Mcu_PllDig_Pll0_LossOfLockIsr
        Mcu_PllDig_Pll0_PowerDownCompleteIsr: implemented-entry=Mcu_PllDig_Pll0_PowerDownCompleteIsr
        Mcu_PllDig_Pll1_LossOfLockIsr: implemented-entry=Mcu_PllDig_Pll1_LossOfLockIsr
        Mcu_PllDig_Pll1_PowerDownCompleteIsr: implemented-entry=Mcu_PllDig_Pll1_PowerDownCompleteIsr
        Mcu_PllDig_Pll2_LossOfLockIsr: implemented-entry=Mcu_PllDig_Pll2_LossOfLockIsr
        Mcu_PllDig_Pll2_PowerDownCompleteIsr: implemented-entry=Mcu_PllDig_Pll2_PowerDownCompleteIsr
        Mcu_PllDig_Pll3_LossOfLockIsr: implemented-entry=Mcu_PllDig_Pll3_LossOfLockIsr
        Mcu_PllDig_Pll3_PowerDownCompleteIsr: implemented-entry=Mcu_PllDig_Pll3_PowerDownCompleteIsr
        Mcu_PllDig_Pll4_LossOfLockIsr: implemented-entry=Mcu_PllDig_Pll4_LossOfLockIsr
        Mcu_PllDig_Pll_LossOfLockIsr: implemented-entry=Mcu_PllDig_Pll_LossOfLockIsr
        Mcu_Sxosc_ISR: implemented-entry=Mcu_Sxosc_ISR
package /AUTOSAR_Mcu/BswModuleEntrys
  45 x bsw module entry, all with is-synchronous=true, sw-service-impl-policy=STANDARD:
    Mcu_DisableCmu: service-id=0, is-reentrant=false, call-type=REGULAR, execution-context=UNSPECIFIED
    Mcu_DistributePllClock: service-id=0x03, is-reentrant=false, call-type=REGULAR, execution-context=UNSPECIFIED
    Mcu_EmiosConfigureGpren: service-id=0, is-reentrant=false, call-type=REGULAR, execution-context=UNSPECIFIED
    Mcu_GetMidrStructure: service-id=0, is-reentrant=false, call-type=REGULAR, execution-context=UNSPECIFIED
    Mcu_GetPeripheralState: service-id=0, is-reentrant=false, call-type=REGULAR, execution-context=UNSPECIFIED
    Mcu_GetPllStatus: service-id=0x04, is-reentrant=true, call-type=REGULAR, execution-context=UNSPECIFIED
    Mcu_GetPowerDomainState: service-id=0, is-reentrant=false, call-type=REGULAR, execution-context=UNSPECIFIED
    Mcu_GetPowerModeState: service-id=0, is-reentrant=false, call-type=REGULAR, execution-context=UNSPECIFIED
    Mcu_GetRamState: service-id=0x04, is-reentrant=true, call-type=REGULAR, execution-context=UNSPECIFIED
    Mcu_GetResetRawValue: service-id=0x06, is-reentrant=true, call-type=REGULAR, execution-context=UNSPECIFIED
    Mcu_GetResetReason: service-id=0x05, is-reentrant=true, call-type=REGULAR, execution-context=UNSPECIFIED
    Mcu_GetSystemState: service-id=0, is-reentrant=false, call-type=REGULAR, execution-context=UNSPECIFIED
    Mcu_GetVersionInfo: service-id=0x09, is-reentrant=true, call-type=REGULAR, execution-context=UNSPECIFIED
    Mcu_Init: service-id=0x00, is-reentrant=false, call-type=REGULAR, execution-context=UNSPECIFIED
    Mcu_InitClock: service-id=0x02, is-reentrant=false, call-type=REGULAR, execution-context=UNSPECIFIED
    Mcu_InitRamSection: service-id=0x01, is-reentrant=false, call-type=REGULAR, execution-context=UNSPECIFIED
    Mcu_PerformReset: service-id=0x07, is-reentrant=false, call-type=REGULAR, execution-context=UNSPECIFIED
    Mcu_SetMode: service-id=0x08, is-reentrant=false, call-type=REGULAR, execution-context=UNSPECIFIED
    Mcu_SSCM_GetMemConfig: service-id=0, is-reentrant=false, call-type=REGULAR, execution-context=UNSPECIFIED
    Mcu_SSCM_GetStatus: service-id=0, is-reentrant=false, call-type=REGULAR, execution-context=UNSPECIFIED
    Mcu_SSCM_GetUops: service-id=0, is-reentrant=false, call-type=REGULAR, execution-context=UNSPECIFIED
    Mcu_SscmGetMemConfig: service-id=0, is-reentrant=false, call-type=REGULAR, execution-context=UNSPECIFIED
    Mcu_SscmGetStatus: service-id=0, is-reentrant=false, call-type=REGULAR, execution-context=UNSPECIFIED
    Mcu_SscmGetUops: service-id=0, is-reentrant=false, call-type=REGULAR, execution-context=UNSPECIFIED
    Mcu_Cmu_ClockFailIsr: service-id=0, is-reentrant=false, call-type=INTERRUPT, execution-context=INTERRUPT-CAT-2
    Mcu_Fxosc_ISR: service-id=0, is-reentrant=false, call-type=INTERRUPT, execution-context=INTERRUPT-CAT-2
    Mcu_LPU_InvalidMode_ISR: service-id=0, is-reentrant=false, call-type=INTERRUPT, execution-context=INTERRUPT-CAT-2
    Mcu_Mcv4_AlternateResetIsr: service-id=0, is-reentrant=false, call-type=INTERRUPT, execution-context=INTERRUPT-CAT-2
    Mcu_Mcv4_InvalidConfigurationIsr: service-id=0, is-reentrant=false, call-type=INTERRUPT, execution-context=INTERRUPT-CAT-2
    Mcu_Mcv4_InvalidModeIsr: service-id=0, is-reentrant=false, call-type=INTERRUPT, execution-context=INTERRUPT-CAT-2
    Mcu_Mcv4_ModeEnterSafeIsr: service-id=0, is-reentrant=false, call-type=INTERRUPT, execution-context=INTERRUPT-CAT-2
    Mcu_Mcv4_ModeTransitionCompleteIsr: service-id=0, is-reentrant=false, call-type=INTERRUPT, execution-context=INTERRUPT-CAT-2
    Mcu_Mcv4_TemperatureErrorIsr: service-id=0, is-reentrant=false, call-type=INTERRUPT, execution-context=INTERRUPT-CAT-2
    Mcu_Mcv4_VoltageErrorIsr: service-id=0, is-reentrant=false, call-type=INTERRUPT, execution-context=INTERRUPT-CAT-2
    Mcu_PllDig_Pll0_LossOfLockIsr: service-id=0, is-reentrant=false, call-type=INTERRUPT, execution-context=INTERRUPT-CAT-2
    Mcu_PllDig_Pll0_PowerDownCompleteIsr: service-id=0, is-reentrant=false, call-type=INTERRUPT, execution-context=INTERRUPT-CAT-2
    Mcu_PllDig_Pll1_LossOfLockIsr: service-id=0, is-reentrant=false, call-type=INTERRUPT, execution-context=INTERRUPT-CAT-2
    Mcu_PllDig_Pll1_PowerDownCompleteIsr: service-id=0, is-reentrant=false, call-type=INTERRUPT, execution-context=INTERRUPT-CAT-2
    Mcu_PllDig_Pll2_LossOfLockIsr: service-id=0, is-reentrant=false, call-type=INTERRUPT, execution-context=INTERRUPT-CAT-2
    Mcu_PllDig_Pll2_PowerDownCompleteIsr: service-id=0, is-reentrant=false, call-type=INTERRUPT, execution-context=INTERRUPT-CAT-2
    Mcu_PllDig_Pll3_LossOfLockIsr: service-id=0, is-reentrant=false, call-type=INTERRUPT, execution-context=INTERRUPT-CAT-2
    Mcu_PllDig_Pll3_PowerDownCompleteIsr: service-id=0, is-reentrant=false, call-type=INTERRUPT, execution-context=INTERRUPT-CAT-2
    Mcu_PllDig_Pll4_LossOfLockIsr: service-id=0, is-reentrant=false, call-type=INTERRUPT, execution-context=INTERRUPT-CAT-2
    Mcu_PllDig_Pll_LossOfLockIsr: service-id=0, is-reentrant=false, call-type=INTERRUPT, execution-context=INTERRUPT-CAT-2
    Mcu_Sxosc_ISR: service-id=0, is-reentrant=false, call-type=INTERRUPT, execution-context=INTERRUPT-CAT-2
package /Mcu_T2D35M10I0R0/Implementations
  bsw implementation BswImplementation_0: programming-language=C, sw-version=1.0.0, vendor-id=43, ar-release-version=4.2.2, behavior=InternalBehavior_0, preconfigured-configuration=McuPreConfiguration, vendor-specific-module-def=Mcu
    code-descriptors:
      code Files
        artifact-descriptors:
          short-label=config::Mcu.xdm, category=SWCFG
          short-label=config_ext::McuPreConfiguration.xdm, category=SWCFG
          short-label=doc::AUTOSAR_MCAL_MCU_IM.pdf, category=SWDOC
          short-label=doc::AUTOSAR_MCAL_MCU_UM.pdf, category=SWDOC
          short-label=include::Mcu.h, category=SWHDR
          short-label=include::Mcu_CMU.h, category=SWHDR
          short-label=include::Mcu_CMU_Types.h, category=SWHDR
          short-label=include::Mcu_eMios.h, category=SWHDR
          short-label=include::Mcu_eMios_Types.h, category=SWHDR
          short-label=include::Mcu_EnvCfg.h, category=SWHDR
          short-label=include::Mcu_FIRC.h, category=SWHDR
          short-label=include::Mcu_FIRC_Types.h, category=SWHDR
          short-label=include::Mcu_FLASH.h, category=SWHDR
          short-label=include::Mcu_FLASH_IPVersion.h, category=SWHDR
          short-label=include::Mcu_FLASH_Types.h, category=SWHDR
          short-label=include::Mcu_FXOSC.h, category=SWHDR
          short-label=include::Mcu_FXOSC_IPVersion.h, category=SWHDR
          short-label=include::Mcu_FXOSC_Types.h, category=SWHDR
          short-label=include::Mcu_IPW.h, category=SWHDR
          short-label=include::Mcu_IPW_Irq.h, category=SWHDR
          short-label=include::Mcu_IPW_Types.h, category=SWHDR
          short-label=include::Mcu_LPU.h, category=SWHDR
          short-label=include::Mcu_LPU_Types.h, category=SWHDR
          short-label=include::Mcu_MC_CGM.h, category=SWHDR
          short-label=include::Mcu_MC_CGM_Types.h, category=SWHDR
          short-label=include::Mcu_MC_IPVersion.h, category=SWHDR
          short-label=include::Mcu_MC_ME.h, category=SWHDR
          short-label=include::Mcu_MC_ME_Types.h, category=SWHDR
          short-label=include::Mcu_MC_PCU.h, category=SWHDR
          short-label=include::Mcu_MC_PCU_Types.h, category=SWHDR
          short-label=include::Mcu_MC_RGM.h, category=SWHDR
          short-label=include::Mcu_MC_RGM_Types.h, category=SWHDR
          short-label=include::Mcu_PLLDIG.h, category=SWHDR
          short-label=include::Mcu_PLLDIG_IPVersion.h, category=SWHDR
          short-label=include::Mcu_PLLDIG_Types.h, category=SWHDR
          short-label=include::Mcu_PMCDIG.h, category=SWHDR
          short-label=include::Mcu_PMCDIG_IPVersion.h, category=SWHDR
          short-label=include::Mcu_PMCDIG_Types.h, category=SWHDR
          short-label=include::Mcu_PRAM.h, category=SWHDR
          short-label=include::Mcu_PRAM_IPVersion.h, category=SWHDR
          short-label=include::Mcu_PRAM_Types.h, category=SWHDR
          short-label=include::Mcu_Reg_eSys_eMios.h, category=SWHDR
          short-label=include::Mcu_Reg_eSys_FLASHC.h, category=SWHDR
          short-label=include::Mcu_Reg_eSys_SIUL2.h, category=SWHDR
          short-label=include::Mcu_SIRC.h, category=SWHDR
          short-label=include::Mcu_SIRC_Types.h, category=SWHDR
          short-label=include::Mcu_SIUL2.h, category=SWHDR
          short-label=include::Mcu_SIUL2_Types.h, category=SWHDR
          short-label=include::Mcu_SSCM.h, category=SWHDR
          short-label=include::Mcu_SSCM_IPVersion.h, category=SWHDR
          short-label=include::Mcu_SSCM_Types.h, category=SWHDR
          short-label=include::Mcu_STCU.h, category=SWHDR
          short-label=include::Mcu_STCU_IPVersion.h, category=SWHDR
          short-label=include::Mcu_STCU_Types.h, category=SWHDR
          short-label=include::Mcu_SXOSC.h, category=SWHDR
          short-label=include::Mcu_SXOSC_Types.h, category=SWHDR
          short-label=include::Reg_eSys_CMU.h, category=SWHDR
          short-label=include::Reg_eSys_FIRC.h, category=SWHDR
          short-label=include::Reg_eSys_FXOSC.h, category=SWHDR
          short-label=include::Reg_eSys_LPU.h, category=SWHDR
          short-label=include::Reg_eSys_MC_CGM.h, category=SWHDR
          short-label=include::Reg_eSys_MC_ME.h, category=SWHDR
          short-label=include::Reg_eSys_MC_PCU.h, category=SWHDR
          short-label=include::Reg_eSys_MC_RGM.h, category=SWHDR
          short-label=include::Reg_eSys_PLLDIG.h, category=SWHDR
          short-label=include::Reg_eSys_PMCDIG.h, category=SWHDR
          short-label=include::Reg_eSys_PRAM.h, category=SWHDR
          short-label=include::Reg_eSys_SIRC.h, category=SWHDR
          short-label=include::Reg_eSys_SSCM.h, category=SWHDR
          short-label=include::Reg_eSys_STCU.h, category=SWHDR
          short-label=include::Reg_eSys_SXOSC.h, category=SWHDR
          short-label=src::Mcu.c, category=SWSRC
          short-label=src::Mcu_CMU.c, category=SWSRC
          short-label=src::Mcu_CMU_Irq.c, category=SWSRC
          short-label=src::Mcu_eMios.c, category=SWSRC
          short-label=src::Mcu_FIRC.c, category=SWSRC
          short-label=src::Mcu_FLASH.c, category=SWSRC
          short-label=src::Mcu_FXOSC.c, category=SWSRC
          short-label=src::Mcu_FXOSC_Irq.c, category=SWSRC
          short-label=src::Mcu_IPW.c, category=SWSRC
          short-label=src::Mcu_LPU.c, category=SWSRC
          short-label=src::Mcu_LPU_Irq.c, category=SWSRC
          short-label=src::Mcu_MC_CGM.c, category=SWSRC
          short-label=src::Mcu_MC_Irq.c, category=SWSRC
          short-label=src::Mcu_MC_ME.c, category=SWSRC
          short-label=src::Mcu_MC_PCU.c, category=SWSRC
          short-label=src::Mcu_MC_RGM.c, category=SWSRC
          short-label=src::Mcu_PLLDIG.c, category=SWSRC
          short-label=src::Mcu_PLLDIG_Irq.c, category=SWSRC
          short-label=src::Mcu_PMCDIG.c, category=SWSRC
          short-label=src::Mcu_PRAM.c, category=SWSRC
          short-label=src::Mcu_SIRC.c, category=SWSRC
          short-label=src::Mcu_SIUL2.c, category=SWSRC
          short-label=src::Mcu_SSCM.c, category=SWSRC
          short-label=src::Mcu_STCU.c, category=SWSRC
          short-label=src::Mcu_SXOSC.c, category=SWSRC
          short-label=src::Mcu_SXOSC_Irq.c, category=SWSRC
    compiler DIAB_Compiler:
      name=Windriver Diab
      options=-tPPCE200Z4204N3VEN:simple -tPPCE200Z210N3VEN:simple -Xdialect-ansi -XO -g3 -Xsize-opt -Xsmall-data=0 -Xsmall-const=0 -Xaddr-sconst=0x11 -Xaddr-sdata=0x11 -Xno-common -Xnested-interrupts -Xdebug-dwarf2 -Xdebug-local-all -Xdebug-local-cie -Xdebug-struct-all -Xforce-declarations -ee1481 -Xmacro-undefined-warn -Xlink-time-lint -W:as:,-l -Wa,-Xisa-vle -DAUTOSAR_OS_NOT_USED -DUSE_SW_VECTOR_MODE -DDIAB -DDISABLE_MCAL_INTERMODULE_ASR_CHECK -c
      vendor=Windriver
      version=Windriver DIAB DIAB_5_9_6_2
    compiler GHS_Compiler:
      name=Green Hills
      options=-cpu=ppc5748gz4204 -cpu=ppc5748gz210 -ansi -noSPE -Ospace -sda=0 -vle -dual_debug -G --no_exceptions -Wundef -Wimplicit-int -Wshadow -Wtrigraphs --prototype_errors --incorrect_pragma_warnings -noslashcomment -preprocess_assembly_files -nostartfile --short_enum --diag_error 223 -DAUTOSAR_OS_NOT_USED -DUSE_SW_VECTOR_MODE -DDISABLE_MCAL_INTERMODULE_ASR_CHECK -DGHS -c
      vendor=Green Hills
      version=Green Hills Multi 7.1.4 / Compiler 2015.1.6
    generated-artifacts:
      dependency on artifact Mcu_PBcfg_c: artifact-descriptor={short-label=generate_PB::src::Mcu_PBcfg.c, category=SWSRC}, usages=COMPILE
      dependency on artifact Mcu_Cfg_h: artifact-descriptor={short-label=generate_PC::include::Mcu_Cfg.h, category=SWHDR}, usages=COMPILE
      dependency on artifact Mcu_Cfg_c: artifact-descriptor={short-label=generate_PC::src::Mcu_Cfg.c, category=SWSRC}, usages=COMPILE
    linker DIAB_Linker: name=Windriver Diab, options=-tPPCE200Z4204N3VEN:simple -tPPCE200Z210N3VEN:simple -Xelf -m6 -Xlink-time-lint, vendor=Windriver, version=Windriver DIAB DIAB_5_9_6_2
    linker GHS_Linker: name=Green Hills, options=-cpu=ppc5748gz4204 -cpu=ppc5748gz210 -nostartfiles -vle --nocpp -Mn -delete -ignore_debug_references -keepmap, vendor=Green Hills, version=Green Hills Multi 7.1.4 / Compiler 2015.1.6
    resource consumption ResourceConsumption
      8 x memory section:
        MCU_CODE: alignment=UNSPECIFIED, sw-addrmethod=CODE, symbol=CODE
        MCU_CONFIG_DATA_UNSPECIFIED: alignment=UNSPECIFIED, sw-addrmethod=CONFIG_DATA_UNSPECIFIED, symbol=CONFIG_DATA_UNSPECIFIED
        MCU_CONST_32: alignment=32, sw-addrmethod=CONST_32, symbol=CONST_32
        MCU_CONST_UNSPECIFIED: alignment=UNSPECIFIED, sw-addrmethod=CONST_UNSPECIFIED, symbol=CONST_UNSPECIFIED
        MCU_RAMCODE: alignment=UNSPECIFIED, sw-addrmethod=RAMCODE, symbol=RAMCODE
        MCU_VAR_INIT_32: alignment=32, sw-addrmethod=VAR_INIT_32, symbol=VAR_INIT_32
        MCU_VAR_INIT_UNSPECIFIED: alignment=UNSPECIFIED, sw-addrmethod=VAR_INIT_UNSPECIFIED, symbol=VAR_INIT_UNSPECIFIED
        MCU_VAR_NO_INIT_8: alignment=8, sw-addrmethod=VAR_NO_INIT_8, symbol=VAR_NO_INIT_8
