AUTOSAR XML (schema 4-0-3)
package /AUTOSAR_Adc/BswModuleDescriptions
  bsw module description Adc: module-id=123
    provided-entrys:
      Adc_Adcdig_DisableCtuControlMode
      Adc_Adcdig_DmaEndGroupConversion
      Adc_Adcdig_DmaEndHardwareConv
      Adc_Adcdig_DmaEndNormalConv
      Adc_Adcdig_EnableCtuControlMode
      Adc_Adcdig_EndGroupConversion
      Adc_Adcdig_EndHardwareConv
      Adc_Adcdig_EndMultipleCtuConv
      Adc_Adcdig_EndSoftwareConv
      Adc_Adcdig_EndWdgInterrupt
      Adc_Adcdig_SetPowerState
      Adc_Adcdig_WdgThresholdHandler
      Adc_Bctu_DeInit
      Adc_Bctu_Init
      Adc_Bctu_SetMode
      Adc_Bctu_SetupDma
      Adc_Bctu_StartCtu
      Adc_Bctu_StopCtu
      Adc_Calibrate
      Adc_ConfigureThreshold
      Adc_Ctu2TriggerHandlerCtrlRegsEnableDisable
      Adc_DeInit
      Adc_DisableChannel
      Adc_DisableCtuControlMode
      Adc_DisableCTUTrigger
      Adc_DisableGroupNotification
      Adc_DisableHardwareTrigger
      Adc_EnableChannel
      Adc_EnableCtuControlMode
      Adc_EnableCTUTrigger
      Adc_EnableGroupNotification
      Adc_EnableHardwareTrigger
      Adc_GetCurrentPowerState
      Adc_GetGroupStatus
      Adc_GetInjectedConversionStatus
      Adc_GetStreamLastPointer
      Adc_GetTargetPowerState
      Adc_GetVersionInfo
      Adc_HwResultReadGroup
      Adc_Init
      Adc_Main_PowerTransitionManager
      Adc_PreparePowerState
      Adc_ReadGroup
      Adc_SelfTest
      Adc_SetChannel
      Adc_SetClockMode
      Adc_SetCtu2CmdListHandlerCtrlRegs
      Adc_SetCtu2TriggerCompareRegs
      Adc_SetCtu2TriggerHandlerCtrlRegs
      Adc_SetMode
      Adc_SetPowerState
      Adc_SetupResultBuffer
      Adc_StartGroupConversion
      Adc_StopGroupConversion
      Adc_ValidateCallAndGroup
      Adc_ValidateCallAndUnit
      Adc_ValidateExtraParams
      Adc_ValidateGloballCall
      Adc_ValidatePtrInit
      Bctu0_AdcDmaEndConversion
      Bctu0_AdcEndConversion
      Bctu0_AdcEndCtuConversion
      Bctu0_AdcEndMultiCtuConv
      Adc_Adcdig_EndGroupConvUnit{0..3}
      Adc_Adcdig_WatchDogThresholdUnit{0..3}
      Bctu0_Adc{0..3}EndConvInterrupt
      Bctu0_AdcEndConvInterrupt
      Bctu0_AdcEndListConvInterrupt
    bsw internal behavior InternalBehavior_0
      29 x exclusive area:
        ADC_EXCLUSIVE_AREA_00
        ADC_EXCLUSIVE_AREA_01
        ADC_EXCLUSIVE_AREA_03
        ADC_EXCLUSIVE_AREA_{05..23}
        ADC_EXCLUSIVE_AREA_{25..31}
      63 x bsw called entity:
        Adc_Adcdig_DisableCtuControlMode: implemented-entry=Adc_Adcdig_DisableCtuControlMode
        Adc_Adcdig_DmaEndGroupConversion: implemented-entry=Adc_Adcdig_DmaEndGroupConversion
        Adc_Adcdig_DmaEndHardwareConv: implemented-entry=Adc_Adcdig_DmaEndHardwareConv
        Adc_Adcdig_DmaEndNormalConv: implemented-entry=Adc_Adcdig_DmaEndNormalConv
        Adc_Adcdig_EnableCtuControlMode: implemented-entry=Adc_Adcdig_EnableCtuControlMode
        Adc_Adcdig_EndGroupConversion: implemented-entry=Adc_Adcdig_EndGroupConversion
        Adc_Adcdig_EndHardwareConv: implemented-entry=Adc_Adcdig_EndHardwareConv
        Adc_Adcdig_EndMultipleCtuConv: implemented-entry=Adc_Adcdig_EndMultipleCtuConv
        Adc_Adcdig_EndSoftwareConv: implemented-entry=Adc_Adcdig_EndSoftwareConv
        Adc_Adcdig_EndWdgInterrupt: implemented-entry=Adc_Adcdig_EndWdgInterrupt
        Adc_Adcdig_SetPowerState: implemented-entry=Adc_Adcdig_SetPowerState
        Adc_Adcdig_WdgThresholdHandler: implemented-entry=Adc_Adcdig_WdgThresholdHandler
        Adc_Bctu_DeInit: implemented-entry=Adc_Bctu_DeInit
        Adc_Bctu_Init: implemented-entry=Adc_Bctu_Init
        Adc_Bctu_SetMode: implemented-entry=Adc_Bctu_SetMode
        Adc_Bctu_SetupDma: implemented-entry=Adc_Bctu_SetupDma
        Adc_Bctu_StartCtu: implemented-entry=Adc_Bctu_StartCtu
        Adc_Bctu_StopCtu: implemented-entry=Adc_Bctu_StopCtu
        Adc_Calibrate: implemented-entry=Adc_Calibrate
        Adc_ConfigureThreshold: implemented-entry=Adc_ConfigureThreshold
        Adc_Ctu2TriggerHandlerCtrlRegsEnableDisable: implemented-entry=Adc_Ctu2TriggerHandlerCtrlRegsEnableDisable
        Adc_DeInit: implemented-entry=Adc_DeInit
        Adc_DisableChannel: implemented-entry=Adc_DisableChannel
        Adc_DisableCtuControlMode: implemented-entry=Adc_DisableCtuControlMode
        Adc_DisableCTUTrigger: implemented-entry=Adc_DisableCTUTrigger
        Adc_DisableGroupNotification: implemented-entry=Adc_DisableGroupNotification
        Adc_DisableHardwareTrigger: implemented-entry=Adc_DisableHardwareTrigger
        Adc_EnableChannel: implemented-entry=Adc_EnableChannel
        Adc_EnableCtuControlMode: implemented-entry=Adc_EnableCtuControlMode
        Adc_EnableCTUTrigger: implemented-entry=Adc_EnableCTUTrigger
        Adc_EnableGroupNotification: implemented-entry=Adc_EnableGroupNotification
        Adc_EnableHardwareTrigger: implemented-entry=Adc_EnableHardwareTrigger
        Adc_GetCurrentPowerState: implemented-entry=Adc_GetCurrentPowerState
        Adc_GetGroupStatus: implemented-entry=Adc_GetGroupStatus
        Adc_GetInjectedConversionStatus: implemented-entry=Adc_GetInjectedConversionStatus
        Adc_GetStreamLastPointer: implemented-entry=Adc_GetStreamLastPointer
        Adc_GetTargetPowerState: implemented-entry=Adc_GetTargetPowerState
        Adc_GetVersionInfo: implemented-entry=Adc_GetVersionInfo
        Adc_HwResultReadGroup: implemented-entry=Adc_HwResultReadGroup
        Adc_Init: can-enter-exclusive-area=[ADC_EXCLUSIVE_AREA_00, ADC_EXCLUSIVE_AREA_01, ADC_EXCLUSIVE_AREA_03, ADC_EXCLUSIVE_AREA_05, ADC_EXCLUSIVE_AREA_06, ADC_EXCLUSIVE_AREA_07, ADC_EXCLUSIVE_AREA_08, ADC_EXCLUSIVE_AREA_09, ADC_EXCLUSIVE_AREA_10, ADC_EXCLUSIVE_AREA_11, ADC_EXCLUSIVE_AREA_12, ADC_EXCLUSIVE_AREA_13, ADC_EXCLUSIVE_AREA_14, ADC_EXCLUSIVE_AREA_15, ADC_EXCLUSIVE_AREA_16, ADC_EXCLUSIVE_AREA_17, ADC_EXCLUSIVE_AREA_18, ADC_EXCLUSIVE_AREA_19, ADC_EXCLUSIVE_AREA_20, ADC_EXCLUSIVE_AREA_21, ADC_EXCLUSIVE_AREA_22, ADC_EXCLUSIVE_AREA_23, ADC_EXCLUSIVE_AREA_25, ADC_EXCLUSIVE_AREA_26, ADC_EXCLUSIVE_AREA_27, ADC_EXCLUSIVE_AREA_28, ADC_EXCLUSIVE_AREA_29, ADC_EXCLUSIVE_AREA_30, ADC_EXCLUSIVE_AREA_31], implemented-entry=Adc_Init
        Adc_Main_PowerTransitionManager: implemented-entry=Adc_Main_PowerTransitionManager
        Adc_PreparePowerState: implemented-entry=Adc_PreparePowerState
        Adc_ReadGroup: implemented-entry=Adc_ReadGroup
        Adc_SelfTest: implemented-entry=Adc_SelfTest
        Adc_SetChannel: implemented-entry=Adc_SetChannel
        Adc_SetClockMode: implemented-entry=Adc_SetClockMode
        Adc_SetCtu2CmdListHandlerCtrlRegs: implemented-entry=Adc_SetCtu2CmdListHandlerCtrlRegs
        Adc_SetCtu2TriggerCompareRegs: implemented-entry=Adc_SetCtu2TriggerCompareRegs
        Adc_SetCtu2TriggerHandlerCtrlRegs: implemented-entry=Adc_SetCtu2TriggerHandlerCtrlRegs
        Adc_SetMode: implemented-entry=Adc_SetMode
        Adc_SetPowerState: implemented-entry=Adc_SetPowerState
        Adc_SetupResultBuffer: implemented-entry=Adc_SetupResultBuffer
        Adc_StartGroupConversion: implemented-entry=Adc_StartGroupConversion
        Adc_StopGroupConversion: implemented-entry=Adc_StopGroupConversion
        Adc_ValidateCallAndGroup: implemented-entry=Adc_ValidateCallAndGroup
        Adc_ValidateCallAndUnit: implemented-entry=Adc_ValidateCallAndUnit
        Adc_ValidateExtraParams: implemented-entry=Adc_ValidateExtraParams
        Adc_ValidateGloballCall: implemented-entry=Adc_ValidateGloballCall
        Adc_ValidatePtrInit: implemented-entry=Adc_ValidatePtrInit
        Bctu0_AdcDmaEndConversion: implemented-entry=Bctu0_AdcDmaEndConversion
        Bctu0_AdcEndConversion: implemented-entry=Bctu0_AdcEndConversion
        Bctu0_AdcEndCtuConversion: implemented-entry=Bctu0_AdcEndCtuConversion
        Bctu0_AdcEndMultiCtuConv: implemented-entry=Bctu0_AdcEndMultiCtuConv
      14 x bsw interrupt entity, all with interrupt-category=CAT-2, interrupt-source=Hardware:
        Adc_Adcdig_EndGroupConvUnit{0..3}: implemented-entry=Adc_Adcdig_EndGroupConvUnit{0..3}
        Adc_Adcdig_WatchDogThresholdUnit{0..3}: implemented-entry=Adc_Adcdig_WatchDogThresholdUnit{0..3}
        Bctu0_Adc{0..3}EndConvInterrupt: implemented-entry=Bctu0_Adc{0..3}EndConvInterrupt
        Bctu0_AdcEndConvInterrupt: implemented-entry=Bctu0_AdcEndConvInterrupt
        Bctu0_AdcEndListConvInterrupt: implemented-entry=Bctu0_AdcEndListConvInterrupt
package /AUTOSAR_Adc/BswModuleEntrys
  77 x bsw module entry, all with sw-service-impl-policy=STANDARD:
    Adc_Adcdig_DisableCtuControlMode: service-id=0, is-reentrant=false, is-synchronous=true, call-type=REGULAR, execution-context=UNSPECIFIED
    Adc_Adcdig_DmaEndGroupConversion: service-id=0, is-reentrant=false, is-synchronous=true, call-type=REGULAR, execution-context=UNSPECIFIED
    Adc_Adcdig_DmaEndHardwareConv: service-id=0, is-reentrant=false, is-synchronous=true, call-type=REGULAR, execution-context=UNSPECIFIED
    Adc_Adcdig_DmaEndNormalConv: service-id=0, is-reentrant=false, is-synchronous=true, call-type=REGULAR, execution-context=UNSPECIFIED
    Adc_Adcdig_EnableCtuControlMode: service-id=0, is-reentrant=false, is-synchronous=true, call-type=REGULAR, execution-context=UNSPECIFIED
    Adc_Adcdig_EndGroupConversion: service-id=0, is-reentrant=false, is-synchronous=true, call-type=REGULAR, execution-context=UNSPECIFIED
    Adc_Adcdig_EndHardwareConv: service-id=0, is-reentrant=false, is-synchronous=true, call-type=REGULAR, execution-context=UNSPECIFIED
    Adc_Adcdig_EndMultipleCtuConv: service-id=0, is-reentrant=false, is-synchronous=true, call-type=REGULAR, execution-context=UNSPECIFIED
    Adc_Adcdig_EndSoftwareConv: service-id=0, is-reentrant=false, is-synchronous=true, call-type=REGULAR, execution-context=UNSPECIFIED
    Adc_Adcdig_EndWdgInterrupt: service-id=0, is-reentrant=false, is-synchronous=true, call-type=REGULAR, execution-context=UNSPECIFIED
    Adc_Adcdig_SetPowerState: service-id=0, is-reentrant=false, is-synchronous=true, call-type=REGULAR, execution-context=UNSPECIFIED
    Adc_Adcdig_WdgThresholdHandler: service-id=0, is-reentrant=false, is-synchronous=true, call-type=REGULAR, execution-context=UNSPECIFIED
    Adc_Bctu_DeInit: service-id=0, is-reentrant=false, is-synchronous=true, call-type=REGULAR, execution-context=UNSPECIFIED
    Adc_Bctu_Init: service-id=0, is-reentrant=false, is-synchronous=true, call-type=REGULAR, execution-context=UNSPECIFIED
    Adc_Bctu_SetMode: service-id=0, is-reentrant=false, is-synchronous=true, call-type=REGULAR, execution-context=UNSPECIFIED
    Adc_Bctu_SetupDma: service-id=0, is-reentrant=false, is-synchronous=true, call-type=REGULAR, execution-context=UNSPECIFIED
    Adc_Bctu_StartCtu: service-id=0, is-reentrant=false, is-synchronous=true, call-type=REGULAR, execution-context=UNSPECIFIED
    Adc_Bctu_StopCtu: service-id=0, is-reentrant=false, is-synchronous=true, call-type=REGULAR, execution-context=UNSPECIFIED
    Adc_Calibrate: service-id=0, is-reentrant=false, is-synchronous=true, call-type=REGULAR, execution-context=UNSPECIFIED
    Adc_ConfigureThreshold: service-id=0, is-reentrant=false, is-synchronous=true, call-type=REGULAR, execution-context=UNSPECIFIED
    Adc_Ctu2TriggerHandlerCtrlRegsEnableDisable: service-id=0, is-reentrant=false, is-synchronous=true, call-type=REGULAR, execution-context=UNSPECIFIED
    Adc_DeInit: service-id=0x01, is-reentrant=false, is-synchronous=true, call-type=REGULAR, execution-context=UNSPECIFIED
    Adc_DisableChannel: service-id=0, is-reentrant=false, is-synchronous=true, call-type=REGULAR, execution-context=UNSPECIFIED
    Adc_DisableCtuControlMode: service-id=0, is-reentrant=false, is-synchronous=true, call-type=REGULAR, execution-context=UNSPECIFIED
    Adc_DisableCTUTrigger: service-id=0, is-reentrant=false, is-synchronous=true, call-type=REGULAR, execution-context=UNSPECIFIED
    Adc_DisableGroupNotification: service-id=0x08, is-reentrant=true, is-synchronous=true, call-type=REGULAR, execution-context=UNSPECIFIED
    Adc_DisableHardwareTrigger: service-id=0x06, is-reentrant=true, is-synchronous=true, call-type=REGULAR, execution-context=UNSPECIFIED
    Adc_EnableChannel: service-id=0, is-reentrant=false, is-synchronous=true, call-type=REGULAR, execution-context=UNSPECIFIED
    Adc_EnableCtuControlMode: service-id=0, is-reentrant=false, is-synchronous=true, call-type=REGULAR, execution-context=UNSPECIFIED
    Adc_EnableCTUTrigger: service-id=0, is-reentrant=false, is-synchronous=true, call-type=REGULAR, execution-context=UNSPECIFIED
    Adc_EnableGroupNotification: service-id=0x07, is-reentrant=true, is-synchronous=true, call-type=REGULAR, execution-context=UNSPECIFIED
    Adc_EnableHardwareTrigger: service-id=0x05, is-reentrant=true, is-synchronous=true, call-type=REGULAR, execution-context=UNSPECIFIED
    Adc_GetCurrentPowerState: service-id=0, is-reentrant=false, is-synchronous=true, call-type=REGULAR, execution-context=UNSPECIFIED
    Adc_GetGroupStatus: service-id=0x09, is-reentrant=true, is-synchronous=true, call-type=REGULAR, execution-context=UNSPECIFIED
    Adc_GetInjectedConversionStatus: service-id=0, is-reentrant=false, is-synchronous=true, call-type=REGULAR, execution-context=UNSPECIFIED
    Adc_GetStreamLastPointer: service-id=0x0b, is-reentrant=true, is-synchronous=true, call-type=REGULAR, execution-context=UNSPECIFIED
    Adc_GetTargetPowerState: service-id=0, is-reentrant=false, is-synchronous=true, call-type=REGULAR, execution-context=UNSPECIFIED
    Adc_GetVersionInfo: service-id=0x0a, is-reentrant=true, is-synchronous=true, call-type=REGULAR, execution-context=UNSPECIFIED
    Adc_HwResultReadGroup: service-id=0, is-reentrant=false, is-synchronous=true, call-type=REGULAR, execution-context=UNSPECIFIED
    Adc_Init: service-id=0x00, is-reentrant=false, is-synchronous=true, call-type=REGULAR, execution-context=UNSPECIFIED
    Adc_Main_PowerTransitionManager: service-id=0, is-reentrant=false, is-synchronous=true, call-type=REGULAR, execution-context=UNSPECIFIED
    Adc_PreparePowerState: service-id=0, is-reentrant=false, is-synchronous=true, call-type=REGULAR, execution-context=UNSPECIFIED
    Adc_ReadGroup: service-id=0x04, is-reentrant=true, is-synchronous=true, call-type=REGULAR, execution-context=UNSPECIFIED
    Adc_SelfTest: service-id=0, is-reentrant=false, is-synchronous=true, call-type=REGULAR, execution-context=UNSPECIFIED
    Adc_SetChannel: service-id=0, is-reentrant=false, is-synchronous=true, call-type=REGULAR, execution-context=UNSPECIFIED
    Adc_SetClockMode: service-id=0, is-reentrant=false, is-synchronous=true, call-type=REGULAR, execution-context=UNSPECIFIED
    Adc_SetCtu2CmdListHandlerCtrlRegs: service-id=0, is-reentrant=false, is-synchronous=true, call-type=REGULAR, execution-context=UNSPECIFIED
    Adc_SetCtu2TriggerCompareRegs: service-id=0, is-reentrant=false, is-synchronous=true, call-type=REGULAR, execution-context=UNSPECIFIED
    Adc_SetCtu2TriggerHandlerCtrlRegs: service-id=0, is-reentrant=false, is-synchronous=true, call-type=REGULAR, execution-context=UNSPECIFIED
    Adc_SetMode: service-id=0, is-reentrant=false, is-synchronous=true, call-type=REGULAR, execution-context=UNSPECIFIED
    Adc_SetPowerState: service-id=0, is-reentrant=false, is-synchronous=true, call-type=REGULAR, execution-context=UNSPECIFIED
    Adc_SetupResultBuffer: service-id=0x0c, is-reentrant=true, is-synchronous=true, call-type=REGULAR, execution-context=UNSPECIFIED
    Adc_StartGroupConversion: service-id=0x02, is-reentrant=true, is-synchronous=false, call-type=REGULAR, execution-context=UNSPECIFIED
    Adc_StopGroupConversion: service-id=0x03, is-reentrant=true, is-synchronous=true, call-type=REGULAR, execution-context=UNSPECIFIED
    Adc_ValidateCallAndGroup: service-id=0, is-reentrant=false, is-synchronous=true, call-type=REGULAR, execution-context=UNSPECIFIED
    Adc_ValidateCallAndUnit: service-id=0, is-reentrant=false, is-synchronous=true, call-type=REGULAR, execution-context=UNSPECIFIED
    Adc_ValidateExtraParams: service-id=0, is-reentrant=false, is-synchronous=true, call-type=REGULAR, execution-context=UNSPECIFIED
    Adc_ValidateGloballCall: service-id=0, is-reentrant=false, is-synchronous=true, call-type=REGULAR, execution-context=UNSPECIFIED
    Adc_ValidatePtrInit: service-id=0, is-reentrant=false, is-synchronous=true, call-type=REGULAR, execution-context=UNSPECIFIED
    Bctu0_AdcDmaEndConversion: service-id=0, is-reentrant=false, is-synchronous=true, call-type=REGULAR, execution-context=UNSPECIFIED
    Bctu0_AdcEndConversion: service-id=0, is-reentrant=false, is-synchronous=true, call-type=REGULAR, execution-context=UNSPECIFIED
    Bctu0_AdcEndCtuConversion: service-id=0, is-reentrant=false, is-synchronous=true, call-type=REGULAR, execution-context=UNSPECIFIED
    Bctu0_AdcEndMultiCtuConv: service-id=0, is-reentrant=false, is-synchronous=true, call-type=REGULAR, execution-context=UNSPECIFIED
    Adc_Adcdig_EndGroupConvUnit{0..3}: service-id=0, is-reentrant=false, is-synchronous=true, call-type=INTERRUPT, execution-context=INTERRUPT-CAT-2
    Adc_Adcdig_WatchDogThresholdUnit{0..3}: service-id=0, is-reentrant=false, is-synchronous=true, call-type=INTERRUPT, execution-context=INTERRUPT-CAT-2
    Bctu0_Adc{0..3}EndConvInterrupt: service-id=0, is-reentrant=false, is-synchronous=true, call-type=INTERRUPT, execution-context=INTERRUPT-CAT-2
    Bctu0_AdcEndConvInterrupt: service-id=0, is-reentrant=false, is-synchronous=true, call-type=INTERRUPT, execution-context=INTERRUPT-CAT-2
    Bctu0_AdcEndListConvInterrupt: service-id=0, is-reentrant=false, is-synchronous=true, call-type=INTERRUPT, execution-context=INTERRUPT-CAT-2
package /Adc_T2D35M10I0R0/Implementations
  bsw implementation BswImplementation_0: programming-language=C, sw-version=1.0.0, vendor-id=43, ar-release-version=4.2.2, behavior=InternalBehavior_0, vendor-specific-module-def=Adc
    code-descriptors:
      code Files
        artifact-descriptors:
          short-label=config::Adc.xdm, category=SWCFG
          short-label=doc::AUTOSAR_MCAL_ADC_IM.pdf, category=SWDOC
          short-label=doc::AUTOSAR_MCAL_ADC_UM.pdf, category=SWDOC
          short-label=include::Adc.h, category=SWHDR
          short-label=include::Adc_Adcdig.h, category=SWHDR
          short-label=include::Adc_Adcdig_CfgEx.h, category=SWHDR
          short-label=include::Adc_Adcdig_Irq.h, category=SWHDR
          short-label=include::Adc_Bctu.h, category=SWHDR
          short-label=include::Adc_EnvCfg.h, category=SWHDR
          short-label=include::Adc_Ipw.h, category=SWHDR
          short-label=include::Adc_Reg_eSys_Adcdig.h, category=SWHDR
          short-label=include::Adc_Reg_eSys_Bctu.h, category=SWHDR
          short-label=include::Adc_Types.h, category=SWHDR
          short-label=src::Adc.c, category=SWSRC
          short-label=src::Adc_Adcdig.c, category=SWSRC
          short-label=src::Adc_Adcdig_Irq.c, category=SWSRC
          short-label=src::Adc_Bctu.c, category=SWSRC
          short-label=src::Adc_Bctu_Irq.c, category=SWSRC
          short-label=src::Adc_Ipw.c, category=SWSRC
          short-label=src::Adc_Reg_eSys_Adcdig.c, category=SWSRC
    compiler DIAB_Compiler:
      name=Windriver Diab
      options=-tPPCE200Z4204N3VEN:simple -tPPCE200Z210N3VEN:simple -Xdialect-ansi -XO -g3 -Xsize-opt -Xsmall-data=0 -Xsmall-const=0 -Xaddr-sconst=0x11 -Xaddr-sdata=0x11 -Xno-common -Xnested-interrupts -Xdebug-dwarf2 -Xdebug-local-all -Xdebug-local-cie -Xdebug-struct-all -Xforce-declarations -ee1481 -Xmacro-undefined-warn -Xlink-time-lint -W:as:,-l -Wa,-Xisa-vle -DAUTOSAR_OS_NOT_USED -DUSE_SW_VECTOR_MODE -DDIAB -DDISABLE_MCAL_INTERMODULE_ASR_CHECK -c
      vendor=Windriver
      version=Windriver DIAB DIAB_5_9_6_2
    compiler GHS_Compiler:
      name=Green Hills
      options=-cpu=ppc5748gz4204 -cpu=ppc5748gz210 -ansi -noSPE -Ospace -sda=0 -vle -dual_debug -G --no_exceptions -Wundef -Wimplicit-int -Wshadow -Wtrigraphs --prototype_errors --incorrect_pragma_warnings -noslashcomment -preprocess_assembly_files -nostartfile --short_enum --diag_error 223 -DAUTOSAR_OS_NOT_USED -DUSE_SW_VECTOR_MODE -DDISABLE_MCAL_INTERMODULE_ASR_CHECK -DGHS -c
      vendor=Green Hills
      version=Green Hills Multi 7.1.4 / Compiler 2015.1.6
    generated-artifacts:
      4 x dependency on artifact, all with usages=COMPILE:
        Adc_PBcfg_c: artifact-descriptor={short-label=generate_PB::src::Adc_PBcfg.c, category=SWSRC}
        Adc_Cfg_h: artifact-descriptor={short-label=generate_PC::include::Adc_Cfg.h, category=SWHDR}
        Adc_CfgDefines_h: artifact-descriptor={short-label=generate_PC::include::Adc_CfgDefines.h, category=SWHDR}
        Adc_Cfg_c: artifact-descriptor={short-label=generate_PC::src::Adc_Cfg.c, category=SWSRC}
    linker DIAB_Linker: name=Windriver Diab, options=-tPPCE200Z4204N3VEN:simple -tPPCE200Z210N3VEN:simple -Xelf -m6 -Xlink-time-lint, vendor=Windriver, version=Windriver DIAB DIAB_5_9_6_2
    linker GHS_Linker: name=Green Hills, options=-cpu=ppc5748gz4204 -cpu=ppc5748gz210 -nostartfiles -vle --nocpp -Mn -delete -ignore_debug_references -keepmap, vendor=Green Hills, version=Green Hills Multi 7.1.4 / Compiler 2015.1.6
    resource consumption ResourceConsumption
      14 x memory section:
        ADC_CODE: alignment=UNSPECIFIED, sw-addrmethod=CODE, symbol=CODE
        ADC_CONFIG_DATA_UNSPECIFIED: alignment=UNSPECIFIED, sw-addrmethod=CONFIG_DATA_UNSPECIFIED, symbol=CONFIG_DATA_UNSPECIFIED
        ADC_CONST_32: alignment=32, sw-addrmethod=CONST_32, symbol=CONST_32
        ADC_CONST_8: alignment=8, sw-addrmethod=CONST_8, symbol=CONST_8
        ADC_CONST_UNSPECIFIED: alignment=UNSPECIFIED, sw-addrmethod=CONST_UNSPECIFIED, symbol=CONST_UNSPECIFIED
        ADC_VAR_INIT_16: alignment=16, sw-addrmethod=VAR_INIT_16, symbol=VAR_INIT_16
        ADC_VAR_INIT_8: alignment=8, sw-addrmethod=VAR_INIT_8, symbol=VAR_INIT_8
        ADC_VAR_INIT_BOOLEAN: alignment=BOOLEAN, sw-addrmethod=VAR_INIT_BOOLEAN, symbol=VAR_INIT_BOOLEAN
        ADC_VAR_INIT_UNSPECIFIED: alignment=UNSPECIFIED, sw-addrmethod=VAR_INIT_UNSPECIFIED, symbol=VAR_INIT_UNSPECIFIED
        ADC_VAR_INIT_UNSPECIFIED_NO_CACHEABLE: alignment=UNSPECIFIED, sw-addrmethod=VAR_INIT_UNSPECIFIED_NO_CACHEABLE, symbol=VAR_INIT_UNSPECIFIED_NO_CACHEABLE
        ADC_VAR_NO_INIT_32_NO_CACHEABLE: alignment=32, sw-addrmethod=VAR_NO_INIT_32_NO_CACHEABLE, symbol=VAR_NO_INIT_32_NO_CACHEABLE
        ADC_VAR_NO_INIT_8: alignment=8, sw-addrmethod=VAR_NO_INIT_8, symbol=VAR_NO_INIT_8
        ADC_VAR_NO_INIT_UNSPECIFIED: alignment=UNSPECIFIED, sw-addrmethod=VAR_NO_INIT_UNSPECIFIED, symbol=VAR_NO_INIT_UNSPECIFIED
        ADC_VAR_NO_INIT_UNSPECIFIED_NO_CACHEABLE: alignment=UNSPECIFIED, sw-addrmethod=VAR_NO_INIT_UNSPECIFIED_NO_CACHEABLE, symbol=VAR_NO_INIT_UNSPECIFIED_NO_CACHEABLE
