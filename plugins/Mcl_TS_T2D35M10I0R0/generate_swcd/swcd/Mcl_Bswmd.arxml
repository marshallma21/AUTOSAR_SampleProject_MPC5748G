AUTOSAR XML (schema 4-0-3)
package /AUTOSAR_Mcl/BswModuleDescriptions
  bsw module description Mcl: module-id=255
    provided-entrys:
      Mcl_DmaAcknowledgeInterrupt
      Mcl_DmaConfigChannel
      Mcl_DmaConfigLinkedChannel
      Mcl_DmaConfigLinkedTcd
      Mcl_DmaConfigScatterGatherChannel
      Mcl_DmaConfigScatterGatherLinkedChannel
      Mcl_DmaConfigScatterGatherLinkedTcd
      Mcl_DmaConfigScatterGatherTcd
      Mcl_DmaConfigTcd
      Mcl_DmaDisableHwRequest
      Mcl_DmaDisableNotification
      Mcl_DmaEnableHwRequest
      Mcl_DmaEnableNotification
      Mcl_DmaGetChannelErrorStatus
      Mcl_DmaGetChannelTcdAddress
      Mcl_DmaGetCrtIterCount
      Mcl_DmaGetGlobalErrorStatus
      Mcl_DmaGetInterruptRequest
      Mcl_DmaGetPhysicalChannel
      Mcl_DmaGetStartIterCount
      Mcl_DmaIsTransferActive
      Mcl_DmaIsTransferCompleted
      Mcl_DmaProcessCombinedInterrupt
      Mcl_DmaProcessErrorInterrupt
      Mcl_DmaProcessInterrupt
      Mcl_DmaSetChannelPriority
      Mcl_DmaStartChannel
      Mcl_DmaTcdClearDone
      Mcl_DmaTcdClearIntMaj
      Mcl_DmaTcdGetDaddr
      Mcl_DmaTcdGetFlags
      Mcl_DmaTcdGetIntMaj
      Mcl_DmaTcdGetIterCount
      Mcl_DmaTcdGetSaddr
      Mcl_DmaTcdSetDaddr
      Mcl_DmaTcdSetDlast
      Mcl_DmaTcdSetDModuloAndSize
      Mcl_DmaTcdSetDoff
      Mcl_DmaTcdSetFlags
      Mcl_DmaTcdSetIntMaj
      Mcl_DmaTcdSetIterCount
      Mcl_DmaTcdSetLinkAndIterCount
      Mcl_DmaTcdSetMinorLoop
      Mcl_DmaTcdSetSaddr
      Mcl_DmaTcdSetSga
      Mcl_DmaTcdSetSlast
      Mcl_DmaTcdSetSModuloAndSize
      Mcl_DmaTcdSetSoff
      Mcl_DmaUpdateDestAddress
      Mcl_DmaUpdateIterCount
      Mcl_GetVersionInfo
      Mcl_Init
      Mcl_IPW_DmaClearDone
      Mcl_IPW_DmaClearIntMaj
      Mcl_IPW_DmaDisableHwRequest
      Mcl_IPW_DmaEnableHwRequest
      Mcl_IPW_DmaGetChannelErrorStatus
      Mcl_IPW_DmaGetChannelTcdAddress
      Mcl_IPW_DmaGetChBiter
      Mcl_IPW_DmaGetChCiter
      Mcl_IPW_DmaGetCiter
      Mcl_IPW_DmaGetDaddr
      Mcl_IPW_DmaGetFlags
      Mcl_IPW_DmaGetGlobalErrorStatus
      Mcl_IPW_DmaGetInterruptRequest
      Mcl_IPW_DmaGetSaddr
      Mcl_IPW_DmaSetBiter
      Mcl_IPW_DmaSetCiter
      Mcl_IPW_DmaSetDaddr
      Mcl_IPW_DmaSetDlast
      Mcl_IPW_DmaSetDModSize
      Mcl_IPW_DmaSetDoff
      Mcl_IPW_DmaSetFlags
      Mcl_IPW_DmaSetIntMaj
      Mcl_IPW_DmaSetLinkAndIterCount
      Mcl_IPW_DmaSetMlnoNBytes
      Mcl_IPW_DmaSetMloffen
      Mcl_IPW_DmaSetSaddr
      Mcl_IPW_DmaSetSga
      Mcl_IPW_DmaSetSlast
      Mcl_IPW_DmaSetSModSize
      Mcl_IPW_DmaSetSoff
      Mcl_IPW_DmaTcdGetIntMaj
      Mcl_IPW_DmaUpdateDestAddress
      Mcl_ValidateChannelConfigCall
      Mcl_ValidateParamNotification
      MCL_DMA0_CH_COMPLETE_ISR
      MCL_DMA0_ERROR_ISR
      MCL_DMA1_CH_COMPLETE_ISR
      MCL_DMA1_ERROR_ISR
      MCL_DMA_CH_0_ISR
      MCL_DMA_CH_{100..109}_ISR
      MCL_DMA_CH_10_ISR
      MCL_DMA_CH_{110..119}_ISR
      MCL_DMA_CH_11_ISR
      MCL_DMA_CH_{120..127}_ISR
      MCL_DMA_CH_{12..19}_ISR
      MCL_DMA_CH_1_ISR
      MCL_DMA_CH_{20..29}_ISR
      MCL_DMA_CH_2_ISR
      MCL_DMA_CH_{30..39}_ISR
      MCL_DMA_CH_3_ISR
      MCL_DMA_CH_{40..49}_ISR
      MCL_DMA_CH_4_ISR
      MCL_DMA_CH_{50..59}_ISR
      MCL_DMA_CH_5_ISR
      MCL_DMA_CH_{60..69}_ISR
      MCL_DMA_CH_6_ISR
      MCL_DMA_CH_{70..79}_ISR
      MCL_DMA_CH_7_ISR
      MCL_DMA_CH_{80..89}_ISR
      MCL_DMA_CH_8_ISR
      MCL_DMA_CH_{90..99}_ISR
      MCL_DMA_CH_9_ISR
      MCL_DMA_CH_MIXED_96_127_COMPLETE_ISR
      MCL_DMA_ERROR_ISR
    bsw internal behavior InternalBehavior_0
      22 x exclusive area:
        MCL_EXCLUSIVE_AREA_00
        MCL_EXCLUSIVE_AREA_01
        MCL_EXCLUSIVE_AREA_{12..31}
      86 x bsw called entity:
        Mcl_DmaAcknowledgeInterrupt: implemented-entry=Mcl_DmaAcknowledgeInterrupt
        Mcl_DmaConfigChannel: implemented-entry=Mcl_DmaConfigChannel
        Mcl_DmaConfigLinkedChannel: implemented-entry=Mcl_DmaConfigLinkedChannel
        Mcl_DmaConfigLinkedTcd: implemented-entry=Mcl_DmaConfigLinkedTcd
        Mcl_DmaConfigScatterGatherChannel: implemented-entry=Mcl_DmaConfigScatterGatherChannel
        Mcl_DmaConfigScatterGatherLinkedChannel: implemented-entry=Mcl_DmaConfigScatterGatherLinkedChannel
        Mcl_DmaConfigScatterGatherLinkedTcd: implemented-entry=Mcl_DmaConfigScatterGatherLinkedTcd
        Mcl_DmaConfigScatterGatherTcd: implemented-entry=Mcl_DmaConfigScatterGatherTcd
        Mcl_DmaConfigTcd: implemented-entry=Mcl_DmaConfigTcd
        Mcl_DmaDisableHwRequest: implemented-entry=Mcl_DmaDisableHwRequest
        Mcl_DmaDisableNotification: implemented-entry=Mcl_DmaDisableNotification
        Mcl_DmaEnableHwRequest: implemented-entry=Mcl_DmaEnableHwRequest
        Mcl_DmaEnableNotification: implemented-entry=Mcl_DmaEnableNotification
        Mcl_DmaGetChannelErrorStatus: implemented-entry=Mcl_DmaGetChannelErrorStatus
        Mcl_DmaGetChannelTcdAddress: implemented-entry=Mcl_DmaGetChannelTcdAddress
        Mcl_DmaGetCrtIterCount: implemented-entry=Mcl_DmaGetCrtIterCount
        Mcl_DmaGetGlobalErrorStatus: implemented-entry=Mcl_DmaGetGlobalErrorStatus
        Mcl_DmaGetInterruptRequest: implemented-entry=Mcl_DmaGetInterruptRequest
        Mcl_DmaGetPhysicalChannel: implemented-entry=Mcl_DmaGetPhysicalChannel
        Mcl_DmaGetStartIterCount: implemented-entry=Mcl_DmaGetStartIterCount
        Mcl_DmaIsTransferActive: implemented-entry=Mcl_DmaIsTransferActive
        Mcl_DmaIsTransferCompleted: implemented-entry=Mcl_DmaIsTransferCompleted
        Mcl_DmaProcessCombinedInterrupt: implemented-entry=Mcl_DmaProcessCombinedInterrupt
        Mcl_DmaProcessErrorInterrupt: implemented-entry=Mcl_DmaProcessErrorInterrupt
        Mcl_DmaProcessInterrupt: implemented-entry=Mcl_DmaProcessInterrupt
        Mcl_DmaSetChannelPriority: implemented-entry=Mcl_DmaSetChannelPriority
        Mcl_DmaStartChannel: implemented-entry=Mcl_DmaStartChannel
        Mcl_DmaTcdClearDone: implemented-entry=Mcl_DmaTcdClearDone
        Mcl_DmaTcdClearIntMaj: implemented-entry=Mcl_DmaTcdClearIntMaj
        Mcl_DmaTcdGetDaddr: implemented-entry=Mcl_DmaTcdGetDaddr
        Mcl_DmaTcdGetFlags: implemented-entry=Mcl_DmaTcdGetFlags
        Mcl_DmaTcdGetIntMaj: implemented-entry=Mcl_DmaTcdGetIntMaj
        Mcl_DmaTcdGetIterCount: implemented-entry=Mcl_DmaTcdGetIterCount
        Mcl_DmaTcdGetSaddr: implemented-entry=Mcl_DmaTcdGetSaddr
        Mcl_DmaTcdSetDaddr: implemented-entry=Mcl_DmaTcdSetDaddr
        Mcl_DmaTcdSetDlast: implemented-entry=Mcl_DmaTcdSetDlast
        Mcl_DmaTcdSetDModuloAndSize: implemented-entry=Mcl_DmaTcdSetDModuloAndSize
        Mcl_DmaTcdSetDoff: implemented-entry=Mcl_DmaTcdSetDoff
        Mcl_DmaTcdSetFlags: implemented-entry=Mcl_DmaTcdSetFlags
        Mcl_DmaTcdSetIntMaj: implemented-entry=Mcl_DmaTcdSetIntMaj
        Mcl_DmaTcdSetIterCount: implemented-entry=Mcl_DmaTcdSetIterCount
        Mcl_DmaTcdSetLinkAndIterCount: implemented-entry=Mcl_DmaTcdSetLinkAndIterCount
        Mcl_DmaTcdSetMinorLoop: implemented-entry=Mcl_DmaTcdSetMinorLoop
        Mcl_DmaTcdSetSaddr: implemented-entry=Mcl_DmaTcdSetSaddr
        Mcl_DmaTcdSetSga: implemented-entry=Mcl_DmaTcdSetSga
        Mcl_DmaTcdSetSlast: implemented-entry=Mcl_DmaTcdSetSlast
        Mcl_DmaTcdSetSModuloAndSize: implemented-entry=Mcl_DmaTcdSetSModuloAndSize
        Mcl_DmaTcdSetSoff: implemented-entry=Mcl_DmaTcdSetSoff
        Mcl_DmaUpdateDestAddress: implemented-entry=Mcl_DmaUpdateDestAddress
        Mcl_DmaUpdateIterCount: implemented-entry=Mcl_DmaUpdateIterCount
        Mcl_GetVersionInfo: implemented-entry=Mcl_GetVersionInfo
        Mcl_Init: can-enter-exclusive-area=[MCL_EXCLUSIVE_AREA_00, MCL_EXCLUSIVE_AREA_01, MCL_EXCLUSIVE_AREA_12, MCL_EXCLUSIVE_AREA_13, MCL_EXCLUSIVE_AREA_14, MCL_EXCLUSIVE_AREA_15, MCL_EXCLUSIVE_AREA_16, MCL_EXCLUSIVE_AREA_17, MCL_EXCLUSIVE_AREA_18, MCL_EXCLUSIVE_AREA_19, MCL_EXCLUSIVE_AREA_20, MCL_EXCLUSIVE_AREA_21, MCL_EXCLUSIVE_AREA_22, MCL_EXCLUSIVE_AREA_23, MCL_EXCLUSIVE_AREA_24, MCL_EXCLUSIVE_AREA_25, MCL_EXCLUSIVE_AREA_26, MCL_EXCLUSIVE_AREA_27, MCL_EXCLUSIVE_AREA_28, MCL_EXCLUSIVE_AREA_29, MCL_EXCLUSIVE_AREA_30, MCL_EXCLUSIVE_AREA_31], implemented-entry=Mcl_Init
        Mcl_IPW_DmaClearDone: implemented-entry=Mcl_IPW_DmaClearDone
        Mcl_IPW_DmaClearIntMaj: implemented-entry=Mcl_IPW_DmaClearIntMaj
        Mcl_IPW_DmaDisableHwRequest: implemented-entry=Mcl_IPW_DmaDisableHwRequest
        Mcl_IPW_DmaEnableHwRequest: implemented-entry=Mcl_IPW_DmaEnableHwRequest
        Mcl_IPW_DmaGetChannelErrorStatus: implemented-entry=Mcl_IPW_DmaGetChannelErrorStatus
        Mcl_IPW_DmaGetChannelTcdAddress: implemented-entry=Mcl_IPW_DmaGetChannelTcdAddress
        Mcl_IPW_DmaGetChBiter: implemented-entry=Mcl_IPW_DmaGetChBiter
        Mcl_IPW_DmaGetChCiter: implemented-entry=Mcl_IPW_DmaGetChCiter
        Mcl_IPW_DmaGetCiter: implemented-entry=Mcl_IPW_DmaGetCiter
        Mcl_IPW_DmaGetDaddr: implemented-entry=Mcl_IPW_DmaGetDaddr
        Mcl_IPW_DmaGetFlags: implemented-entry=Mcl_IPW_DmaGetFlags
        Mcl_IPW_DmaGetGlobalErrorStatus: implemented-entry=Mcl_IPW_DmaGetGlobalErrorStatus
        Mcl_IPW_DmaGetInterruptRequest: implemented-entry=Mcl_IPW_DmaGetInterruptRequest
        Mcl_IPW_DmaGetSaddr: implemented-entry=Mcl_IPW_DmaGetSaddr
        Mcl_IPW_DmaSetBiter: implemented-entry=Mcl_IPW_DmaSetBiter
        Mcl_IPW_DmaSetCiter: implemented-entry=Mcl_IPW_DmaSetCiter
        Mcl_IPW_DmaSetDaddr: implemented-entry=Mcl_IPW_DmaSetDaddr
        Mcl_IPW_DmaSetDlast: implemented-entry=Mcl_IPW_DmaSetDlast
        Mcl_IPW_DmaSetDModSize: implemented-entry=Mcl_IPW_DmaSetDModSize
        Mcl_IPW_DmaSetDoff: implemented-entry=Mcl_IPW_DmaSetDoff
        Mcl_IPW_DmaSetFlags: implemented-entry=Mcl_IPW_DmaSetFlags
        Mcl_IPW_DmaSetIntMaj: implemented-entry=Mcl_IPW_DmaSetIntMaj
        Mcl_IPW_DmaSetLinkAndIterCount: implemented-entry=Mcl_IPW_DmaSetLinkAndIterCount
        Mcl_IPW_DmaSetMlnoNBytes: implemented-entry=Mcl_IPW_DmaSetMlnoNBytes
        Mcl_IPW_DmaSetMloffen: implemented-entry=Mcl_IPW_DmaSetMloffen
        Mcl_IPW_DmaSetSaddr: implemented-entry=Mcl_IPW_DmaSetSaddr
        Mcl_IPW_DmaSetSga: implemented-entry=Mcl_IPW_DmaSetSga
        Mcl_IPW_DmaSetSlast: implemented-entry=Mcl_IPW_DmaSetSlast
        Mcl_IPW_DmaSetSModSize: implemented-entry=Mcl_IPW_DmaSetSModSize
        Mcl_IPW_DmaSetSoff: implemented-entry=Mcl_IPW_DmaSetSoff
        Mcl_IPW_DmaTcdGetIntMaj: implemented-entry=Mcl_IPW_DmaTcdGetIntMaj
        Mcl_IPW_DmaUpdateDestAddress: implemented-entry=Mcl_IPW_DmaUpdateDestAddress
        Mcl_ValidateChannelConfigCall: implemented-entry=Mcl_ValidateChannelConfigCall
        Mcl_ValidateParamNotification: implemented-entry=Mcl_ValidateParamNotification
      134 x bsw interrupt entity, all with interrupt-category=CAT-2, interrupt-source=Hardware:
        MCL_DMA0_CH_COMPLETE_ISR: implemented-entry=MCL_DMA0_CH_COMPLETE_ISR
        MCL_DMA0_ERROR_ISR: implemented-entry=MCL_DMA0_ERROR_ISR
        MCL_DMA1_CH_COMPLETE_ISR: implemented-entry=MCL_DMA1_CH_COMPLETE_ISR
        MCL_DMA1_ERROR_ISR: implemented-entry=MCL_DMA1_ERROR_ISR
        MCL_DMA_CH_0_ISR: implemented-entry=MCL_DMA_CH_0_ISR
        MCL_DMA_CH_{100..109}_ISR: implemented-entry=MCL_DMA_CH_{100..109}_ISR
        MCL_DMA_CH_10_ISR: implemented-entry=MCL_DMA_CH_10_ISR
        MCL_DMA_CH_{110..119}_ISR: implemented-entry=MCL_DMA_CH_{110..119}_ISR
        MCL_DMA_CH_11_ISR: implemented-entry=MCL_DMA_CH_11_ISR
        MCL_DMA_CH_{120..127}_ISR: implemented-entry=MCL_DMA_CH_{120..127}_ISR
        MCL_DMA_CH_{12..19}_ISR: implemented-entry=MCL_DMA_CH_{12..19}_ISR
        MCL_DMA_CH_1_ISR: implemented-entry=MCL_DMA_CH_1_ISR
        MCL_DMA_CH_{20..29}_ISR: implemented-entry=MCL_DMA_CH_{20..29}_ISR
        MCL_DMA_CH_2_ISR: implemented-entry=MCL_DMA_CH_2_ISR
        MCL_DMA_CH_{30..39}_ISR: implemented-entry=MCL_DMA_CH_{30..39}_ISR
        MCL_DMA_CH_3_ISR: implemented-entry=MCL_DMA_CH_3_ISR
        MCL_DMA_CH_{40..49}_ISR: implemented-entry=MCL_DMA_CH_{40..49}_ISR
        MCL_DMA_CH_4_ISR: implemented-entry=MCL_DMA_CH_4_ISR
        MCL_DMA_CH_{50..59}_ISR: implemented-entry=MCL_DMA_CH_{50..59}_ISR
        MCL_DMA_CH_5_ISR: implemented-entry=MCL_DMA_CH_5_ISR
        MCL_DMA_CH_{60..69}_ISR: implemented-entry=MCL_DMA_CH_{60..69}_ISR
        MCL_DMA_CH_6_ISR: implemented-entry=MCL_DMA_CH_6_ISR
        MCL_DMA_CH_{70..79}_ISR: implemented-entry=MCL_DMA_CH_{70..79}_ISR
        MCL_DMA_CH_7_ISR: implemented-entry=MCL_DMA_CH_7_ISR
        MCL_DMA_CH_{80..89}_ISR: implemented-entry=MCL_DMA_CH_{80..89}_ISR
        MCL_DMA_CH_8_ISR: implemented-entry=MCL_DMA_CH_8_ISR
        MCL_DMA_CH_{90..99}_ISR: implemented-entry=MCL_DMA_CH_{90..99}_ISR
        MCL_DMA_CH_9_ISR: implemented-entry=MCL_DMA_CH_9_ISR
        MCL_DMA_CH_MIXED_96_127_COMPLETE_ISR: implemented-entry=MCL_DMA_CH_MIXED_96_127_COMPLETE_ISR
        MCL_DMA_ERROR_ISR: implemented-entry=MCL_DMA_ERROR_ISR
package /AUTOSAR_Mcl/BswModuleEntrys
  220 x bsw module entry, all with service-id=0, is-reentrant=false, is-synchronous=true, sw-service-impl-policy=STANDARD:
    Mcl_DmaAcknowledgeInterrupt: call-type=REGULAR, execution-context=UNSPECIFIED
    Mcl_DmaConfigChannel: call-type=REGULAR, execution-context=UNSPECIFIED
    Mcl_DmaConfigLinkedChannel: call-type=REGULAR, execution-context=UNSPECIFIED
    Mcl_DmaConfigLinkedTcd: call-type=REGULAR, execution-context=UNSPECIFIED
    Mcl_DmaConfigScatterGatherChannel: call-type=REGULAR, execution-context=UNSPECIFIED
    Mcl_DmaConfigScatterGatherLinkedChannel: call-type=REGULAR, execution-context=UNSPECIFIED
    Mcl_DmaConfigScatterGatherLinkedTcd: call-type=REGULAR, execution-context=UNSPECIFIED
    Mcl_DmaConfigScatterGatherTcd: call-type=REGULAR, execution-context=UNSPECIFIED
    Mcl_DmaConfigTcd: call-type=REGULAR, execution-context=UNSPECIFIED
    Mcl_DmaDisableHwRequest: call-type=REGULAR, execution-context=UNSPECIFIED
    Mcl_DmaDisableNotification: call-type=REGULAR, execution-context=UNSPECIFIED
    Mcl_DmaEnableHwRequest: call-type=REGULAR, execution-context=UNSPECIFIED
    Mcl_DmaEnableNotification: call-type=REGULAR, execution-context=UNSPECIFIED
    Mcl_DmaGetChannelErrorStatus: call-type=REGULAR, execution-context=UNSPECIFIED
    Mcl_DmaGetChannelTcdAddress: call-type=REGULAR, execution-context=UNSPECIFIED
    Mcl_DmaGetCrtIterCount: call-type=REGULAR, execution-context=UNSPECIFIED
    Mcl_DmaGetGlobalErrorStatus: call-type=REGULAR, execution-context=UNSPECIFIED
    Mcl_DmaGetInterruptRequest: call-type=REGULAR, execution-context=UNSPECIFIED
    Mcl_DmaGetPhysicalChannel: call-type=REGULAR, execution-context=UNSPECIFIED
    Mcl_DmaGetStartIterCount: call-type=REGULAR, execution-context=UNSPECIFIED
    Mcl_DmaIsTransferActive: call-type=REGULAR, execution-context=UNSPECIFIED
    Mcl_DmaIsTransferCompleted: call-type=REGULAR, execution-context=UNSPECIFIED
    Mcl_DmaProcessCombinedInterrupt: call-type=REGULAR, execution-context=UNSPECIFIED
    Mcl_DmaProcessErrorInterrupt: call-type=REGULAR, execution-context=UNSPECIFIED
    Mcl_DmaProcessInterrupt: call-type=REGULAR, execution-context=UNSPECIFIED
    Mcl_DmaSetChannelPriority: call-type=REGULAR, execution-context=UNSPECIFIED
    Mcl_DmaStartChannel: call-type=REGULAR, execution-context=UNSPECIFIED
    Mcl_DmaTcdClearDone: call-type=REGULAR, execution-context=UNSPECIFIED
    Mcl_DmaTcdClearIntMaj: call-type=REGULAR, execution-context=UNSPECIFIED
    Mcl_DmaTcdGetDaddr: call-type=REGULAR, execution-context=UNSPECIFIED
    Mcl_DmaTcdGetFlags: call-type=REGULAR, execution-context=UNSPECIFIED
    Mcl_DmaTcdGetIntMaj: call-type=REGULAR, execution-context=UNSPECIFIED
    Mcl_DmaTcdGetIterCount: call-type=REGULAR, execution-context=UNSPECIFIED
    Mcl_DmaTcdGetSaddr: call-type=REGULAR, execution-context=UNSPECIFIED
    Mcl_DmaTcdSetDaddr: call-type=REGULAR, execution-context=UNSPECIFIED
    Mcl_DmaTcdSetDlast: call-type=REGULAR, execution-context=UNSPECIFIED
    Mcl_DmaTcdSetDModuloAndSize: call-type=REGULAR, execution-context=UNSPECIFIED
    Mcl_DmaTcdSetDoff: call-type=REGULAR, execution-context=UNSPECIFIED
    Mcl_DmaTcdSetFlags: call-type=REGULAR, execution-context=UNSPECIFIED
    Mcl_DmaTcdSetIntMaj: call-type=REGULAR, execution-context=UNSPECIFIED
    Mcl_DmaTcdSetIterCount: call-type=REGULAR, execution-context=UNSPECIFIED
    Mcl_DmaTcdSetLinkAndIterCount: call-type=REGULAR, execution-context=UNSPECIFIED
    Mcl_DmaTcdSetMinorLoop: call-type=REGULAR, execution-context=UNSPECIFIED
    Mcl_DmaTcdSetSaddr: call-type=REGULAR, execution-context=UNSPECIFIED
    Mcl_DmaTcdSetSga: call-type=REGULAR, execution-context=UNSPECIFIED
    Mcl_DmaTcdSetSlast: call-type=REGULAR, execution-context=UNSPECIFIED
    Mcl_DmaTcdSetSModuloAndSize: call-type=REGULAR, execution-context=UNSPECIFIED
    Mcl_DmaTcdSetSoff: call-type=REGULAR, execution-context=UNSPECIFIED
    Mcl_DmaUpdateDestAddress: call-type=REGULAR, execution-context=UNSPECIFIED
    Mcl_DmaUpdateIterCount: call-type=REGULAR, execution-context=UNSPECIFIED
    Mcl_GetVersionInfo: call-type=REGULAR, execution-context=UNSPECIFIED
    Mcl_Init: call-type=REGULAR, execution-context=UNSPECIFIED
    Mcl_IPW_DmaClearDone: call-type=REGULAR, execution-context=UNSPECIFIED
    Mcl_IPW_DmaClearIntMaj: call-type=REGULAR, execution-context=UNSPECIFIED
    Mcl_IPW_DmaDisableHwRequest: call-type=REGULAR, execution-context=UNSPECIFIED
    Mcl_IPW_DmaEnableHwRequest: call-type=REGULAR, execution-context=UNSPECIFIED
    Mcl_IPW_DmaGetChannelErrorStatus: call-type=REGULAR, execution-context=UNSPECIFIED
    Mcl_IPW_DmaGetChannelTcdAddress: call-type=REGULAR, execution-context=UNSPECIFIED
    Mcl_IPW_DmaGetChBiter: call-type=REGULAR, execution-context=UNSPECIFIED
    Mcl_IPW_DmaGetChCiter: call-type=REGULAR, execution-context=UNSPECIFIED
    Mcl_IPW_DmaGetCiter: call-type=REGULAR, execution-context=UNSPECIFIED
    Mcl_IPW_DmaGetDaddr: call-type=REGULAR, execution-context=UNSPECIFIED
    Mcl_IPW_DmaGetFlags: call-type=REGULAR, execution-context=UNSPECIFIED
    Mcl_IPW_DmaGetGlobalErrorStatus: call-type=REGULAR, execution-context=UNSPECIFIED
    Mcl_IPW_DmaGetInterruptRequest: call-type=REGULAR, execution-context=UNSPECIFIED
    Mcl_IPW_DmaGetSaddr: call-type=REGULAR, execution-context=UNSPECIFIED
    Mcl_IPW_DmaSetBiter: call-type=REGULAR, execution-context=UNSPECIFIED
    Mcl_IPW_DmaSetCiter: call-type=REGULAR, execution-context=UNSPECIFIED
    Mcl_IPW_DmaSetDaddr: call-type=REGULAR, execution-context=UNSPECIFIED
    Mcl_IPW_DmaSetDlast: call-type=REGULAR, execution-context=UNSPECIFIED
    Mcl_IPW_DmaSetDModSize: call-type=REGULAR, execution-context=UNSPECIFIED
    Mcl_IPW_DmaSetDoff: call-type=REGULAR, execution-context=UNSPECIFIED
    Mcl_IPW_DmaSetFlags: call-type=REGULAR, execution-context=UNSPECIFIED
    Mcl_IPW_DmaSetIntMaj: call-type=REGULAR, execution-context=UNSPECIFIED
    Mcl_IPW_DmaSetLinkAndIterCount: call-type=REGULAR, execution-context=UNSPECIFIED
    Mcl_IPW_DmaSetMlnoNBytes: call-type=REGULAR, execution-context=UNSPECIFIED
    Mcl_IPW_DmaSetMloffen: call-type=REGULAR, execution-context=UNSPECIFIED
    Mcl_IPW_DmaSetSaddr: call-type=REGULAR, execution-context=UNSPECIFIED
    Mcl_IPW_DmaSetSga: call-type=REGULAR, execution-context=UNSPECIFIED
    Mcl_IPW_DmaSetSlast: call-type=REGULAR, execution-context=UNSPECIFIED
    Mcl_IPW_DmaSetSModSize: call-type=REGULAR, execution-context=UNSPECIFIED
    Mcl_IPW_DmaSetSoff: call-type=REGULAR, execution-context=UNSPECIFIED
    Mcl_IPW_DmaTcdGetIntMaj: call-type=REGULAR, execution-context=UNSPECIFIED
    Mcl_IPW_DmaUpdateDestAddress: call-type=REGULAR, execution-context=UNSPECIFIED
    Mcl_ValidateChannelConfigCall: call-type=REGULAR, execution-context=UNSPECIFIED
    Mcl_ValidateParamNotification: call-type=REGULAR, execution-context=UNSPECIFIED
    MCL_DMA0_CH_COMPLETE_ISR: call-type=INTERRUPT, execution-context=INTERRUPT-CAT-2
    MCL_DMA0_ERROR_ISR: call-type=INTERRUPT, execution-context=INTERRUPT-CAT-2
    MCL_DMA1_CH_COMPLETE_ISR: call-type=INTERRUPT, execution-context=INTERRUPT-CAT-2
    MCL_DMA1_ERROR_ISR: call-type=INTERRUPT, execution-context=INTERRUPT-CAT-2
    MCL_DMA_CH_0_ISR: call-type=INTERRUPT, execution-context=INTERRUPT-CAT-2
    MCL_DMA_CH_{100..109}_ISR: call-type=INTERRUPT, execution-context=INTERRUPT-CAT-2
    MCL_DMA_CH_10_ISR: call-type=INTERRUPT, execution-context=INTERRUPT-CAT-2
    MCL_DMA_CH_{110..119}_ISR: call-type=INTERRUPT, execution-context=INTERRUPT-CAT-2
    MCL_DMA_CH_11_ISR: call-type=INTERRUPT, execution-context=INTERRUPT-CAT-2
    MCL_DMA_CH_{120..127}_ISR: call-type=INTERRUPT, execution-context=INTERRUPT-CAT-2
    MCL_DMA_CH_{12..19}_ISR: call-type=INTERRUPT, execution-context=INTERRUPT-CAT-2
    MCL_DMA_CH_1_ISR: call-type=INTERRUPT, execution-context=INTERRUPT-CAT-2
    MCL_DMA_CH_{20..29}_ISR: call-type=INTERRUPT, execution-context=INTERRUPT-CAT-2
    MCL_DMA_CH_2_ISR: call-type=INTERRUPT, execution-context=INTERRUPT-CAT-2
    MCL_DMA_CH_{30..39}_ISR: call-type=INTERRUPT, execution-context=INTERRUPT-CAT-2
    MCL_DMA_CH_3_ISR: call-type=INTERRUPT, execution-context=INTERRUPT-CAT-2
    MCL_DMA_CH_{40..49}_ISR: call-type=INTERRUPT, execution-context=INTERRUPT-CAT-2
    MCL_DMA_CH_4_ISR: call-type=INTERRUPT, execution-context=INTERRUPT-CAT-2
    MCL_DMA_CH_{50..59}_ISR: call-type=INTERRUPT, execution-context=INTERRUPT-CAT-2
    MCL_DMA_CH_5_ISR: call-type=INTERRUPT, execution-context=INTERRUPT-CAT-2
    MCL_DMA_CH_{60..69}_ISR: call-type=INTERRUPT, execution-context=INTERRUPT-CAT-2
    MCL_DMA_CH_6_ISR: call-type=INTERRUPT, execution-context=INTERRUPT-CAT-2
    MCL_DMA_CH_{70..79}_ISR: call-type=INTERRUPT, execution-context=INTERRUPT-CAT-2
    MCL_DMA_CH_7_ISR: call-type=INTERRUPT, execution-context=INTERRUPT-CAT-2
    MCL_DMA_CH_{80..89}_ISR: call-type=INTERRUPT, execution-context=INTERRUPT-CAT-2
    MCL_DMA_CH_8_ISR: call-type=INTERRUPT, execution-context=INTERRUPT-CAT-2
    MCL_DMA_CH_{90..99}_ISR: call-type=INTERRUPT, execution-context=INTERRUPT-CAT-2
    MCL_DMA_CH_9_ISR: call-type=INTERRUPT, execution-context=INTERRUPT-CAT-2
    MCL_DMA_CH_MIXED_96_127_COMPLETE_ISR: call-type=INTERRUPT, execution-context=INTERRUPT-CAT-2
    MCL_DMA_ERROR_ISR: call-type=INTERRUPT, execution-context=INTERRUPT-CAT-2
package /Mcl_T2D35M10I0R0/Implementations
  bsw implementation BswImplementation_0: programming-language=C, sw-version=1.0.0, vendor-id=43, ar-release-version=4.2.2, behavior=InternalBehavior_0, vendor-specific-module-def=Mcl
    code-descriptors:
      code Files
        artifact-descriptors:
          short-label=config::Mcl.xdm, category=SWCFG
          short-label=doc::AUTOSAR_MCAL_MCL_IM.pdf, category=SWDOC
          short-label=doc::AUTOSAR_MCAL_MCL_UM.pdf, category=SWDOC
          short-label=include::CDD_Mcl.h, category=SWHDR
          short-label=include::eMios_Common.h, category=SWHDR
          short-label=include::eMios_Common_Types.h, category=SWHDR
          short-label=include::Mcl.h, category=SWHDR
          short-label=include::Mcl_Axbs.h, category=SWHDR
          short-label=include::Mcl_Axbs_Types.h, category=SWHDR
          short-label=include::Mcl_Dma.h, category=SWHDR
          short-label=include::Mcl_DmaMux.h, category=SWHDR
          short-label=include::Mcl_DmaMux_Types.h, category=SWHDR
          short-label=include::Mcl_Dma_Types.h, category=SWHDR
          short-label=include::Mcl_EnvCfg.h, category=SWHDR
          short-label=include::Mcl_IPW.h, category=SWHDR
          short-label=include::Mcl_IPW_Notif.h, category=SWHDR
          short-label=include::Mcl_IPW_Types.h, category=SWHDR
          short-label=include::Mcl_Notif.h, category=SWHDR
          short-label=include::Mcl_Types.h, category=SWHDR
          short-label=include::Reg_eSys_Axbs.h, category=SWHDR
          short-label=include::Reg_eSys_Dma.h, category=SWHDR
          short-label=include::Reg_eSys_DmaMux.h, category=SWHDR
          short-label=include::Reg_eSys_eMios.h, category=SWHDR
          short-label=src::CDD_Mcl.c, category=SWSRC
          short-label=src::eMios_Common.c, category=SWSRC
          short-label=src::Mcl_Axbs.c, category=SWSRC
          short-label=src::Mcl_Dma.c, category=SWSRC
          short-label=src::Mcl_DmaMux.c, category=SWSRC
          short-label=src::Mcl_Dma_Irq.c, category=SWSRC
          short-label=src::Mcl_IPW.c, category=SWSRC
    compiler DIAB_Compiler:
      name=Windriver Diab
      options=-tPPCE200Z4204N3VEN:simple -tPPCE200Z210N3VEN:simple -Xdialect-ansi -XO -g3 -Xsize-opt -Xsmall-data=0 -Xsmall-const=0 -Xaddr-sconst=0x11 -Xaddr-sdata=0x11 -Xno-common -Xnested-interrupts -Xdebug-dwarf2 -Xdebug-local-all -Xdebug-local-cie -Xdebug-struct-all -Xforce-declarations -ee1481 -Xmacro-undefined-warn -Xlink-time-lint -W:as:,-l -Wa,-Xisa-vle -DAUTOSAR_OS_NOT_USED -DUSE_SW_VECTOR_MODE -DDIAB -DDISABLE_MCAL_INTERMODULE_ASR_CHECK -c
      vendor=Windriver
      version=Windriver DIAB DIAB_5_9_6_2
    compiler GHS_Compiler:
      name=Green Hills
      options=-cpu=ppc5748gz4204 -cpu=ppc5748gz210 -ansi -noSPE -Ospace -sda=0 -vle -dual_debug -G --no_exceptions -Wundef -Wimplicit-int -Wshadow -Wtrigraphs --prototype_errors --incorrect_pragma_warnings -noslashcomment -preprocess_assembly_files -nostartfile --short_enum --diag_error 223 -DAUTOSAR_OS_NOT_USED -DUSE_SW_VECTOR_MODE -DDISABLE_MCAL_INTERMODULE_ASR_CHECK -DGHS -c
      vendor=Green Hills
      version=Green Hills Multi 7.1.4 / Compiler 2015.1.6
    generated-artifacts:
      dependency on artifact CDD_Mcl_PBcfg_c: artifact-descriptor={short-label=generate_PB::src::CDD_Mcl_PBcfg.c, category=SWSRC}, usages=COMPILE
      dependency on artifact CDD_Mcl_Cfg_h: artifact-descriptor={short-label=generate_PC::include::CDD_Mcl_Cfg.h, category=SWHDR}, usages=COMPILE
      dependency on artifact CDD_Mcl_Cfg_c: artifact-descriptor={short-label=generate_PC::src::CDD_Mcl_Cfg.c, category=SWSRC}, usages=COMPILE
    linker DIAB_Linker: name=Windriver Diab, options=-tPPCE200Z4204N3VEN:simple -tPPCE200Z210N3VEN:simple -Xelf -m6 -Xlink-time-lint, vendor=Windriver, version=Windriver DIAB DIAB_5_9_6_2
    linker GHS_Linker: name=Green Hills, options=-cpu=ppc5748gz4204 -cpu=ppc5748gz210 -nostartfiles -vle --nocpp -Mn -delete -ignore_debug_references -keepmap, vendor=Green Hills, version=Green Hills Multi 7.1.4 / Compiler 2015.1.6
    resource consumption ResourceConsumption
      5 x memory section:
        MCL_CODE: alignment=UNSPECIFIED, sw-addrmethod=CODE, symbol=CODE
        MCL_CONFIG_DATA_UNSPECIFIED: alignment=UNSPECIFIED, sw-addrmethod=CONFIG_DATA_UNSPECIFIED, symbol=CONFIG_DATA_UNSPECIFIED
        MCL_CONST_32: alignment=32, sw-addrmethod=CONST_32, symbol=CONST_32
        MCL_CONST_UNSPECIFIED: alignment=UNSPECIFIED, sw-addrmethod=CONST_UNSPECIFIED, symbol=CONST_UNSPECIFIED
        MCL_VAR_INIT_UNSPECIFIED: alignment=UNSPECIFIED, sw-addrmethod=VAR_INIT_UNSPECIFIED, symbol=VAR_INIT_UNSPECIFIED
