AUTOSAR XML (schema 4-0-3)
package /AUTOSAR_Icu/BswModuleDescriptions
  bsw module description Icu: module-id=122
    provided-entrys:
      Icu_CheckWakeup
      Icu_DeInit
      Icu_DisableEdgeCount
      Icu_DisableEdgeDetection
      Icu_DisableNotification
      Icu_DisableWakeup
      Icu_eMios_CheckOverflowFlag
      Icu_eMios_DeInit
      Icu_eMios_DisableEdgeCount
      Icu_eMios_DisableInterrupt
      Icu_eMios_EnableInterrupt
      Icu_eMios_GetCaptureRegA
      Icu_eMios_GetCaptureRegB
      Icu_eMios_GetChannelClockMode
      Icu_eMios_GetEdgeNumbers
      Icu_eMios_GetInputLevel
      Icu_eMios_GetInputState
      Icu_eMios_Init
      Icu_eMios_ResetEdgeCount
      Icu_eMios_SetActivationCondition
      Icu_eMios_SetNormalMode
      Icu_eMios_SetPrescaler
      Icu_eMios_SetSleepMode
      Icu_eMios_StartSignalMeasurement
      Icu_eMios_StartTimestamp
      Icu_eMios_StopSignalMeasurement
      Icu_eMios_StopTimestamp
      Icu_eMios_UCSetMode
      Icu_EnableEdgeCount
      Icu_EnableEdgeDetection
      Icu_EnableNotification
      Icu_EnableWakeup
      Icu_GetCaptureRegisterValue
      Icu_GetDutyCycleValues
      Icu_GetEdgeNumbers
      Icu_GetInputState
      Icu_GetTimeElapsed
      Icu_GetTimestampIndex
      Icu_Init
      Icu_ResetEdgeCount
      Icu_SetActivationCondition
      Icu_SetMode
      Icu_StartSignalMeasurement
      Icu_StartTimestamp
      Icu_StopSignalMeasurement
      Icu_StopTimestamp
      Icu_GetVersionInfo
      ICU_EXT_IRQ_SINGLE_INTERRUPT
      SIUL2_EXT_IRQ_0_7_ISR
      SIUL2_EXT_IRQ_16_23_ISR
      SIUL2_EXT_IRQ_24_31_ISR
      SIUL2_EXT_IRQ_8_15_ISR
    bsw internal behavior InternalBehavior_0
      27 x exclusive area:
        ICU_EXCLUSIVE_AREA_{00..11}
        ICU_EXCLUSIVE_AREA_{13..24}
        ICU_EXCLUSIVE_AREA_{26..28}
      47 x bsw called entity:
        Icu_CheckWakeup: implemented-entry=Icu_CheckWakeup
        Icu_DeInit: implemented-entry=Icu_DeInit
        Icu_DisableEdgeCount: implemented-entry=Icu_DisableEdgeCount
        Icu_DisableEdgeDetection: implemented-entry=Icu_DisableEdgeDetection
        Icu_DisableNotification: implemented-entry=Icu_DisableNotification
        Icu_DisableWakeup: implemented-entry=Icu_DisableWakeup
        Icu_eMios_CheckOverflowFlag: implemented-entry=Icu_eMios_CheckOverflowFlag
        Icu_eMios_DeInit: implemented-entry=Icu_eMios_DeInit
        Icu_eMios_DisableEdgeCount: implemented-entry=Icu_eMios_DisableEdgeCount
        Icu_eMios_DisableInterrupt: implemented-entry=Icu_eMios_DisableInterrupt
        Icu_eMios_EnableInterrupt: implemented-entry=Icu_eMios_EnableInterrupt
        Icu_eMios_GetCaptureRegA: implemented-entry=Icu_eMios_GetCaptureRegA
        Icu_eMios_GetCaptureRegB: implemented-entry=Icu_eMios_GetCaptureRegB
        Icu_eMios_GetChannelClockMode: implemented-entry=Icu_eMios_GetChannelClockMode
        Icu_eMios_GetEdgeNumbers: implemented-entry=Icu_eMios_GetEdgeNumbers
        Icu_eMios_GetInputLevel: implemented-entry=Icu_eMios_GetInputLevel
        Icu_eMios_GetInputState: implemented-entry=Icu_eMios_GetInputState
        Icu_eMios_Init: implemented-entry=Icu_eMios_Init
        Icu_eMios_ResetEdgeCount: implemented-entry=Icu_eMios_ResetEdgeCount
        Icu_eMios_SetActivationCondition: implemented-entry=Icu_eMios_SetActivationCondition
        Icu_eMios_SetNormalMode: implemented-entry=Icu_eMios_SetNormalMode
        Icu_eMios_SetPrescaler: implemented-entry=Icu_eMios_SetPrescaler
        Icu_eMios_SetSleepMode: implemented-entry=Icu_eMios_SetSleepMode
        Icu_eMios_StartSignalMeasurement: implemented-entry=Icu_eMios_StartSignalMeasurement
        Icu_eMios_StartTimestamp: implemented-entry=Icu_eMios_StartTimestamp
        Icu_eMios_StopSignalMeasurement: implemented-entry=Icu_eMios_StopSignalMeasurement
        Icu_eMios_StopTimestamp: implemented-entry=Icu_eMios_StopTimestamp
        Icu_eMios_UCSetMode: implemented-entry=Icu_eMios_UCSetMode
        Icu_EnableEdgeCount: implemented-entry=Icu_EnableEdgeCount
        Icu_EnableEdgeDetection: implemented-entry=Icu_EnableEdgeDetection
        Icu_EnableNotification: implemented-entry=Icu_EnableNotification
        Icu_EnableWakeup: implemented-entry=Icu_EnableWakeup
        Icu_GetCaptureRegisterValue: implemented-entry=Icu_GetCaptureRegisterValue
        Icu_GetDutyCycleValues: implemented-entry=Icu_GetDutyCycleValues
        Icu_GetEdgeNumbers: implemented-entry=Icu_GetEdgeNumbers
        Icu_GetInputState: implemented-entry=Icu_GetInputState
        Icu_GetTimeElapsed: implemented-entry=Icu_GetTimeElapsed
        Icu_GetTimestampIndex: implemented-entry=Icu_GetTimestampIndex
        Icu_Init: can-enter-exclusive-area=[ICU_EXCLUSIVE_AREA_00, ICU_EXCLUSIVE_AREA_01, ICU_EXCLUSIVE_AREA_02, ICU_EXCLUSIVE_AREA_03, ICU_EXCLUSIVE_AREA_04, ICU_EXCLUSIVE_AREA_05, ICU_EXCLUSIVE_AREA_06, ICU_EXCLUSIVE_AREA_07, ICU_EXCLUSIVE_AREA_08, ICU_EXCLUSIVE_AREA_09, ICU_EXCLUSIVE_AREA_10, ICU_EXCLUSIVE_AREA_11, ICU_EXCLUSIVE_AREA_13, ICU_EXCLUSIVE_AREA_14, ICU_EXCLUSIVE_AREA_15, ICU_EXCLUSIVE_AREA_16, ICU_EXCLUSIVE_AREA_17, ICU_EXCLUSIVE_AREA_18, ICU_EXCLUSIVE_AREA_19, ICU_EXCLUSIVE_AREA_20, ICU_EXCLUSIVE_AREA_21, ICU_EXCLUSIVE_AREA_22, ICU_EXCLUSIVE_AREA_23, ICU_EXCLUSIVE_AREA_24, ICU_EXCLUSIVE_AREA_26, ICU_EXCLUSIVE_AREA_27, ICU_EXCLUSIVE_AREA_28], implemented-entry=Icu_Init
        Icu_ResetEdgeCount: implemented-entry=Icu_ResetEdgeCount
        Icu_SetActivationCondition: implemented-entry=Icu_SetActivationCondition
        Icu_SetMode: implemented-entry=Icu_SetMode
        Icu_StartSignalMeasurement: implemented-entry=Icu_StartSignalMeasurement
        Icu_StartTimestamp: implemented-entry=Icu_StartTimestamp
        Icu_StopSignalMeasurement: implemented-entry=Icu_StopSignalMeasurement
        Icu_StopTimestamp: implemented-entry=Icu_StopTimestamp
        Icu_GetVersionInfo: implemented-entry=Icu_GetVersionInfo
      5 x bsw interrupt entity, all with interrupt-category=CAT-2, interrupt-source=Hardware:
        ICU_EXT_IRQ_SINGLE_INTERRUPT: implemented-entry=ICU_EXT_IRQ_SINGLE_INTERRUPT
        SIUL2_EXT_IRQ_0_7_ISR: implemented-entry=SIUL2_EXT_IRQ_0_7_ISR
        SIUL2_EXT_IRQ_16_23_ISR: implemented-entry=SIUL2_EXT_IRQ_16_23_ISR
        SIUL2_EXT_IRQ_24_31_ISR: implemented-entry=SIUL2_EXT_IRQ_24_31_ISR
        SIUL2_EXT_IRQ_8_15_ISR: implemented-entry=SIUL2_EXT_IRQ_8_15_ISR
package /AUTOSAR_Icu/BswModuleEntrys
  52 x bsw module entry, all with sw-service-impl-policy=STANDARD:
    Icu_CheckWakeup: service-id=0x15, is-reentrant=true, is-synchronous=true, call-type=REGULAR, execution-context=UNSPECIFIED
    Icu_DeInit: service-id=0x01, is-reentrant=false, is-synchronous=true, call-type=REGULAR, execution-context=UNSPECIFIED
    Icu_DisableEdgeCount: service-id=0x0e, is-reentrant=true, is-synchronous=true, call-type=REGULAR, execution-context=UNSPECIFIED
    Icu_DisableEdgeDetection: service-id=0x17, is-reentrant=true, is-synchronous=true, call-type=REGULAR, execution-context=UNSPECIFIED
    Icu_DisableNotification: service-id=0x06, is-reentrant=true, is-synchronous=true, call-type=REGULAR, execution-context=UNSPECIFIED
    Icu_DisableWakeup: service-id=0x03, is-reentrant=true, is-synchronous=true, call-type=REGULAR, execution-context=UNSPECIFIED
    Icu_eMios_CheckOverflowFlag: service-id=0, is-reentrant=false, is-synchronous=true, call-type=REGULAR, execution-context=UNSPECIFIED
    Icu_eMios_DeInit: service-id=0, is-reentrant=false, is-synchronous=true, call-type=REGULAR, execution-context=UNSPECIFIED
    Icu_eMios_DisableEdgeCount: service-id=0, is-reentrant=false, is-synchronous=true, call-type=REGULAR, execution-context=UNSPECIFIED
    Icu_eMios_DisableInterrupt: service-id=0, is-reentrant=false, is-synchronous=true, call-type=REGULAR, execution-context=UNSPECIFIED
    Icu_eMios_EnableInterrupt: service-id=0, is-reentrant=false, is-synchronous=true, call-type=REGULAR, execution-context=UNSPECIFIED
    Icu_eMios_GetCaptureRegA: service-id=0, is-reentrant=false, is-synchronous=true, call-type=REGULAR, execution-context=UNSPECIFIED
    Icu_eMios_GetCaptureRegB: service-id=0, is-reentrant=false, is-synchronous=true, call-type=REGULAR, execution-context=UNSPECIFIED
    Icu_eMios_GetChannelClockMode: service-id=0, is-reentrant=false, is-synchronous=true, call-type=REGULAR, execution-context=UNSPECIFIED
    Icu_eMios_GetEdgeNumbers: service-id=0, is-reentrant=false, is-synchronous=true, call-type=REGULAR, execution-context=UNSPECIFIED
    Icu_eMios_GetInputLevel: service-id=0, is-reentrant=false, is-synchronous=true, call-type=REGULAR, execution-context=UNSPECIFIED
    Icu_eMios_GetInputState: service-id=0, is-reentrant=false, is-synchronous=true, call-type=REGULAR, execution-context=UNSPECIFIED
    Icu_eMios_Init: service-id=0, is-reentrant=false, is-synchronous=true, call-type=REGULAR, execution-context=UNSPECIFIED
    Icu_eMios_ResetEdgeCount: service-id=0, is-reentrant=false, is-synchronous=true, call-type=REGULAR, execution-context=UNSPECIFIED
    Icu_eMios_SetActivationCondition: service-id=0, is-reentrant=false, is-synchronous=true, call-type=REGULAR, execution-context=UNSPECIFIED
    Icu_eMios_SetNormalMode: service-id=0, is-reentrant=false, is-synchronous=true, call-type=REGULAR, execution-context=UNSPECIFIED
    Icu_eMios_SetPrescaler: service-id=0, is-reentrant=false, is-synchronous=true, call-type=REGULAR, execution-context=UNSPECIFIED
    Icu_eMios_SetSleepMode: service-id=0, is-reentrant=false, is-synchronous=true, call-type=REGULAR, execution-context=UNSPECIFIED
    Icu_eMios_StartSignalMeasurement: service-id=0, is-reentrant=false, is-synchronous=true, call-type=REGULAR, execution-context=UNSPECIFIED
    Icu_eMios_StartTimestamp: service-id=0, is-reentrant=false, is-synchronous=true, call-type=REGULAR, execution-context=UNSPECIFIED
    Icu_eMios_StopSignalMeasurement: service-id=0, is-reentrant=false, is-synchronous=true, call-type=REGULAR, execution-context=UNSPECIFIED
    Icu_eMios_StopTimestamp: service-id=0, is-reentrant=false, is-synchronous=true, call-type=REGULAR, execution-context=UNSPECIFIED
    Icu_eMios_UCSetMode: service-id=0, is-reentrant=false, is-synchronous=true, call-type=REGULAR, execution-context=UNSPECIFIED
    Icu_EnableEdgeCount: service-id=0x0d, is-reentrant=true, is-synchronous=true, call-type=REGULAR, execution-context=UNSPECIFIED
    Icu_EnableEdgeDetection: service-id=0x16, is-reentrant=true, is-synchronous=true, call-type=REGULAR, execution-context=UNSPECIFIED
    Icu_EnableNotification: service-id=0x07, is-reentrant=true, is-synchronous=true, call-type=REGULAR, execution-context=UNSPECIFIED
    Icu_EnableWakeup: service-id=0x04, is-reentrant=true, is-synchronous=true, call-type=REGULAR, execution-context=UNSPECIFIED
    Icu_GetCaptureRegisterValue: service-id=0, is-reentrant=false, is-synchronous=true, call-type=REGULAR, execution-context=UNSPECIFIED
    Icu_GetDutyCycleValues: service-id=0x11, is-reentrant=true, is-synchronous=true, call-type=REGULAR, execution-context=UNSPECIFIED
    Icu_GetEdgeNumbers: service-id=0x0f, is-reentrant=true, is-synchronous=false, call-type=REGULAR, execution-context=UNSPECIFIED
    Icu_GetInputState: service-id=0x08, is-reentrant=true, is-synchronous=true, call-type=REGULAR, execution-context=UNSPECIFIED
    Icu_GetTimeElapsed: service-id=0x10, is-reentrant=true, is-synchronous=true, call-type=REGULAR, execution-context=UNSPECIFIED
    Icu_GetTimestampIndex: service-id=0x0b, is-reentrant=true, is-synchronous=true, call-type=REGULAR, execution-context=UNSPECIFIED
    Icu_Init: service-id=0x00, is-reentrant=false, is-synchronous=true, call-type=REGULAR, execution-context=UNSPECIFIED
    Icu_ResetEdgeCount: service-id=0x0c, is-reentrant=true, is-synchronous=true, call-type=REGULAR, execution-context=UNSPECIFIED
    Icu_SetActivationCondition: service-id=0x05, is-reentrant=true, is-synchronous=true, call-type=REGULAR, execution-context=UNSPECIFIED
    Icu_SetMode: service-id=0x02, is-reentrant=false, is-synchronous=true, call-type=REGULAR, execution-context=UNSPECIFIED
    Icu_StartSignalMeasurement: service-id=0x13, is-reentrant=true, is-synchronous=false, call-type=REGULAR, execution-context=UNSPECIFIED
    Icu_StartTimestamp: service-id=0x09, is-reentrant=true, is-synchronous=false, call-type=REGULAR, execution-context=UNSPECIFIED
    Icu_StopSignalMeasurement: service-id=0x14, is-reentrant=true, is-synchronous=true, call-type=REGULAR, execution-context=UNSPECIFIED
    Icu_StopTimestamp: service-id=0x0a, is-reentrant=true, is-synchronous=true, call-type=REGULAR, execution-context=UNSPECIFIED
    Icu_GetVersionInfo: service-id=0x12, is-reentrant=true, is-synchronous=true, call-type=REGULAR, execution-context=UNSPECIFIED
    ICU_EXT_IRQ_SINGLE_INTERRUPT: service-id=0, is-reentrant=false, is-synchronous=true, call-type=INTERRUPT, execution-context=INTERRUPT-CAT-2
    SIUL2_EXT_IRQ_0_7_ISR: service-id=0, is-reentrant=false, is-synchronous=true, call-type=INTERRUPT, execution-context=INTERRUPT-CAT-2
    SIUL2_EXT_IRQ_16_23_ISR: service-id=0, is-reentrant=false, is-synchronous=true, call-type=INTERRUPT, execution-context=INTERRUPT-CAT-2
    SIUL2_EXT_IRQ_24_31_ISR: service-id=0, is-reentrant=false, is-synchronous=true, call-type=INTERRUPT, execution-context=INTERRUPT-CAT-2
    SIUL2_EXT_IRQ_8_15_ISR: service-id=0, is-reentrant=false, is-synchronous=true, call-type=INTERRUPT, execution-context=INTERRUPT-CAT-2
package /Icu_T2D35M10I0R0/Implementations
  bsw implementation BswImplementation_0: programming-language=C, sw-version=1.0.0, vendor-id=43, ar-release-version=4.2.2, behavior=InternalBehavior_0, vendor-specific-module-def=Icu
    code-descriptors:
      code Files
        artifact-descriptors:
          short-label=config::Icu.xdm, category=SWCFG
          short-label=doc::AUTOSAR_MCAL_ICU_IM.pdf, category=SWDOC
          short-label=doc::AUTOSAR_MCAL_ICU_UM.pdf, category=SWDOC
          short-label=include::Icu.h, category=SWHDR
          short-label=include::Icu_eMios.h, category=SWHDR
          short-label=include::Icu_eMios_Irq.h, category=SWHDR
          short-label=include::Icu_eMios_Types.h, category=SWHDR
          short-label=include::Icu_EnvCfg.h, category=SWHDR
          short-label=include::Icu_Ipw.h, category=SWHDR
          short-label=include::Icu_Ipw_Irq.h, category=SWHDR
          short-label=include::Icu_Ipw_Types.h, category=SWHDR
          short-label=include::Icu_Irq.h, category=SWHDR
          short-label=include::Icu_Reg_eSys_Siul2.h, category=SWHDR
          short-label=include::Icu_Reg_eSys_Wkpu.h, category=SWHDR
          short-label=include::Icu_Siul2.h, category=SWHDR
          short-label=include::Icu_Siul2_Types.h, category=SWHDR
          short-label=include::Icu_Types.h, category=SWHDR
          short-label=include::Icu_Wkpu.h, category=SWHDR
          short-label=include::Icu_Wkpu_Types.h, category=SWHDR
          short-label=src::Icu.c, category=SWSRC
          short-label=src::Icu_eMios.c, category=SWSRC
          short-label=src::Icu_Ipw.c, category=SWSRC
          short-label=src::Icu_Siul2.c, category=SWSRC
          short-label=src::Icu_Siul2_Irq.c, category=SWSRC
          short-label=src::Icu_Wkpu.c, category=SWSRC
          short-label=src::Icu_Wkpu_Irq.c, category=SWSRC
    compiler DIAB_Compiler:
      name=Windriver Diab
      options=-tPPCE200Z4204N3VEN:simple -tPPCE200Z210N3VEN:simple -Xdialect-ansi -XO -g3 -Xsize-opt -Xsmall-data=0 -Xsmall-const=0 -Xaddr-sconst=0x11 -Xaddr-sdata=0x11 -Xno-common -Xnested-interrupts -Xdebug-dwarf2 -Xdebug-local-all -Xdebug-local-cie -Xdebug-struct-all -Xforce-declarations -ee1481 -Xmacro-undefined-warn -Xlink-time-lint -W:as:,-l -Wa,-Xisa-vle -DAUTOSAR_OS_NOT_USED -DUSE_SW_VECTOR_MODE -DDIAB -DDISABLE_MCAL_INTERMODULE_ASR_CHECK -c
      vendor=Windriver
      version=Windriver DIAB DIAB_5_9_6_2
    compiler GHS_Compiler:
      name=Green Hills
      options=-cpu=ppc5748gz4204 -cpu=ppc5748gz210 -ansi -noSPE -Ospace -sda=0 -vle -dual_debug -G --no_exceptions -Wundef -Wimplicit-int -Wshadow -Wtrigraphs --prototype_errors --incorrect_pragma_warnings -noslashcomment -preprocess_assembly_files -nostartfile --short_enum --diag_error 223 -DAUTOSAR_OS_NOT_USED -DUSE_SW_VECTOR_MODE -DDISABLE_MCAL_INTERMODULE_ASR_CHECK -DGHS -c
      vendor=Green Hills
      version=Green Hills Multi 7.1.4 / Compiler 2015.1.6
    generated-artifacts:
      4 x dependency on artifact, all with usages=COMPILE:
        Icu_Cfg_h: artifact-descriptor={short-label=generate::include::Icu_Cfg.h, category=SWHDR}
        Icu_DmaNotification_c: artifact-descriptor={short-label=generate::src::Icu_DmaNotification.c, category=SWSRC}
        Icu_PBcfg_c: artifact-descriptor={short-label=generate_PB::src::Icu_PBcfg.c, category=SWSRC}
        Icu_Cfg_c: artifact-descriptor={short-label=generate_PC::src::Icu_Cfg.c, category=SWSRC}
    linker DIAB_Linker: name=Windriver Diab, options=-tPPCE200Z4204N3VEN:simple -tPPCE200Z210N3VEN:simple -Xelf -m6 -Xlink-time-lint, vendor=Windriver, version=Windriver DIAB DIAB_5_9_6_2
    linker GHS_Linker: name=Green Hills, options=-cpu=ppc5748gz4204 -cpu=ppc5748gz210 -nostartfiles -vle --nocpp -Mn -delete -ignore_debug_references -keepmap, vendor=Green Hills, version=Green Hills Multi 7.1.4 / Compiler 2015.1.6
    resource consumption ResourceConsumption
      6 x memory section:
        ICU_CODE: alignment=UNSPECIFIED, sw-addrmethod=CODE, symbol=CODE
        ICU_CONFIG_DATA_UNSPECIFIED: alignment=UNSPECIFIED, sw-addrmethod=CONFIG_DATA_UNSPECIFIED, symbol=CONFIG_DATA_UNSPECIFIED
        ICU_VAR_INIT_32: alignment=32, sw-addrmethod=VAR_INIT_32, symbol=VAR_INIT_32
        ICU_VAR_INIT_UNSPECIFIED: alignment=UNSPECIFIED, sw-addrmethod=VAR_INIT_UNSPECIFIED, symbol=VAR_INIT_UNSPECIFIED
        ICU_VAR_NO_INIT_UNSPECIFIED: alignment=UNSPECIFIED, sw-addrmethod=VAR_NO_INIT_UNSPECIFIED, symbol=VAR_NO_INIT_UNSPECIFIED
        ICU_VAR_NO_INIT_UNSPECIFIED_NO_CACHEABLE: alignment=UNSPECIFIED, sw-addrmethod=VAR_NO_INIT_UNSPECIFIED_NO_CACHEABLE, symbol=VAR_NO_INIT_UNSPECIFIED_NO_CACHEABLE
