AUTOSAR XML (schema 4-0-3)
package /AUTOSAR_Gpt/BswModuleDescriptions
  bsw module description Gpt: module-id=100
    provided-entrys:
      Gpt_CheckWakeup
      Gpt_DeInit
      Gpt_DisableNotification
      Gpt_DisableWakeup
      Gpt_EnableNotification
      Gpt_EnableWakeup
      Gpt_GetTimeElapsed
      Gpt_GetTimeRemaining
      Gpt_GetVersionInfo
      Gpt_Init
      Gpt_SetMode
      Gpt_StartTimer
      Gpt_StopTimer
      Gpt_PIT_0_ISR
      Gpt_PIT_0_TIMER_0_ISR
      Gpt_PIT_0_TIMER_{10..15}_ISR
      Gpt_PIT_0_TIMER_{1..9}_ISR
      Gpt_PIT_0_TIMER_RTI_ISR
      Gpt_PIT_1_ISR
      Gpt_PIT_1_TIMER_0_ISR
      Gpt_PIT_1_TIMER_{10..15}_ISR
      Gpt_PIT_1_TIMER_{1..9}_ISR
      Gpt_PIT_1_TIMER_RTI_ISR
      Gpt_RTC_0_Ch_0_ISR
      Gpt_STM_0_Ch_{0..3}_ISR
      Gpt_STM_0_ISR
      Gpt_STM_1_Ch_{0..3}_ISR
      Gpt_STM_1_ISR
      Gpt_STM_2_Ch_{0..3}_ISR
      Gpt_STM_2_ISR
    bsw internal behavior InternalBehavior_0
      18 x exclusive area:
        GPT_EXCLUSIVE_AREA_{00..17}
      13 x bsw called entity:
        Gpt_CheckWakeup: implemented-entry=Gpt_CheckWakeup
        Gpt_DeInit: implemented-entry=Gpt_DeInit
        Gpt_DisableNotification: implemented-entry=Gpt_DisableNotification
        Gpt_DisableWakeup: implemented-entry=Gpt_DisableWakeup
        Gpt_EnableNotification: implemented-entry=Gpt_EnableNotification
        Gpt_EnableWakeup: implemented-entry=Gpt_EnableWakeup
        Gpt_GetTimeElapsed: implemented-entry=Gpt_GetTimeElapsed
        Gpt_GetTimeRemaining: implemented-entry=Gpt_GetTimeRemaining
        Gpt_GetVersionInfo: implemented-entry=Gpt_GetVersionInfo
        Gpt_Init: can-enter-exclusive-area=[GPT_EXCLUSIVE_AREA_00, GPT_EXCLUSIVE_AREA_01, GPT_EXCLUSIVE_AREA_02, GPT_EXCLUSIVE_AREA_03, GPT_EXCLUSIVE_AREA_04, GPT_EXCLUSIVE_AREA_05, GPT_EXCLUSIVE_AREA_06, GPT_EXCLUSIVE_AREA_07, GPT_EXCLUSIVE_AREA_08, GPT_EXCLUSIVE_AREA_09, GPT_EXCLUSIVE_AREA_10, GPT_EXCLUSIVE_AREA_11, GPT_EXCLUSIVE_AREA_12, GPT_EXCLUSIVE_AREA_13, GPT_EXCLUSIVE_AREA_14, GPT_EXCLUSIVE_AREA_15, GPT_EXCLUSIVE_AREA_16, GPT_EXCLUSIVE_AREA_17], implemented-entry=Gpt_Init
        Gpt_SetMode: implemented-entry=Gpt_SetMode
        Gpt_StartTimer: implemented-entry=Gpt_StartTimer
        Gpt_StopTimer: implemented-entry=Gpt_StopTimer
      52 x bsw interrupt entity, all with interrupt-category=CAT-2, interrupt-source=Hardware:
        Gpt_PIT_0_ISR: implemented-entry=Gpt_PIT_0_ISR
        Gpt_PIT_0_TIMER_0_ISR: implemented-entry=Gpt_PIT_0_TIMER_0_ISR
        Gpt_PIT_0_TIMER_{10..15}_ISR: implemented-entry=Gpt_PIT_0_TIMER_{10..15}_ISR
        Gpt_PIT_0_TIMER_{1..9}_ISR: implemented-entry=Gpt_PIT_0_TIMER_{1..9}_ISR
        Gpt_PIT_0_TIMER_RTI_ISR: implemented-entry=Gpt_PIT_0_TIMER_RTI_ISR
        Gpt_PIT_1_ISR: implemented-entry=Gpt_PIT_1_ISR
        Gpt_PIT_1_TIMER_0_ISR: implemented-entry=Gpt_PIT_1_TIMER_0_ISR
        Gpt_PIT_1_TIMER_{10..15}_ISR: implemented-entry=Gpt_PIT_1_TIMER_{10..15}_ISR
        Gpt_PIT_1_TIMER_{1..9}_ISR: implemented-entry=Gpt_PIT_1_TIMER_{1..9}_ISR
        Gpt_PIT_1_TIMER_RTI_ISR: implemented-entry=Gpt_PIT_1_TIMER_RTI_ISR
        Gpt_RTC_0_Ch_0_ISR: implemented-entry=Gpt_RTC_0_Ch_0_ISR
        Gpt_STM_0_Ch_{0..3}_ISR: implemented-entry=Gpt_STM_0_Ch_{0..3}_ISR
        Gpt_STM_0_ISR: implemented-entry=Gpt_STM_0_ISR
        Gpt_STM_1_Ch_{0..3}_ISR: implemented-entry=Gpt_STM_1_Ch_{0..3}_ISR
        Gpt_STM_1_ISR: implemented-entry=Gpt_STM_1_ISR
        Gpt_STM_2_Ch_{0..3}_ISR: implemented-entry=Gpt_STM_2_Ch_{0..3}_ISR
        Gpt_STM_2_ISR: implemented-entry=Gpt_STM_2_ISR
package /AUTOSAR_Gpt/BswModuleEntrys
  65 x bsw module entry, all with is-synchronous=true, sw-service-impl-policy=STANDARD:
    Gpt_CheckWakeup: service-id=0x0c, is-reentrant=true, call-type=REGULAR, execution-context=UNSPECIFIED
    Gpt_DeInit: service-id=0x02, is-reentrant=true, call-type=REGULAR, execution-context=UNSPECIFIED
    Gpt_DisableNotification: service-id=0x08, is-reentrant=true, call-type=REGULAR, execution-context=UNSPECIFIED
    Gpt_DisableWakeup: service-id=0x0a, is-reentrant=true, call-type=REGULAR, execution-context=UNSPECIFIED
    Gpt_EnableNotification: service-id=0x07, is-reentrant=true, call-type=REGULAR, execution-context=UNSPECIFIED
    Gpt_EnableWakeup: service-id=0x0b, is-reentrant=true, call-type=REGULAR, execution-context=UNSPECIFIED
    Gpt_GetTimeElapsed: service-id=0x03, is-reentrant=true, call-type=REGULAR, execution-context=UNSPECIFIED
    Gpt_GetTimeRemaining: service-id=0x04, is-reentrant=true, call-type=REGULAR, execution-context=UNSPECIFIED
    Gpt_GetVersionInfo: service-id=0x00, is-reentrant=true, call-type=REGULAR, execution-context=UNSPECIFIED
    Gpt_Init: service-id=0x01, is-reentrant=false, call-type=REGULAR, execution-context=UNSPECIFIED
    Gpt_SetMode: service-id=0x09, is-reentrant=false, call-type=REGULAR, execution-context=UNSPECIFIED
    Gpt_StartTimer: service-id=0x05, is-reentrant=true, call-type=REGULAR, execution-context=UNSPECIFIED
    Gpt_StopTimer: service-id=0x06, is-reentrant=true, call-type=REGULAR, execution-context=UNSPECIFIED
    Gpt_PIT_0_ISR: service-id=0, is-reentrant=false, call-type=INTERRUPT, execution-context=INTERRUPT-CAT-2
    Gpt_PIT_0_TIMER_0_ISR: service-id=0, is-reentrant=false, call-type=INTERRUPT, execution-context=INTERRUPT-CAT-2
    Gpt_PIT_0_TIMER_{10..15}_ISR: service-id=0, is-reentrant=false, call-type=INTERRUPT, execution-context=INTERRUPT-CAT-2
    Gpt_PIT_0_TIMER_{1..9}_ISR: service-id=0, is-reentrant=false, call-type=INTERRUPT, execution-context=INTERRUPT-CAT-2
    Gpt_PIT_0_TIMER_RTI_ISR: service-id=0, is-reentrant=false, call-type=INTERRUPT, execution-context=INTERRUPT-CAT-2
    Gpt_PIT_1_ISR: service-id=0, is-reentrant=false, call-type=INTERRUPT, execution-context=INTERRUPT-CAT-2
    Gpt_PIT_1_TIMER_0_ISR: service-id=0, is-reentrant=false, call-type=INTERRUPT, execution-context=INTERRUPT-CAT-2
    Gpt_PIT_1_TIMER_{10..15}_ISR: service-id=0, is-reentrant=false, call-type=INTERRUPT, execution-context=INTERRUPT-CAT-2
    Gpt_PIT_1_TIMER_{1..9}_ISR: service-id=0, is-reentrant=false, call-type=INTERRUPT, execution-context=INTERRUPT-CAT-2
    Gpt_PIT_1_TIMER_RTI_ISR: service-id=0, is-reentrant=false, call-type=INTERRUPT, execution-context=INTERRUPT-CAT-2
    Gpt_RTC_0_Ch_0_ISR: service-id=0, is-reentrant=false, call-type=INTERRUPT, execution-context=INTERRUPT-CAT-2
    Gpt_STM_0_Ch_{0..3}_ISR: service-id=0, is-reentrant=false, call-type=INTERRUPT, execution-context=INTERRUPT-CAT-2
    Gpt_STM_0_ISR: service-id=0, is-reentrant=false, call-type=INTERRUPT, execution-context=INTERRUPT-CAT-2
    Gpt_STM_1_Ch_{0..3}_ISR: service-id=0, is-reentrant=false, call-type=INTERRUPT, execution-context=INTERRUPT-CAT-2
    Gpt_STM_1_ISR: service-id=0, is-reentrant=false, call-type=INTERRUPT, execution-context=INTERRUPT-CAT-2
    Gpt_STM_2_Ch_{0..3}_ISR: service-id=0, is-reentrant=false, call-type=INTERRUPT, execution-context=INTERRUPT-CAT-2
    Gpt_STM_2_ISR: service-id=0, is-reentrant=false, call-type=INTERRUPT, execution-context=INTERRUPT-CAT-2
package /Gpt_T2D35M10I0R0/Implementations
  bsw implementation BswImplementation_0: programming-language=C, sw-version=1.0.0, vendor-id=43, ar-release-version=4.2.2, behavior=InternalBehavior_0, vendor-specific-module-def=Gpt
    code-descriptors:
      code Files
        artifact-descriptors:
          short-label=config::Gpt.xdm, category=SWCFG
          short-label=doc::AUTOSAR_MCAL_GPT_IM.pdf, category=SWDOC
          short-label=doc::AUTOSAR_MCAL_GPT_UM.pdf, category=SWDOC
          short-label=include::Gpt.h, category=SWHDR
          short-label=include::Gpt_eMios.h, category=SWHDR
          short-label=include::Gpt_eMios_Irq.h, category=SWHDR
          short-label=include::Gpt_eMios_Types.h, category=SWHDR
          short-label=include::Gpt_EnvCfg.h, category=SWHDR
          short-label=include::Gpt_Ipw.h, category=SWHDR
          short-label=include::Gpt_Ipw_Irq.h, category=SWHDR
          short-label=include::Gpt_Ipw_Types.h, category=SWHDR
          short-label=include::Gpt_Irq.h, category=SWHDR
          short-label=include::Gpt_Pit.h, category=SWHDR
          short-label=include::Gpt_Pit_Types.h, category=SWHDR
          short-label=include::Gpt_Rtc.h, category=SWHDR
          short-label=include::Gpt_Rtc_Types.h, category=SWHDR
          short-label=include::Gpt_Stm.h, category=SWHDR
          short-label=include::Gpt_Stm_Types.h, category=SWHDR
          short-label=include::Reg_eSys_Pit.h, category=SWHDR
          short-label=include::Reg_eSys_Rtc.h, category=SWHDR
          short-label=include::Reg_eSys_Stm.h, category=SWHDR
          short-label=src::Gpt.c, category=SWSRC
          short-label=src::Gpt_eMios.c, category=SWSRC
          short-label=src::Gpt_eMios_Irq.c, category=SWSRC
          short-label=src::Gpt_Ipw.c, category=SWSRC
          short-label=src::Gpt_Pit.c, category=SWSRC
          short-label=src::Gpt_Rtc.c, category=SWSRC
          short-label=src::Gpt_Stm.c, category=SWSRC
    compiler DIAB_Compiler:
      name=Windriver Diab
      options=-tPPCE200Z4204N3VEN:simple -tPPCE200Z210N3VEN:simple -Xdialect-ansi -XO -g3 -Xsize-opt -Xsmall-data=0 -Xsmall-const=0 -Xaddr-sconst=0x11 -Xaddr-sdata=0x11 -Xno-common -Xnested-interrupts -Xdebug-dwarf2 -Xdebug-local-all -Xdebug-local-cie -Xdebug-struct-all -Xforce-declarations -ee1481 -Xmacro-undefined-warn -Xlink-time-lint -W:as:,-l -Wa,-Xisa-vle -DAUTOSAR_OS_NOT_USED -DUSE_SW_VECTOR_MODE -DDIAB -DDISABLE_MCAL_INTERMODULE_ASR_CHECK -c
      vendor=Windriver
      version=Windriver DIAB DIAB_5_9_6_2
    compiler GHS_Compiler:
      name=Green Hills
      options=-cpu=ppc5748gz4204 -cpu=ppc5748gz210 -ansi -noSPE -Ospace -sda=0 -vle -dual_debug -G --no_exceptions -Wundef -Wimplicit-int -Wshadow -Wtrigraphs --prototype_errors --incorrect_pragma_warnings -noslashcomment -preprocess_assembly_files -nostartfile --short_enum --diag_error 223 -DAUTOSAR_OS_NOT_USED -DUSE_SW_VECTOR_MODE -DDISABLE_MCAL_INTERMODULE_ASR_CHECK -DGHS -c
      vendor=Green Hills
      version=Green Hills Multi 7.1.4 / Compiler 2015.1.6
    generated-artifacts:
      dependency on artifact Gpt_PBcfg_c: artifact-descriptor={short-label=generate_PB::src::Gpt_PBcfg.c, category=SWSRC}, usages=COMPILE
      dependency on artifact Gpt_Cfg_h: artifact-descriptor={short-label=generate_PC::include::Gpt_Cfg.h, category=SWHDR}, usages=COMPILE
      dependency on artifact Gpt_Cfg_c: artifact-descriptor={short-label=generate_PC::src::Gpt_Cfg.c, category=SWSRC}, usages=COMPILE
    linker DIAB_Linker: name=Windriver Diab, options=-tPPCE200Z4204N3VEN:simple -tPPCE200Z210N3VEN:simple -Xelf -m6 -Xlink-time-lint, vendor=Windriver, version=Windriver DIAB DIAB_5_9_6_2
    linker GHS_Linker: name=Green Hills, options=-cpu=ppc5748gz4204 -cpu=ppc5748gz210 -nostartfiles -vle --nocpp -Mn -delete -ignore_debug_references -keepmap, vendor=Green Hills, version=Green Hills Multi 7.1.4 / Compiler 2015.1.6
    resource consumption ResourceConsumption
      7 x memory section:
        GPT_CODE: alignment=UNSPECIFIED, sw-addrmethod=CODE, symbol=CODE
        GPT_CONFIG_DATA_UNSPECIFIED: alignment=UNSPECIFIED, sw-addrmethod=CONFIG_DATA_UNSPECIFIED, symbol=CONFIG_DATA_UNSPECIFIED
        GPT_CONST_32: alignment=32, sw-addrmethod=CONST_32, symbol=CONST_32
        GPT_VAR_INIT_32: alignment=32, sw-addrmethod=VAR_INIT_32, symbol=VAR_INIT_32
        GPT_VAR_INIT_UNSPECIFIED: alignment=UNSPECIFIED, sw-addrmethod=VAR_INIT_UNSPECIFIED, symbol=VAR_INIT_UNSPECIFIED
        GPT_VAR_NO_INIT_32: alignment=32, sw-addrmethod=VAR_NO_INIT_32, symbol=VAR_NO_INIT_32
        GPT_VAR_NO_INIT_UNSPECIFIED: alignment=UNSPECIFIED, sw-addrmethod=VAR_NO_INIT_UNSPECIFIED, symbol=VAR_NO_INIT_UNSPECIFIED
