AUTOSAR XML (schema 4-0-3)
package /AUTOSAR_Can/BswModuleDescriptions
  bsw module description Can: module-id=80
    provided-entrys:
      Can_AbortMb
      Can_ChangeBaudrate
      Can_CheckBaudrate
      Can_CheckWakeup
      Can_DisableControllerInterrupts
      Can_DummyRead
      Can_EnableControllerInterrupts
      Can_FlexCan_MainFunctionMultipleReadPoll
      Can_FlexCan_MainFunctionMultipleWritePoll
      Can_GetVersionInfo
      Can_Init
      Can_MainFunction_BusOff
      Can_MainFunction_CheckMRAF
      Can_MainFunction_Mode
      Can_MainFunction_Read
      Can_MainFunction_Read_0
      Can_MainFunction_Read_1
      Can_MainFunction_Read_10
      Can_MainFunction_Read_{2..9}
      Can_MainFunction_Write
      Can_MainFunction_Write_0
      Can_MainFunction_Write_1
      Can_MainFunction_Write_10
      Can_MainFunction_Write_{2..9}
      Can_SetClockMode
      Can_SetControllerMode
      Can_Write
      Can_MainFunction_Wakeup
    bsw internal behavior InternalBehavior_0
      10 x exclusive area:
        CAN_EXCLUSIVE_AREA_{00..02}
        CAN_EXCLUSIVE_AREA_{04..08}
        CAN_EXCLUSIVE_AREA_11
        CAN_EXCLUSIVE_AREA_13
      41 x bsw called entity:
        Can_AbortMb: implemented-entry=Can_AbortMb
        Can_ChangeBaudrate: implemented-entry=Can_ChangeBaudrate
        Can_CheckBaudrate: implemented-entry=Can_CheckBaudrate
        Can_CheckWakeup: implemented-entry=Can_CheckWakeup
        Can_DisableControllerInterrupts: implemented-entry=Can_DisableControllerInterrupts
        Can_DummyRead: implemented-entry=Can_DummyRead
        Can_EnableControllerInterrupts: implemented-entry=Can_EnableControllerInterrupts
        Can_FlexCan_MainFunctionMultipleReadPoll: implemented-entry=Can_FlexCan_MainFunctionMultipleReadPoll
        Can_FlexCan_MainFunctionMultipleWritePoll: implemented-entry=Can_FlexCan_MainFunctionMultipleWritePoll
        Can_GetVersionInfo: implemented-entry=Can_GetVersionInfo
        Can_Init: can-enter-exclusive-area=[CAN_EXCLUSIVE_AREA_00, CAN_EXCLUSIVE_AREA_01, CAN_EXCLUSIVE_AREA_02, CAN_EXCLUSIVE_AREA_04, CAN_EXCLUSIVE_AREA_05, CAN_EXCLUSIVE_AREA_06, CAN_EXCLUSIVE_AREA_07, CAN_EXCLUSIVE_AREA_08, CAN_EXCLUSIVE_AREA_11, CAN_EXCLUSIVE_AREA_13], implemented-entry=Can_Init
        Can_MainFunction_BusOff: implemented-entry=Can_MainFunction_BusOff
        Can_MainFunction_CheckMRAF: implemented-entry=Can_MainFunction_CheckMRAF
        Can_MainFunction_Mode: implemented-entry=Can_MainFunction_Mode
        Can_MainFunction_Read: implemented-entry=Can_MainFunction_Read
        Can_MainFunction_Read_0: implemented-entry=Can_MainFunction_Read_0
        Can_MainFunction_Read_1: implemented-entry=Can_MainFunction_Read_1
        Can_MainFunction_Read_10: implemented-entry=Can_MainFunction_Read_10
        Can_MainFunction_Read_{2..9}: implemented-entry=Can_MainFunction_Read_{2..9}
        Can_MainFunction_Write: implemented-entry=Can_MainFunction_Write
        Can_MainFunction_Write_0: implemented-entry=Can_MainFunction_Write_0
        Can_MainFunction_Write_1: implemented-entry=Can_MainFunction_Write_1
        Can_MainFunction_Write_10: implemented-entry=Can_MainFunction_Write_10
        Can_MainFunction_Write_{2..9}: implemented-entry=Can_MainFunction_Write_{2..9}
        Can_SetClockMode: implemented-entry=Can_SetClockMode
        Can_SetControllerMode: implemented-entry=Can_SetControllerMode
        Can_Write: implemented-entry=Can_Write
      bsw schedulable entity Can_MainFunction_Wakeup: implemented-entry=Can_MainFunction_Wakeup
      30 x bsw timing event:
        CanFlexCanMultipleReadPollTimingEvent_MainFunction: starts-on-event=Can_FlexCan_MainFunctionMultipleReadPoll, period=CanFlexCanMainFunctionMultipleReadPollPeriod
        CanFlexCanMultipleWritePollTimingEvent_MainFunction: starts-on-event=Can_FlexCan_MainFunctionMultipleWritePoll, period=CanFlexCanMainFunctionMultipleWritePollPeriod
        CanBusOffTimingEvent_MainFunction: starts-on-event=Can_MainFunction_BusOff, period=CanMainFunctionBusOffPeriod
        CanCheckMRAFTimingEvent_MainFunction: starts-on-event=Can_MainFunction_CheckMRAF, period=CanMainFunctionCheckMRAFPeriod
        CanModeTimingEvent_MainFunction: starts-on-event=Can_MainFunction_Mode, period=CanMainFunctionModePeriod
        CanReadTimingEvent_MainFunction: starts-on-event=Can_MainFunction_Read, period=CanMainFunctionReadPeriod
        CanRead0TimingEvent_MainFunction: starts-on-event=Can_MainFunction_Read_0, period=CanMainFunctionRead0Period
        CanRead1TimingEvent_MainFunction: starts-on-event=Can_MainFunction_Read_1, period=CanMainFunctionRead1Period
        CanRead10TimingEvent_MainFunction: starts-on-event=Can_MainFunction_Read_10, period=CanMainFunctionRead10Period
        CanRead{2..9}TimingEvent_MainFunction: starts-on-event=Can_MainFunction_Read_{2..9}, period=CanMainFunctionRead{2..9}Period
        CanWriteTimingEvent_MainFunction: starts-on-event=Can_MainFunction_Write, period=CanMainFunctionWritePeriod
        CanWrite0TimingEvent_MainFunction: starts-on-event=Can_MainFunction_Write_0, period=CanMainFunctionWrite0Period
        CanWrite1TimingEvent_MainFunction: starts-on-event=Can_MainFunction_Write_1, period=CanMainFunctionWrite1Period
        CanWrite10TimingEvent_MainFunction: starts-on-event=Can_MainFunction_Write_10, period=CanMainFunctionWrite10Period
        CanWrite{2..9}TimingEvent_MainFunction: starts-on-event=Can_MainFunction_Write_{2..9}, period=CanMainFunctionWrite{2..9}Period
        CanWakeupTimingEvent_MainFunction: starts-on-event=Can_MainFunction_Wakeup, period=CanMainFunctionWakeupPeriod
package /AUTOSAR_Can/BswModuleEntrys
  42 x bsw module entry, all with sw-service-impl-policy=STANDARD:
    Can_AbortMb: service-id=0, is-reentrant=false, is-synchronous=true, call-type=REGULAR, execution-context=UNSPECIFIED
    Can_ChangeBaudrate: service-id=0x0d, is-reentrant=false, is-synchronous=true, call-type=REGULAR, execution-context=UNSPECIFIED
    Can_CheckBaudrate: service-id=0x0e, is-reentrant=true, is-synchronous=true, call-type=REGULAR, execution-context=UNSPECIFIED
    Can_CheckWakeup: service-id=0x0b, is-reentrant=false, is-synchronous=true, call-type=REGULAR, execution-context=UNSPECIFIED
    Can_DisableControllerInterrupts: service-id=0x04, is-reentrant=true, is-synchronous=true, call-type=REGULAR, execution-context=UNSPECIFIED
    Can_DummyRead: service-id=0, is-reentrant=false, is-synchronous=true, call-type=REGULAR, execution-context=UNSPECIFIED
    Can_EnableControllerInterrupts: service-id=0x05, is-reentrant=true, is-synchronous=true, call-type=REGULAR, execution-context=UNSPECIFIED
    Can_FlexCan_MainFunctionMultipleReadPoll: service-id=0, is-reentrant=false, is-synchronous=true, call-type=SCHEDULED, execution-context=TASK
    Can_FlexCan_MainFunctionMultipleWritePoll: service-id=0, is-reentrant=false, is-synchronous=true, call-type=SCHEDULED, execution-context=TASK
    Can_GetVersionInfo: service-id=0x07, is-reentrant=true, is-synchronous=true, call-type=REGULAR, execution-context=UNSPECIFIED
    Can_Init: service-id=0x00, is-reentrant=false, is-synchronous=true, call-type=REGULAR, execution-context=UNSPECIFIED
    Can_MainFunction_BusOff: service-id=0x09, is-reentrant=false, is-synchronous=true, call-type=SCHEDULED, execution-context=TASK
    Can_MainFunction_CheckMRAF: service-id=0, is-reentrant=false, is-synchronous=true, call-type=SCHEDULED, execution-context=TASK
    Can_MainFunction_Mode: service-id=0x0c, is-reentrant=false, is-synchronous=true, call-type=SCHEDULED, execution-context=TASK
    Can_MainFunction_Read: service-id=0x08, is-reentrant=false, is-synchronous=true, call-type=SCHEDULED, execution-context=TASK
    Can_MainFunction_Read_0: service-id=0, is-reentrant=false, is-synchronous=true, call-type=SCHEDULED, execution-context=TASK
    Can_MainFunction_Read_1: service-id=0, is-reentrant=false, is-synchronous=true, call-type=SCHEDULED, execution-context=TASK
    Can_MainFunction_Read_10: service-id=0, is-reentrant=false, is-synchronous=true, call-type=SCHEDULED, execution-context=TASK
    Can_MainFunction_Read_{2..9}: service-id=0, is-reentrant=false, is-synchronous=true, call-type=SCHEDULED, execution-context=TASK
    Can_MainFunction_Write: service-id=0x01, is-reentrant=false, is-synchronous=true, call-type=SCHEDULED, execution-context=TASK
    Can_MainFunction_Write_0: service-id=0, is-reentrant=false, is-synchronous=true, call-type=SCHEDULED, execution-context=TASK
    Can_MainFunction_Write_1: service-id=0, is-reentrant=false, is-synchronous=true, call-type=SCHEDULED, execution-context=TASK
    Can_MainFunction_Write_10: service-id=0, is-reentrant=false, is-synchronous=true, call-type=SCHEDULED, execution-context=TASK
    Can_MainFunction_Write_{2..9}: service-id=0, is-reentrant=false, is-synchronous=true, call-type=SCHEDULED, execution-context=TASK
    Can_SetClockMode: service-id=0, is-reentrant=false, is-synchronous=true, call-type=REGULAR, execution-context=UNSPECIFIED
    Can_SetControllerMode: service-id=0x03, is-reentrant=false, is-synchronous=false, call-type=REGULAR, execution-context=UNSPECIFIED
    Can_Write: service-id=0x06, is-reentrant=true, is-synchronous=true, call-type=REGULAR, execution-context=UNSPECIFIED
    Can_MainFunction_Wakeup: service-id=0x0a, is-reentrant=false, is-synchronous=true, call-type=SCHEDULED, execution-context=TASK
package /Can_T2D35M10I0R0/Implementations
  bsw implementation BswImplementation_0: programming-language=C, sw-version=1.0.0, vendor-id=43, ar-release-version=4.2.2, behavior=InternalBehavior_0, vendor-specific-module-def=Can
    code-descriptors:
      code Files
        artifact-descriptors:
          short-label=config::Can.xdm, category=SWCFG
          short-label=doc::AUTOSAR_MCAL_CAN_IM.pdf, category=SWDOC
          short-label=doc::AUTOSAR_MCAL_CAN_UM.pdf, category=SWDOC
          short-label=include::Can.h, category=SWHDR
          short-label=include::Can_Flexcan.h, category=SWHDR
          short-label=include::Can_IPW.h, category=SWHDR
          short-label=include::Reg_eSys_FlexCan.h, category=SWHDR
          short-label=src::Can.c, category=SWSRC
          short-label=src::Can_Flexcan.c, category=SWSRC
          short-label=src::Can_Irq.c, category=SWSRC
    compiler DIAB_Compiler:
      name=Windriver Diab
      options=-tPPCE200Z4204N3VEN:simple -tPPCE200Z210N3VEN:simple -Xdialect-ansi -XO -g3 -Xsize-opt -Xsmall-data=0 -Xsmall-const=0 -Xaddr-sconst=0x11 -Xaddr-sdata=0x11 -Xno-common -Xnested-interrupts -Xdebug-dwarf2 -Xdebug-local-all -Xdebug-local-cie -Xdebug-struct-all -Xforce-declarations -ee1481 -Xmacro-undefined-warn -Xlink-time-lint -W:as:,-l -Wa,-Xisa-vle -DAUTOSAR_OS_NOT_USED -DUSE_SW_VECTOR_MODE -DDIAB -DDISABLE_MCAL_INTERMODULE_ASR_CHECK -c
      vendor=Windriver
      version=Windriver DIAB DIAB_5_9_6_2
    compiler GHS_Compiler:
      name=Green Hills
      options=-cpu=ppc5748gz4204 -cpu=ppc5748gz210 -ansi -noSPE -Ospace -sda=0 -vle -dual_debug -G --no_exceptions -Wundef -Wimplicit-int -Wshadow -Wtrigraphs --prototype_errors --incorrect_pragma_warnings -noslashcomment -preprocess_assembly_files -nostartfile --short_enum --diag_error 223 -DAUTOSAR_OS_NOT_USED -DUSE_SW_VECTOR_MODE -DDISABLE_MCAL_INTERMODULE_ASR_CHECK -DGHS -c
      vendor=Green Hills
      version=Green Hills Multi 7.1.4 / Compiler 2015.1.6
    generated-artifacts:
      dependency on artifact Can_PBcfg_c: artifact-descriptor={short-label=generate_PB::src::Can_PBcfg.c, category=SWSRC}, usages=COMPILE
      dependency on artifact Can_Cfg_h: artifact-descriptor={short-label=generate_PC::include::Can_Cfg.h, category=SWHDR}, usages=COMPILE
      dependency on artifact Can_Cfg_c: artifact-descriptor={short-label=generate_PC::src::Can_Cfg.c, category=SWSRC}, usages=COMPILE
    linker DIAB_Linker: name=Windriver Diab, options=-tPPCE200Z4204N3VEN:simple -tPPCE200Z210N3VEN:simple -Xelf -m6 -Xlink-time-lint, vendor=Windriver, version=Windriver DIAB DIAB_5_9_6_2
    linker GHS_Linker: name=Green Hills, options=-cpu=ppc5748gz4204 -cpu=ppc5748gz210 -nostartfiles -vle --nocpp -Mn -delete -ignore_debug_references -keepmap, vendor=Green Hills, version=Green Hills Multi 7.1.4 / Compiler 2015.1.6
    resource consumption ResourceConsumption
