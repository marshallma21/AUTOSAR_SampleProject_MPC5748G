AUTOSAR XML (schema 4-0-3)
package /AUTOSAR_Fr/BswModuleDescriptions
  bsw module description Fr: module-id=81
    provided-entrys:
      Fr_AbortCommunication
      Fr_AckAbsoluteTimerIRQ
      Fr_AllowColdstart
      Fr_AllSlots
      Fr_CancelAbsoluteTimer
      Fr_CancelTxLPdu
      Fr_CheckTxLPduStatus
      Fr_ControllerInit
      Fr_DisableAbsoluteTimerIRQ
      Fr_DisableLPdu
      Fr_EnableAbsoluteTimerIRQ
      Fr_GetAbsoluteTimerIRQStatus
      Fr_GetChannelStatus
      Fr_GetClockCorrection
      Fr_GetGlobalTime
      Fr_GetNmVector
      Fr_GetNumOfStartupFrames
      Fr_GetPOCStatus
      Fr_GetSyncFrameList
      Fr_GetVersionInfo
      Fr_GetWakeupRxStatus
      Fr_HaltCommunication
      Fr_Init
      Fr_PrepareLPdu
      Fr_ReadCCConfig
      Fr_ReceiveRxLPdu
      Fr_ReconfigLPdu
      Fr_SendWUP
      Fr_SetAbsoluteTimer
      Fr_SetWakeupChannel
      Fr_StartCommunication
      Fr_TransmitTxLPdu
    bsw internal behavior InternalBehavior_0
      14 x exclusive area:
        FR_EXCLUSIVE_AREA_{00..13}
      32 x bsw called entity:
        Fr_AbortCommunication: implemented-entry=Fr_AbortCommunication
        Fr_AckAbsoluteTimerIRQ: implemented-entry=Fr_AckAbsoluteTimerIRQ
        Fr_AllowColdstart: implemented-entry=Fr_AllowColdstart
        Fr_AllSlots: implemented-entry=Fr_AllSlots
        Fr_CancelAbsoluteTimer: implemented-entry=Fr_CancelAbsoluteTimer
        Fr_CancelTxLPdu: implemented-entry=Fr_CancelTxLPdu
        Fr_CheckTxLPduStatus: implemented-entry=Fr_CheckTxLPduStatus
        Fr_ControllerInit: implemented-entry=Fr_ControllerInit
        Fr_DisableAbsoluteTimerIRQ: implemented-entry=Fr_DisableAbsoluteTimerIRQ
        Fr_DisableLPdu: implemented-entry=Fr_DisableLPdu
        Fr_EnableAbsoluteTimerIRQ: implemented-entry=Fr_EnableAbsoluteTimerIRQ
        Fr_GetAbsoluteTimerIRQStatus: implemented-entry=Fr_GetAbsoluteTimerIRQStatus
        Fr_GetChannelStatus: implemented-entry=Fr_GetChannelStatus
        Fr_GetClockCorrection: implemented-entry=Fr_GetClockCorrection
        Fr_GetGlobalTime: implemented-entry=Fr_GetGlobalTime
        Fr_GetNmVector: implemented-entry=Fr_GetNmVector
        Fr_GetNumOfStartupFrames: implemented-entry=Fr_GetNumOfStartupFrames
        Fr_GetPOCStatus: implemented-entry=Fr_GetPOCStatus
        Fr_GetSyncFrameList: implemented-entry=Fr_GetSyncFrameList
        Fr_GetVersionInfo: implemented-entry=Fr_GetVersionInfo
        Fr_GetWakeupRxStatus: implemented-entry=Fr_GetWakeupRxStatus
        Fr_HaltCommunication: implemented-entry=Fr_HaltCommunication
        Fr_Init: can-enter-exclusive-area=[FR_EXCLUSIVE_AREA_00, FR_EXCLUSIVE_AREA_01, FR_EXCLUSIVE_AREA_02, FR_EXCLUSIVE_AREA_03, FR_EXCLUSIVE_AREA_04, FR_EXCLUSIVE_AREA_05, FR_EXCLUSIVE_AREA_06, FR_EXCLUSIVE_AREA_07, FR_EXCLUSIVE_AREA_08, FR_EXCLUSIVE_AREA_09, FR_EXCLUSIVE_AREA_10, FR_EXCLUSIVE_AREA_11, FR_EXCLUSIVE_AREA_12, FR_EXCLUSIVE_AREA_13], implemented-entry=Fr_Init
        Fr_PrepareLPdu: implemented-entry=Fr_PrepareLPdu
        Fr_ReadCCConfig: implemented-entry=Fr_ReadCCConfig
        Fr_ReceiveRxLPdu: implemented-entry=Fr_ReceiveRxLPdu
        Fr_ReconfigLPdu: implemented-entry=Fr_ReconfigLPdu
        Fr_SendWUP: implemented-entry=Fr_SendWUP
        Fr_SetAbsoluteTimer: implemented-entry=Fr_SetAbsoluteTimer
        Fr_SetWakeupChannel: implemented-entry=Fr_SetWakeupChannel
        Fr_StartCommunication: implemented-entry=Fr_StartCommunication
        Fr_TransmitTxLPdu: implemented-entry=Fr_TransmitTxLPdu
package /AUTOSAR_Fr/BswModuleEntrys
  32 x bsw module entry, all with is-reentrant=false, call-type=REGULAR, execution-context=UNSPECIFIED, sw-service-impl-policy=STANDARD:
    Fr_AbortCommunication: service-id=0x05, is-synchronous=true
    Fr_AckAbsoluteTimerIRQ: service-id=0x17, is-synchronous=true
    Fr_AllowColdstart: service-id=0x23, is-synchronous=false
    Fr_AllSlots: service-id=0x24, is-synchronous=false
    Fr_CancelAbsoluteTimer: service-id=0x13, is-synchronous=true
    Fr_CancelTxLPdu: service-id=0x2d, is-synchronous=true
    Fr_CheckTxLPduStatus: service-id=0x0d, is-synchronous=true
    Fr_ControllerInit: service-id=0x00, is-synchronous=true
    Fr_DisableAbsoluteTimerIRQ: service-id=0x19, is-synchronous=true
    Fr_DisableLPdu: service-id=0x26, is-synchronous=true
    Fr_EnableAbsoluteTimerIRQ: service-id=0x15, is-synchronous=true
    Fr_GetAbsoluteTimerIRQStatus: service-id=0x20, is-synchronous=true
    Fr_GetChannelStatus: service-id=0x28, is-synchronous=true
    Fr_GetClockCorrection: service-id=0x29, is-synchronous=true
    Fr_GetGlobalTime: service-id=0x10, is-synchronous=true
    Fr_GetNmVector: service-id=0x22, is-synchronous=true
    Fr_GetNumOfStartupFrames: service-id=0x27, is-synchronous=true
    Fr_GetPOCStatus: service-id=0x0a, is-synchronous=true
    Fr_GetSyncFrameList: service-id=0x2a, is-synchronous=true
    Fr_GetVersionInfo: service-id=0x1b, is-synchronous=true
    Fr_GetWakeupRxStatus: service-id=0x2b, is-synchronous=true
    Fr_HaltCommunication: service-id=0x04, is-synchronous=false
    Fr_Init: service-id=0x1c, is-synchronous=true
    Fr_PrepareLPdu: service-id=0x1f, is-synchronous=true
    Fr_ReadCCConfig: service-id=0x2e, is-synchronous=true
    Fr_ReceiveRxLPdu: service-id=0x0c, is-synchronous=true
    Fr_ReconfigLPdu: service-id=0x25, is-synchronous=true
    Fr_SendWUP: service-id=0x06, is-synchronous=false
    Fr_SetAbsoluteTimer: service-id=0x11, is-synchronous=true
    Fr_SetWakeupChannel: service-id=0x07, is-synchronous=true
    Fr_StartCommunication: service-id=0x03, is-synchronous=false
    Fr_TransmitTxLPdu: service-id=0x0b, is-synchronous=false
package /Fr_T2D35M10I0R0/Implementations
  bsw implementation BswImplementation_0: programming-language=C, sw-version=1.0.0, vendor-id=43, ar-release-version=4.2.2, behavior=InternalBehavior_0, vendor-specific-module-def=Fr
    code-descriptors:
      code Files
        artifact-descriptors:
          short-label=config::Fr.xdm, category=SWCFG
          short-label=doc::AUTOSAR_MCAL_FR_IM.pdf, category=SWDOC
          short-label=doc::AUTOSAR_MCAL_FR_UM.pdf, category=SWDOC
          short-label=include::Fr.h, category=SWHDR
          short-label=include::Fr_Flexray.h, category=SWHDR
          short-label=include::Fr_IPW.h, category=SWHDR
          short-label=src::Fr.c, category=SWSRC
          short-label=src::Fr_Flexray.c, category=SWSRC
          short-label=src::Fr_IPW.c, category=SWSRC
    compiler DIAB_Compiler:
      name=Windriver Diab
      options=-tPPCE200Z4204N3VEN:simple -tPPCE200Z210N3VEN:simple -Xdialect-ansi -XO -g3 -Xsize-opt -Xsmall-data=0 -Xsmall-const=0 -Xaddr-sconst=0x11 -Xaddr-sdata=0x11 -Xno-common -Xnested-interrupts -Xdebug-dwarf2 -Xdebug-local-all -Xdebug-local-cie -Xdebug-struct-all -Xforce-declarations -ee1481 -Xmacro-undefined-warn -Xlink-time-lint -W:as:,-l -Wa,-Xisa-vle -DAUTOSAR_OS_NOT_USED -DUSE_SW_VECTOR_MODE -DDIAB -DDISABLE_MCAL_INTERMODULE_ASR_CHECK -c
      vendor=Windriver
      version=Windriver DIAB DIAB_5_9_6_2
    compiler GHS_Compiler:
      name=Green Hills
      options=-cpu=ppc5748gz4204 -cpu=ppc5748gz210 -ansi -noSPE -Ospace -sda=0 -vle -dual_debug -G --no_exceptions -Wundef -Wimplicit-int -Wshadow -Wtrigraphs --prototype_errors --incorrect_pragma_warnings -noslashcomment -preprocess_assembly_files -nostartfile --short_enum --diag_error 223 -DAUTOSAR_OS_NOT_USED -DUSE_SW_VECTOR_MODE -DDISABLE_MCAL_INTERMODULE_ASR_CHECK -DGHS -c
      vendor=Green Hills
      version=Green Hills Multi 7.1.4 / Compiler 2015.1.6
    generated-artifacts:
      dependency on artifact Fr_PBcfg_c: artifact-descriptor={short-label=generate_PB::src::Fr_PBcfg.c, category=SWSRC}, usages=COMPILE
      dependency on artifact Fr_Cfg_h: artifact-descriptor={short-label=generate_PC::include::Fr_Cfg.h, category=SWHDR}, usages=COMPILE
    linker DIAB_Linker: name=Windriver Diab, options=-tPPCE200Z4204N3VEN:simple -tPPCE200Z210N3VEN:simple -Xelf -m6 -Xlink-time-lint, vendor=Windriver, version=Windriver DIAB DIAB_5_9_6_2
    linker GHS_Linker: name=Green Hills, options=-cpu=ppc5748gz4204 -cpu=ppc5748gz210 -nostartfiles -vle --nocpp -Mn -delete -ignore_debug_references -keepmap, vendor=Green Hills, version=Green Hills Multi 7.1.4 / Compiler 2015.1.6
    resource consumption ResourceConsumption
      8 x memory section:
        FR_CODE: alignment=UNSPECIFIED, sw-addrmethod=CODE, symbol=CODE
        FR_CONFIG_DATA_UNSPECIFIED: alignment=UNSPECIFIED, sw-addrmethod=CONFIG_DATA_UNSPECIFIED, symbol=CONFIG_DATA_UNSPECIFIED
        FR_VAR_INIT_16: alignment=16, sw-addrmethod=VAR_INIT_16, symbol=VAR_INIT_16
        FR_VAR_INIT_BOOLEAN: alignment=BOOLEAN, sw-addrmethod=VAR_INIT_BOOLEAN, symbol=VAR_INIT_BOOLEAN
        FR_VAR_INIT_UNSPECIFIED: alignment=UNSPECIFIED, sw-addrmethod=VAR_INIT_UNSPECIFIED, symbol=VAR_INIT_UNSPECIFIED
        FR_VAR_NO_INIT_8: alignment=8, sw-addrmethod=VAR_NO_INIT_8, symbol=VAR_NO_INIT_8
        FR_VAR_NO_INIT_UNSPECIFIED: alignment=UNSPECIFIED, sw-addrmethod=VAR_NO_INIT_UNSPECIFIED, symbol=VAR_NO_INIT_UNSPECIFIED
        FR_VAR_NO_INIT_UNSPECIFIED_NO_CACHEABLE: alignment=UNSPECIFIED, sw-addrmethod=VAR_NO_INIT_UNSPECIFIED_NO_CACHEABLE, symbol=VAR_NO_INIT_UNSPECIFIED_NO_CACHEABLE
