AUTOSAR XML (schema 4-0-3)
package /AUTOSAR_Eth/BswModuleDescriptions
  bsw module description Eth: module-id=88
    provided-entrys:
      Eth_EnableEgressTimeStamp
      Eth_GetControllerMode
      Eth_GetCurrentTime
      Eth_GetEgressTimeStamp
      Eth_GetEtherStats
      Eth_GetIngressTimeStamp
      Eth_GetPhysAddr
      Eth_GetVersionInfo
      Eth_Init
      Eth_MainFunction
      Eth_Receive
      Eth_SetControllerMode
      Eth_SetCorrectionTime
      Eth_SetGlobalTime
      Eth_SetPhysAddr
      Eth_TxConfirmation
      Eth_ControllerInit
      Eth_GetCounterState
      Eth_ProvideTxBuffer
      Eth_ReadMii
      BswModuleEntrys/Eth_RxIrqHdlr_0
      Eth_Transmit
      BswModuleEntrys/Eth_TxIrqHdlr_0
      Eth_WriteMii
      BswModuleEntrys/Eth_RxIrqHdlr_0
      Eth_RxIrqHdlr_1
      Eth_TimerWrapIsr_1
      BswModuleEntrys/Eth_TxIrqHdlr_0
      Eth_TxIrqHdlr_1
    bsw internal behavior InternalBehavior_0
      exclusive area ETH_EXCLUSIVE_AREA_{00..02}
      24 x bsw called entity:
        Eth_EnableEgressTimeStamp: implemented-entry=Eth_EnableEgressTimeStamp
        Eth_GetControllerMode: implemented-entry=Eth_GetControllerMode
        Eth_GetCurrentTime: implemented-entry=Eth_GetCurrentTime
        Eth_GetEgressTimeStamp: implemented-entry=Eth_GetEgressTimeStamp
        Eth_GetEtherStats: implemented-entry=Eth_GetEtherStats
        Eth_GetIngressTimeStamp: implemented-entry=Eth_GetIngressTimeStamp
        Eth_GetPhysAddr: implemented-entry=Eth_GetPhysAddr
        Eth_GetVersionInfo: implemented-entry=Eth_GetVersionInfo
        Eth_Init: can-enter-exclusive-area=[ETH_EXCLUSIVE_AREA_00, ETH_EXCLUSIVE_AREA_01, ETH_EXCLUSIVE_AREA_02], implemented-entry=Eth_Init
        Eth_MainFunction: implemented-entry=Eth_MainFunction
        Eth_Receive: implemented-entry=Eth_Receive
        Eth_SetControllerMode: implemented-entry=Eth_SetControllerMode
        Eth_SetCorrectionTime: implemented-entry=Eth_SetCorrectionTime
        Eth_SetGlobalTime: implemented-entry=Eth_SetGlobalTime
        Eth_SetPhysAddr: implemented-entry=Eth_SetPhysAddr
        Eth_TxConfirmation: implemented-entry=Eth_TxConfirmation
        Eth_ControllerInit: implemented-entry=Eth_ControllerInit
        Eth_GetCounterState: implemented-entry=Eth_GetCounterState
        Eth_ProvideTxBuffer: implemented-entry=Eth_ProvideTxBuffer
        Eth_ReadMii: implemented-entry=Eth_ReadMii
        Eth_RxIrqHdlr_0: implemented-entry=BswModuleEntrys/Eth_RxIrqHdlr_0
        Eth_Transmit: implemented-entry=Eth_Transmit
        Eth_TxIrqHdlr_0: implemented-entry=BswModuleEntrys/Eth_TxIrqHdlr_0
        Eth_WriteMii: implemented-entry=Eth_WriteMii
      5 x bsw interrupt entity, all with interrupt-category=CAT-2, interrupt-source=Hardware:
        Eth_RxIrqHdlr_0: implemented-entry=BswModuleEntrys/Eth_RxIrqHdlr_0
        Eth_RxIrqHdlr_1: implemented-entry=Eth_RxIrqHdlr_1
        Eth_TimerWrapIsr_1: implemented-entry=Eth_TimerWrapIsr_1
        Eth_TxIrqHdlr_0: implemented-entry=BswModuleEntrys/Eth_TxIrqHdlr_0
        Eth_TxIrqHdlr_1: implemented-entry=Eth_TxIrqHdlr_1
      bsw timing event EthTimingEvent_MainFunction: starts-on-event=Eth_MainFunction, period=EthMainFunctionPeriod
package /AUTOSAR_Eth/BswModuleEntrys
  29 x bsw module entry, all with is-synchronous=true, sw-service-impl-policy=STANDARD:
    Eth_EnableEgressTimeStamp: service-id=0, is-reentrant=false, call-type=REGULAR, execution-context=UNSPECIFIED
    Eth_GetControllerMode: service-id=0x04, is-reentrant=false, call-type=REGULAR, execution-context=UNSPECIFIED
    Eth_GetCurrentTime: service-id=0, is-reentrant=false, call-type=REGULAR, execution-context=UNSPECIFIED
    Eth_GetEgressTimeStamp: service-id=0, is-reentrant=false, call-type=REGULAR, execution-context=UNSPECIFIED
    Eth_GetEtherStats: service-id=0, is-reentrant=false, call-type=REGULAR, execution-context=UNSPECIFIED
    Eth_GetIngressTimeStamp: service-id=0, is-reentrant=false, call-type=REGULAR, execution-context=UNSPECIFIED
    Eth_GetPhysAddr: service-id=0x08, is-reentrant=false, call-type=REGULAR, execution-context=UNSPECIFIED
    Eth_GetVersionInfo: service-id=0x0D, is-reentrant=true, call-type=REGULAR, execution-context=UNSPECIFIED
    Eth_Init: service-id=0x01, is-reentrant=false, call-type=REGULAR, execution-context=UNSPECIFIED
    Eth_MainFunction: service-id=0, is-reentrant=false, call-type=SCHEDULED, execution-context=TASK
    Eth_Receive: service-id=0x0B, is-reentrant=false, call-type=REGULAR, execution-context=UNSPECIFIED
    Eth_SetControllerMode: service-id=0x03, is-reentrant=false, call-type=REGULAR, execution-context=UNSPECIFIED
    Eth_SetCorrectionTime: service-id=0, is-reentrant=false, call-type=REGULAR, execution-context=UNSPECIFIED
    Eth_SetGlobalTime: service-id=0, is-reentrant=false, call-type=REGULAR, execution-context=UNSPECIFIED
    Eth_SetPhysAddr: service-id=0, is-reentrant=false, call-type=REGULAR, execution-context=UNSPECIFIED
    Eth_TxConfirmation: service-id=0x0C, is-reentrant=false, call-type=REGULAR, execution-context=UNSPECIFIED
    Eth_ControllerInit: service-id=0x02, is-reentrant=false, call-type=REGULAR, execution-context=UNSPECIFIED
    Eth_GetCounterState: service-id=0x07, is-reentrant=false, call-type=REGULAR, execution-context=UNSPECIFIED
    Eth_ProvideTxBuffer: service-id=0x09, is-reentrant=false, call-type=REGULAR, execution-context=UNSPECIFIED
    Eth_ReadMii: service-id=0x06, is-reentrant=false, call-type=REGULAR, execution-context=UNSPECIFIED
    Eth_RxIrqHdlr_0: service-id=0x10, is-reentrant=false, call-type=REGULAR, execution-context=UNSPECIFIED
    Eth_Transmit: service-id=0x0A, is-reentrant=false, call-type=REGULAR, execution-context=UNSPECIFIED
    Eth_TxIrqHdlr_0: service-id=0x11, is-reentrant=false, call-type=REGULAR, execution-context=UNSPECIFIED
    Eth_WriteMii: service-id=0x05, is-reentrant=false, call-type=REGULAR, execution-context=UNSPECIFIED
    Eth_RxIrqHdlr_0: service-id=0, is-reentrant=false, call-type=INTERRUPT, execution-context=INTERRUPT-CAT-2
    Eth_RxIrqHdlr_1: service-id=0, is-reentrant=false, call-type=INTERRUPT, execution-context=INTERRUPT-CAT-2
    Eth_TimerWrapIsr_1: service-id=0, is-reentrant=false, call-type=INTERRUPT, execution-context=INTERRUPT-CAT-2
    Eth_TxIrqHdlr_0: service-id=0, is-reentrant=false, call-type=INTERRUPT, execution-context=INTERRUPT-CAT-2
    Eth_TxIrqHdlr_1: service-id=0, is-reentrant=false, call-type=INTERRUPT, execution-context=INTERRUPT-CAT-2
package /Eth_T2D35M10I0R0/Implementations
  bsw implementation BswImplementation_0: programming-language=C, sw-version=1.0.0, vendor-id=43, ar-release-version=4.2.2, behavior=InternalBehavior_0, vendor-specific-module-def=Eth
    code-descriptors:
      code Files
        artifact-descriptors:
          short-label=config::Eth.xdm, category=SWCFG
          short-label=doc::AUTOSAR_MCAL_ETH_IM.pdf, category=SWDOC
          short-label=doc::AUTOSAR_MCAL_ETH_UM.pdf, category=SWDOC
          short-label=include::Eth.h, category=SWHDR
          short-label=include::Eth_Enet.h, category=SWHDR
          short-label=include::Eth_Enet_Counters.h, category=SWHDR
          short-label=include::Eth_Ipw.h, category=SWHDR
          short-label=include::Eth_Irq.h, category=SWHDR
          short-label=src::Eth.c, category=SWSRC
          short-label=src::Eth_Buffers.c, category=SWSRC
          short-label=src::Eth_Enet.c, category=SWSRC
          short-label=src::Eth_Ipw.c, category=SWSRC
          short-label=src::Eth_Irq.c, category=SWSRC
    compiler DIAB_Compiler:
      name=Windriver Diab
      options=-tPPCE200Z4204N3VEN:simple -tPPCE200Z210N3VEN:simple -Xdialect-ansi -XO -g3 -Xsize-opt -Xsmall-data=0 -Xsmall-const=0 -Xaddr-sconst=0x11 -Xaddr-sdata=0x11 -Xno-common -Xnested-interrupts -Xdebug-dwarf2 -Xdebug-local-all -Xdebug-local-cie -Xdebug-struct-all -Xforce-declarations -ee1481 -Xmacro-undefined-warn -Xlink-time-lint -W:as:,-l -Wa,-Xisa-vle -DAUTOSAR_OS_NOT_USED -DUSE_SW_VECTOR_MODE -DDIAB -DDISABLE_MCAL_INTERMODULE_ASR_CHECK -c
      vendor=Windriver
      version=Windriver DIAB DIAB_5_9_6_2
    compiler GHS_Compiler:
      name=Green Hills
      options=-cpu=ppc5748gz4204 -cpu=ppc5748gz210 -ansi -noSPE -Ospace -sda=0 -vle -dual_debug -G --no_exceptions -Wundef -Wimplicit-int -Wshadow -Wtrigraphs --prototype_errors --incorrect_pragma_warnings -noslashcomment -preprocess_assembly_files -nostartfile --short_enum --diag_error 223 -DAUTOSAR_OS_NOT_USED -DUSE_SW_VECTOR_MODE -DDISABLE_MCAL_INTERMODULE_ASR_CHECK -DGHS -c
      vendor=Green Hills
      version=Green Hills Multi 7.1.4 / Compiler 2015.1.6
    generated-artifacts:
      dependency on artifact Eth_Cfg_h: artifact-descriptor={short-label=generate::include::Eth_Cfg.h, category=SWHDR}, usages=COMPILE
      dependency on artifact Eth_Cfg_c: artifact-descriptor={short-label=generate::src::Eth_Cfg.c, category=SWSRC}, usages=COMPILE
      dependency on artifact Eth_PBcfg_c: artifact-descriptor={short-label=generate::src::Eth_PBcfg.c, category=SWSRC}, usages=COMPILE
    linker DIAB_Linker: name=Windriver Diab, options=-tPPCE200Z4204N3VEN:simple -tPPCE200Z210N3VEN:simple -Xelf -m6 -Xlink-time-lint, vendor=Windriver, version=Windriver DIAB DIAB_5_9_6_2
    linker GHS_Linker: name=Green Hills, options=-cpu=ppc5748gz4204 -cpu=ppc5748gz210 -nostartfiles -vle --nocpp -Mn -delete -ignore_debug_references -keepmap, vendor=Green Hills, version=Green Hills Multi 7.1.4 / Compiler 2015.1.6
    resource consumption ResourceConsumption
      13 x memory section:
        ETH_CODE: alignment=UNSPECIFIED, sw-addrmethod=CODE, symbol=CODE
        ETH_CONFIG_DATA_UNSPECIFIED: alignment=UNSPECIFIED, sw-addrmethod=CONFIG_DATA_UNSPECIFIED, symbol=CONFIG_DATA_UNSPECIFIED
        ETH_CONST_16: alignment=16, sw-addrmethod=CONST_16, symbol=CONST_16
        ETH_CONST_32: alignment=32, sw-addrmethod=CONST_32, symbol=CONST_32
        ETH_CONST_UNSPECIFIED: alignment=UNSPECIFIED, sw-addrmethod=CONST_UNSPECIFIED, symbol=CONST_UNSPECIFIED
        ETH_VAR_INIT_16: alignment=16, sw-addrmethod=VAR_INIT_16, symbol=VAR_INIT_16
        ETH_VAR_INIT_32: alignment=32, sw-addrmethod=VAR_INIT_32, symbol=VAR_INIT_32
        ETH_VAR_INIT_8: alignment=8, sw-addrmethod=VAR_INIT_8, symbol=VAR_INIT_8
        ETH_VAR_INIT_BOOLEAN: alignment=BOOLEAN, sw-addrmethod=VAR_INIT_BOOLEAN, symbol=VAR_INIT_BOOLEAN
        ETH_VAR_INIT_UNSPECIFIED: alignment=UNSPECIFIED, sw-addrmethod=VAR_INIT_UNSPECIFIED, symbol=VAR_INIT_UNSPECIFIED
        ETH_VAR_NO_INIT_8: alignment=8, sw-addrmethod=VAR_NO_INIT_8, symbol=VAR_NO_INIT_8
        ETH_VAR_NO_INIT_UNSPECIFIED: alignment=UNSPECIFIED, sw-addrmethod=VAR_NO_INIT_UNSPECIFIED, symbol=VAR_NO_INIT_UNSPECIFIED
        ETH_VAR_NO_INIT_UNSPECIFIED_NO_CACHEABLE: alignment=UNSPECIFIED, sw-addrmethod=VAR_NO_INIT_UNSPECIFIED_NO_CACHEABLE, symbol=VAR_NO_INIT_UNSPECIFIED_NO_CACHEABLE
